/begin MEASUREMENT DIAGGlobalTimeTick "Data Logging Global Time Tick" VALUE 0x20073168 RL_VALU32 CM_DIAGGLOBALTIMETICK USERDIAG 0 10000 /end MEASUREMENT
/begin COMPU_METHOD CM_DIAGGLOBALTIMETICK Conversion for "DIAGGlobalTimeTick" IDENTICAL %6.0 dl /end COMPU_METHOD
/begin MEASUREMENT IAC Step "IAC Current Stepper Position" VALUE 0x2007352C RL_VALU32 CM_IAC_STEP IAC 0 255 /end MEASUREMENT
/begin COMPU_METHOD CM_IAC_STEP Conversion for "IAC Step" IDENTICAL %5.3 dl /end COMPU_METHOD
/begin MEASUREMENT IAC Step Learned Min "IAC Learned Min Position" VALUE 0x2007351C RL_VALU32 CM_IAC_STEP_LEARNED_MIN IAC 0 255 /end MEASUREMENT
/begin COMPU_METHOD CM_IAC_STEP_LEARNED_MIN Conversion for "IAC Step Learned Min" IDENTICAL %5.3 dl /end COMPU_METHOD
/begin MEASUREMENT IAC Target RPM "IAC Current Target RPM" VALUE 0x20073532 RL_VALU16 CM_IAC_TARGET_RPM IAC 0 4095 /end MEASUREMENT
/begin COMPU_METHOD CM_IAC_TARGET_RPM Conversion for "IAC Target RPM" IDENTICAL %5.3 dl /end COMPU_METHOD
/begin MEASUREMENT Nernst Sense 1 Volts "Nernst Sense Volts Left" VALUE 0x00000000 RL_VALU32 CM_NERNST_SENSE_1_VOLTS LSU4X 0 5 /end MEASUREMENT
/begin COMPU_METHOD CM_NERNST_SENSE_1_VOLTS Conversion for "Nernst Sense 1 Volts" LINEAR %4.3 V COEFFS_LINEAR 0.001 0 /end COMPU_METHOD
/begin MEASUREMENT Nernst Sense 2 Volts "Nernst Sense Volts Right" VALUE 0x00000000 RL_VALU32 CM_NERNST_SENSE_2_VOLTS LSU4X 0 5 /end MEASUREMENT
/begin COMPU_METHOD CM_NERNST_SENSE_2_VOLTS Conversion for "Nernst Sense 2 Volts" LINEAR %4.3 V COEFFS_LINEAR 0.001 0 /end COMPU_METHOD
/begin MEASUREMENT Pump Current 1 "Pump 1 Current (uA)" VALUE 0x00000000 RL_VALS32 CM_PUMP_CURRENT_1 LSU4X -20000 20000 /end MEASUREMENT
/begin COMPU_METHOD CM_PUMP_CURRENT_1 Conversion for "Pump Current 1" LINEAR %4.3 uA COEFFS_LINEAR 0.001 0 /end COMPU_METHOD
/begin MEASUREMENT Pump Current 2 "Pump 2 Current (uA)" VALUE 0x00000000 RL_VALS32 CM_PUMP_CURRENT_2 LSU4X -20000 20000 /end MEASUREMENT
/begin COMPU_METHOD CM_PUMP_CURRENT_2 Conversion for "Pump Current 2" LINEAR %4.3 uA COEFFS_LINEAR 0.001 0 /end COMPU_METHOD
/begin MEASUREMENT Heater Duty 1 "Heater Left Duty Cycle" VALUE 0x00000000 RL_VALU32 CM_HEATER_DUTY_1 LSUH 0 100 /end MEASUREMENT
/begin COMPU_METHOD CM_HEATER_DUTY_1 Conversion for "Heater Duty 1" LINEAR %6.3 % COEFFS_LINEAR 0.001 0 /end COMPU_METHOD
/begin MEASUREMENT Heater Duty 2 "Heater Right Duty Cycle" VALUE 0x00000000 RL_VALU32 CM_HEATER_DUTY_2 LSUH 0 100 /end MEASUREMENT
/begin COMPU_METHOD CM_HEATER_DUTY_2 Conversion for "Heater Duty 2" LINEAR %6.3 % COEFFS_LINEAR 0.001 0 /end COMPU_METHOD
/begin MEASUREMENT USERCAL_ConfigCRC "Working Calibration CRC" VALUE 0x2007362C RL_VALU16 CM_USERCAL_CONFIGCRC USERCAL 0 65535 /end MEASUREMENT
/begin COMPU_METHOD CM_USERCAL_CONFIGCRC Conversion for "USERCAL_ConfigCRC" IDENTICAL %5.3 dl /end COMPU_METHOD
/begin MEASUREMENT AFM Sensor ADC "AFM Sensor ADC Counts" VALUE 0x20073034 RL_VALU32 CM_AFM_SENSOR_ADC AFM 0 4095 /end MEASUREMENT
/begin COMPU_METHOD CM_AFM_SENSOR_ADC Conversion for "AFM Sensor ADC" IDENTICAL %5.3 dl /end COMPU_METHOD
/begin MEASUREMENT AFM Sensor Frequency "AFM Sensor Flow" VALUE 0x20073014 RL_VALU32 CM_AFM_SENSOR_FREQUENCY AFM 0 65535 /end MEASUREMENT
/begin COMPU_METHOD CM_AFM_SENSOR_FREQUENCY Conversion for "AFM Sensor Frequency" IDENTICAL %5.3 Hz /end COMPU_METHOD
/begin MEASUREMENT AFM Sensor Voltage "AFM Sensor Flow" VALUE 0x20073030 RL_VALU32 CM_AFM_SENSOR_VOLTAGE AFM 0 5 /end MEASUREMENT
/begin COMPU_METHOD CM_AFM_SENSOR_VOLTAGE Conversion for "AFM Sensor Voltage" LINEAR %5.3 V COEFFS_LINEAR 0.001 0 /end COMPU_METHOD
/begin MEASUREMENT AFM Sensor Mass Flow "AFM Sensor Flow" VALUE 0x20073018 RL_VALU32 CM_AFM_SENSOR_MASS_FLOW AFM 0 5 /end MEASUREMENT
/begin COMPU_METHOD CM_AFM_SENSOR_MASS_FLOW Conversion for "AFM Sensor Mass Flow" LINEAR %5.3 V COEFFS_LINEAR 0.001 0 /end COMPU_METHOD
/begin MEASUREMENT AFM Sensor Mass Filtered Backup "AFM Sensor Flow Filtered" VALUE 0x20073008 RL_VALU32 CM_AFM_SENSOR_MASS_FILTERED_BACKUP AFM 0 5 /end MEASUREMENT
/begin COMPU_METHOD CM_AFM_SENSOR_MASS_FILTERED_BACKUP Conversion for "AFM Sensor Mass Filtered Backup" LINEAR %5.3 V COEFFS_LINEAR 0.001 0 /end COMPU_METHOD
/begin MEASUREMENT AFM VE Learn "AFM VE Learn" VALUE 0x20073038 RL_VALU16 CM_AFM_VE_LEARN AFM 0 2 /end MEASUREMENT
/begin COMPU_METHOD CM_AFM_VE_LEARN Conversion for "AFM VE Learn" LINEAR %5.3 dl COEFFS_LINEAR 0.001 0 /end COMPU_METHOD
/begin MEASUREMENT Air Sensor Filtered ADC "ATS Sensor ADC" VALUE 0x20073060 RL_VALU32 CM_AIR_SENSOR_FILTERED_ADC ATS 0 1048575 /end MEASUREMENT
/begin COMPU_METHOD CM_AIR_SENSOR_FILTERED_ADC Conversion for "Air Sensor Filtered ADC" IDENTICAL %5.3 counts /end COMPU_METHOD
/begin MEASUREMENT ATS Sensor Voltage "ATS Sensor Voltage" VALUE 0x20073048 RL_VALU32 CM_ATS_SENSOR_VOLTAGE ATS 0 5 /end MEASUREMENT
/begin COMPU_METHOD CM_ATS_SENSOR_VOLTAGE Conversion for "ATS Sensor Voltage" LINEAR %3.2 V COEFFS_LINEAR 0.001 0 /end COMPU_METHOD
/begin MEASUREMENT Air Temperature "Air Temperature" VALUE 0x2007306C RL_VALS32 CM_AIR_TEMPERATURE ATS 0 200 /end MEASUREMENT
/begin COMPU_METHOD CM_AIR_TEMPERATURE Conversion for "Air Temperature" LINEAR %4.1 degrees C COEFFS_LINEAR 0.001 0 /end COMPU_METHOD
/begin MEASUREMENT Battery Voltage "Battery Voltage" VALUE 0x20073078 RL_VALU32 CM_BATTERY_VOLTAGE BVM 0 20 /end MEASUREMENT
/begin COMPU_METHOD CM_BATTERY_VOLTAGE Conversion for "Battery Voltage" LINEAR %5.3 V COEFFS_LINEAR 0.001 0 /end COMPU_METHOD
/begin MEASUREMENT Engine Speed Raw "Engine Speed" VALUE 0x20073098 RL_VALU32 CM_ENGINE_SPEED_RAW CAM 0 10000 /end MEASUREMENT
/begin COMPU_METHOD CM_ENGINE_SPEED_RAW Conversion for "Engine Speed Raw" IDENTICAL %4.0 RPM /end COMPU_METHOD
/begin MEASUREMENT RPM Transition Counter "RPM Transition Counter" VALUE 0x2007308C RL_VALU32 CM_RPM_TRANSITION_COUNTER CAM 0 10000 /end MEASUREMENT
/begin COMPU_METHOD CM_RPM_TRANSITION_COUNTER Conversion for "RPM Transition Counter" IDENTICAL %4.0 RPM /end COMPU_METHOD
/begin MEASUREMENT STT Bank 1 "Short Term Trim Bank1" VALUE 0x200730C0 RL_VALU32 CM_STT_BANK_1 CLO2 0 1500 /end MEASUREMENT
/begin COMPU_METHOD CM_STT_BANK_1 Conversion for "STT Bank 1" IDENTICAL %4.0 dl /end COMPU_METHOD
/begin MEASUREMENT STT Bank 2 "Short Term Trim Bank2" VALUE 0x200730C4 RL_VALU32 CM_STT_BANK_2 CLO2 0 1500 /end MEASUREMENT
/begin COMPU_METHOD CM_STT_BANK_2 Conversion for "STT Bank 2" IDENTICAL %4.0 dl /end COMPU_METHOD
/begin MEASUREMENT AFR Measured 1 "Measured AFR Bank1" VALUE 0x200730A4 RL_VALU16 CM_AFR_MEASURED_1 CLO2 5 100 /end MEASUREMENT
/begin COMPU_METHOD CM_AFR_MEASURED_1 Conversion for "AFR Measured 1" LINEAR %4.2 dl COEFFS_LINEAR 0.01 0 /end COMPU_METHOD
/begin MEASUREMENT AFR Measured 2 "Measured AFR Bank2" VALUE 0x200730A6 RL_VALU16 CM_AFR_MEASURED_2 CLO2 5 100 /end MEASUREMENT
/begin COMPU_METHOD CM_AFR_MEASURED_2 Conversion for "AFR Measured 2" LINEAR %4.2 dl COEFFS_LINEAR 0.01 0 /end COMPU_METHOD
/begin MEASUREMENT VE AUTOTUNE DIAG "Autotune VE Diag" VALUE 0x200730CC RL_VALU32 CM_VE_AUTOTUNE_DIAG CLO2 5 100 /end MEASUREMENT
/begin COMPU_METHOD CM_VE_AUTOTUNE_DIAG Conversion for "VE AUTOTUNE DIAG" LINEAR %4.2 dl COEFFS_LINEAR 0.01 0 /end COMPU_METHOD
/begin MEASUREMENT Coolant Sensor Filtered ADC "CTS Sensor ADC" VALUE 0x20073108 RL_VALU32 CM_COOLANT_SENSOR_FILTERED_ADC CTS 0 1048575 /end MEASUREMENT
/begin COMPU_METHOD CM_COOLANT_SENSOR_FILTERED_ADC Conversion for "Coolant Sensor Filtered ADC" IDENTICAL %5.3 counts /end COMPU_METHOD
/begin MEASUREMENT CTS Sensor Voltage "CTS Sensor Voltage" VALUE 0x200730F4 RL_VALU32 CM_CTS_SENSOR_VOLTAGE CTS 0 5 /end MEASUREMENT
/begin COMPU_METHOD CM_CTS_SENSOR_VOLTAGE Conversion for "CTS Sensor Voltage" LINEAR %3.2 V COEFFS_LINEAR 0.001 0 /end COMPU_METHOD
/begin MEASUREMENT Coolant Temperature "Coolant Temperature" VALUE 0x200730E4 RL_VALS32 CM_COOLANT_TEMPERATURE CTS 0 200 /end MEASUREMENT
/begin COMPU_METHOD CM_COOLANT_TEMPERATURE Conversion for "Coolant Temperature" LINEAR %4.1 degrees C COEFFS_LINEAR 0.001 0 /end COMPU_METHOD
/begin MEASUREMENT Primer "Start Primer" VALUE 0x200730F8 RL_VALU32 CM_PRIMER CTS 0 200 /end MEASUREMENT
/begin COMPU_METHOD CM_PRIMER Conversion for "Primer" LINEAR %4.1 us COEFFS_LINEAR 0.001 0 /end COMPU_METHOD
/begin MEASUREMENT _DIAG Spread Result Table 0 "Internal Spread Result Table" VALUE 0x20073148 RL_VALU32 CM__DIAG_SPREAD_RESULT_TABLE_0 DIAG 0 1 /end MEASUREMENT
/begin COMPU_METHOD CM__DIAG_SPREAD_RESULT_TABLE_0 Conversion for "_DIAG Spread Result Table 0" IDENTICAL %6.0 dl /end COMPU_METHOD
/begin MEASUREMENT _DIAG Spread Result Table 1 "Internal Spread Result Table" VALUE 0x2007314C RL_VALU32 CM__DIAG_SPREAD_RESULT_TABLE_1 DIAG 0 1 /end MEASUREMENT
/begin COMPU_METHOD CM__DIAG_SPREAD_RESULT_TABLE_1 Conversion for "_DIAG Spread Result Table 1" IDENTICAL %6.0 dl /end COMPU_METHOD
/begin MEASUREMENT _DIAG Spread Result Table 2 "Internal Spread Result Table" VALUE 0x20073150 RL_VALU32 CM__DIAG_SPREAD_RESULT_TABLE_2 DIAG 0 1 /end MEASUREMENT
/begin COMPU_METHOD CM__DIAG_SPREAD_RESULT_TABLE_2 Conversion for "_DIAG Spread Result Table 2" IDENTICAL %6.0 dl /end COMPU_METHOD
/begin MEASUREMENT _DIAG Spread Result Table 3 "Internal Spread Result Table" VALUE 0x20073154 RL_VALU32 CM__DIAG_SPREAD_RESULT_TABLE_3 DIAG 0 1 /end MEASUREMENT
/begin COMPU_METHOD CM__DIAG_SPREAD_RESULT_TABLE_3 Conversion for "_DIAG Spread Result Table 3" IDENTICAL %6.0 dl /end COMPU_METHOD
/begin CHARACTERISTIC _DIAG Spread Address Table 0 "Internal Spread Address Table" VALUE 0x20073134 RL_VALU32 CM__DIAG_SPREAD_ADDRESS_TABLE_0 DIAG 0 1 /end CHARACTERISTIC
/begin COMPU_METHOD CM__DIAG_SPREAD_ADDRESS_TABLE_0 Conversion for "_DIAG Spread Address Table 0" IDENTICAL %6.0 dl /end COMPU_METHOD
/begin CHARACTERISTIC _DIAG Spread Address Table 1 "Internal Spread Address Table" VALUE 0x20073138 RL_VALU32 CM__DIAG_SPREAD_ADDRESS_TABLE_1 DIAG 0 1 /end CHARACTERISTIC
/begin COMPU_METHOD CM__DIAG_SPREAD_ADDRESS_TABLE_1 Conversion for "_DIAG Spread Address Table 1" IDENTICAL %6.0 dl /end COMPU_METHOD
/begin CHARACTERISTIC _DIAG Spread Address Table 2 "Internal Spread Address Table" VALUE 0x2007313C RL_VALU32 CM__DIAG_SPREAD_ADDRESS_TABLE_2 DIAG 0 1 /end CHARACTERISTIC
/begin COMPU_METHOD CM__DIAG_SPREAD_ADDRESS_TABLE_2 Conversion for "_DIAG Spread Address Table 2" IDENTICAL %6.0 dl /end COMPU_METHOD
/begin CHARACTERISTIC _DIAG Spread Address Table 3 "Internal Spread Address Table" VALUE 0x20073140 RL_VALU32 CM__DIAG_SPREAD_ADDRESS_TABLE_3 DIAG 0 1 /end CHARACTERISTIC
/begin COMPU_METHOD CM__DIAG_SPREAD_ADDRESS_TABLE_3 Conversion for "_DIAG Spread Address Table 3" IDENTICAL %6.0 dl /end COMPU_METHOD
/begin MEASUREMENT EST Start Fraction "EST Dwell Start Fraction" VALUE 0x20073330 RL_VALU32 CM_EST_START_FRACTION EST 0 1 /end MEASUREMENT
/begin COMPU_METHOD CM_EST_START_FRACTION Conversion for "EST Start Fraction" LINEAR %6.0 dl COEFFS_LINEAR 1.526E-05 0 /end COMPU_METHOD
/begin MEASUREMENT EST Dwell Fraction "EST Dwell Fraction" VALUE 0x20073340 RL_VALU32 CM_EST_DWELL_FRACTION EST 0 1 /end MEASUREMENT
/begin COMPU_METHOD CM_EST_DWELL_FRACTION Conversion for "EST Dwell Fraction" LINEAR %6.0 dl COEFFS_LINEAR 1.526E-05 0 /end COMPU_METHOD
/begin MEASUREMENT EST Ignition Advance "EST Ignition Advance" VALUE 0x20073360 RL_VALU32 CM_EST_IGNITION_ADVANCE EST 0 50 /end MEASUREMENT
/begin COMPU_METHOD CM_EST_IGNITION_ADVANCE Conversion for "EST Ignition Advance" LINEAR %5.3 degrees COEFFS_LINEAR 0.001 0 /end COMPU_METHOD
/begin MEASUREMENT Fuel Injector Hold ms "Fuel Injector Total ms" VALUE 0x20073404 RL_VALU32 CM_FUEL_INJECTOR_HOLD_MS FUEL 0 40 /end MEASUREMENT
/begin COMPU_METHOD CM_FUEL_INJECTOR_HOLD_MS Conversion for "Fuel Injector Hold ms" LINEAR %5.3 ms COEFFS_LINEAR 0.001 0 /end COMPU_METHOD
/begin MEASUREMENT Fuel Injector Predicted ms "Fuel Injector Predicted ms" VALUE 0x200733D8 RL_VALU32 CM_FUEL_INJECTOR_PREDICTED_MS FUEL 0 40 /end MEASUREMENT
/begin COMPU_METHOD CM_FUEL_INJECTOR_PREDICTED_MS Conversion for "Fuel Injector Predicted ms" LINEAR %5.3 ms COEFFS_LINEAR 0.001 0 /end COMPU_METHOD
/begin MEASUREMENT Generic Data 1|LINK|Engine Speed Raw "Generic RPM" VALUE 0x200734A6 RL_VALU16 CM_GENERIC_DATA_1|LINK|ENGINE_SPEED_RAW GENDATA 0 32767 /end MEASUREMENT
/begin COMPU_METHOD CM_GENERIC_DATA_1|LINK|ENGINE_SPEED_RAW Conversion for "Generic Data 1|LINK|Engine Speed Raw" IDENTICAL %5.3 dl /end COMPU_METHOD
/begin MEASUREMENT Generic Data 2|LINK|Throttle Angle "Generic TPS" VALUE 0x200734A8 RL_VALU16 CM_GENERIC_DATA_2|LINK|THROTTLE_ANGLE GENDATA 0 32767 /end MEASUREMENT
/begin COMPU_METHOD CM_GENERIC_DATA_2|LINK|THROTTLE_ANGLE Conversion for "Generic Data 2|LINK|Throttle Angle" IDENTICAL %5.3 dl /end COMPU_METHOD
/begin MEASUREMENT Generic Data 3|LINK|MAP kPa "Generic MAP" VALUE 0x20073490 RL_VALU16 CM_GENERIC_DATA_3|LINK|MAP_KPA GENDATA 0 32767 /end MEASUREMENT
/begin COMPU_METHOD CM_GENERIC_DATA_3|LINK|MAP_KPA Conversion for "Generic Data 3|LINK|MAP kPa" IDENTICAL %5.3 dl /end COMPU_METHOD
/begin MEASUREMENT Generic Data 4|LINK|Coolant Temperature "Generic CTS" VALUE 0x200734A4 RL_VALU16 CM_GENERIC_DATA_4|LINK|COOLANT_TEMPERATURE GENDATA 0 32767 /end MEASUREMENT
/begin COMPU_METHOD CM_GENERIC_DATA_4|LINK|COOLANT_TEMPERATURE Conversion for "Generic Data 4|LINK|Coolant Temperature" IDENTICAL %5.3 dl /end COMPU_METHOD
/begin MEASUREMENT Generic Data 5|LINK|Air Temperature "Generic CTS" VALUE 0x200734FC RL_VALU16 CM_GENERIC_DATA_5|LINK|AIR_TEMPERATURE GENDATA 0 32767 /end MEASUREMENT
/begin COMPU_METHOD CM_GENERIC_DATA_5|LINK|AIR_TEMPERATURE Conversion for "Generic Data 5|LINK|Air Temperature" IDENTICAL %5.3 dl /end COMPU_METHOD
/begin MEASUREMENT Generic Source IDX1 "Generic Source IDX1" VALUE 0x200734AC RL_VALU16 CM_GENERIC_SOURCE_IDX1 GENDATA 0 32767 /end MEASUREMENT
/begin COMPU_METHOD CM_GENERIC_SOURCE_IDX1 Conversion for "Generic Source IDX1" IDENTICAL %5.3 dl /end COMPU_METHOD
/begin MEASUREMENT Generic Source IDX2 "Generic Source IDX2" VALUE 0x200734AE RL_VALU16 CM_GENERIC_SOURCE_IDX2 GENDATA 0 32767 /end MEASUREMENT
/begin COMPU_METHOD CM_GENERIC_SOURCE_IDX2 Conversion for "Generic Source IDX2" IDENTICAL %5.3 dl /end COMPU_METHOD
/begin MEASUREMENT Generic Source IDX3 "Generic Source IDX3" VALUE 0x200734B0 RL_VALU16 CM_GENERIC_SOURCE_IDX3 GENDATA 0 32767 /end MEASUREMENT
/begin COMPU_METHOD CM_GENERIC_SOURCE_IDX3 Conversion for "Generic Source IDX3" IDENTICAL %5.3 dl /end COMPU_METHOD
/begin MEASUREMENT Generic Source IDX4 "Generic Source IDX4" VALUE 0x200734B2 RL_VALU16 CM_GENERIC_SOURCE_IDX4 GENDATA 0 32767 /end MEASUREMENT
/begin COMPU_METHOD CM_GENERIC_SOURCE_IDX4 Conversion for "Generic Source IDX4" IDENTICAL %5.3 dl /end COMPU_METHOD
/begin MEASUREMENT Generic Source IDX5 "Generic Source IDX5" VALUE 0x200734B4 RL_VALU16 CM_GENERIC_SOURCE_IDX5 GENDATA 0 32767 /end MEASUREMENT
/begin COMPU_METHOD CM_GENERIC_SOURCE_IDX5 Conversion for "Generic Source IDX5" IDENTICAL %5.3 dl /end COMPU_METHOD
/begin MEASUREMENT Generic Source IDX6 "Generic Source IDX6" VALUE 0x200734B6 RL_VALU16 CM_GENERIC_SOURCE_IDX6 GENDATA 0 32767 /end MEASUREMENT
/begin COMPU_METHOD CM_GENERIC_SOURCE_IDX6 Conversion for "Generic Source IDX6" IDENTICAL %5.3 dl /end COMPU_METHOD
/begin MEASUREMENT Generic Source IDX7 "Generic Source IDX7" VALUE 0x200734B8 RL_VALU16 CM_GENERIC_SOURCE_IDX7 GENDATA 0 32767 /end MEASUREMENT
/begin COMPU_METHOD CM_GENERIC_SOURCE_IDX7 Conversion for "Generic Source IDX7" IDENTICAL %5.3 dl /end COMPU_METHOD
/begin MEASUREMENT Generic Source IDX8 "Generic Source IDX8" VALUE 0x200734BA RL_VALU16 CM_GENERIC_SOURCE_IDX8 GENDATA 0 32767 /end MEASUREMENT
/begin COMPU_METHOD CM_GENERIC_SOURCE_IDX8 Conversion for "Generic Source IDX8" IDENTICAL %5.3 dl /end COMPU_METHOD
/begin MEASUREMENT Generic Source IDX9 "Generic Source IDX9" VALUE 0x200734BC RL_VALU16 CM_GENERIC_SOURCE_IDX9 GENDATA 0 32767 /end MEASUREMENT
/begin COMPU_METHOD CM_GENERIC_SOURCE_IDX9 Conversion for "Generic Source IDX9" IDENTICAL %5.3 dl /end COMPU_METHOD
/begin MEASUREMENT Generic Source IDX10 "Generic Source IDX10" VALUE 0x200734BE RL_VALU16 CM_GENERIC_SOURCE_IDX10 GENDATA 0 32767 /end MEASUREMENT
/begin COMPU_METHOD CM_GENERIC_SOURCE_IDX10 Conversion for "Generic Source IDX10" IDENTICAL %5.3 dl /end COMPU_METHOD
/begin MEASUREMENT Generic Source IDX11 "Generic Source IDX11" VALUE 0x200734C0 RL_VALU16 CM_GENERIC_SOURCE_IDX11 GENDATA 0 32767 /end MEASUREMENT
/begin COMPU_METHOD CM_GENERIC_SOURCE_IDX11 Conversion for "Generic Source IDX11" IDENTICAL %5.3 dl /end COMPU_METHOD
/begin MEASUREMENT Generic Source IDX12 "Generic Source IDX12" VALUE 0x200734C2 RL_VALU16 CM_GENERIC_SOURCE_IDX12 GENDATA 0 32767 /end MEASUREMENT
/begin COMPU_METHOD CM_GENERIC_SOURCE_IDX12 Conversion for "Generic Source IDX12" IDENTICAL %5.3 dl /end COMPU_METHOD
/begin MEASUREMENT Generic Source IDX13 "Generic Source IDX13" VALUE 0x200734C4 RL_VALU16 CM_GENERIC_SOURCE_IDX13 GENDATA 0 32767 /end MEASUREMENT
/begin COMPU_METHOD CM_GENERIC_SOURCE_IDX13 Conversion for "Generic Source IDX13" IDENTICAL %5.3 dl /end COMPU_METHOD
/begin MEASUREMENT Generic Source IDX14 "Generic Source IDX14" VALUE 0x200734C6 RL_VALU16 CM_GENERIC_SOURCE_IDX14 GENDATA 0 32767 /end MEASUREMENT
/begin COMPU_METHOD CM_GENERIC_SOURCE_IDX14 Conversion for "Generic Source IDX14" IDENTICAL %5.3 dl /end COMPU_METHOD
/begin MEASUREMENT Generic Source IDX15 "Generic Source IDX15" VALUE 0x200734C8 RL_VALU16 CM_GENERIC_SOURCE_IDX15 GENDATA 0 32767 /end MEASUREMENT
/begin COMPU_METHOD CM_GENERIC_SOURCE_IDX15 Conversion for "Generic Source IDX15" IDENTICAL %5.3 dl /end COMPU_METHOD
/begin MEASUREMENT Generic Source IDX16 "Generic Source IDX16" VALUE 0x200734CA RL_VALU16 CM_GENERIC_SOURCE_IDX16 GENDATA 0 32767 /end MEASUREMENT
/begin COMPU_METHOD CM_GENERIC_SOURCE_IDX16 Conversion for "Generic Source IDX16" IDENTICAL %5.3 dl /end COMPU_METHOD
/begin MEASUREMENT PWMPeriod "PWM Period" VALUE 0x00000000 RL_VALU16 CM_PWMPERIOD LSU4X 0 5 /end MEASUREMENT
/begin COMPU_METHOD CM_PWMPERIOD Conversion for "PWMPeriod" LINEAR %6.0 dl COEFFS_LINEAR 0.001 0 /end COMPU_METHOD
/begin MEASUREMENT PWMLastStart "PWM Period Last Origin" VALUE 0x00000000 RL_VALU16 CM_PWMLASTSTART LSU4X 0 5 /end MEASUREMENT
/begin COMPU_METHOD CM_PWMLASTSTART Conversion for "PWMLastStart" LINEAR %6.0 dl COEFFS_LINEAR 0.001 0 /end COMPU_METHOD
/begin MEASUREMENT Nernst Rout 1 "Nernst 1 output impedence" VALUE 0x00000000 RL_VALU32 CM_NERNST_ROUT_1 LSU4X 0 1000 /end MEASUREMENT
/begin COMPU_METHOD CM_NERNST_ROUT_1 Conversion for "Nernst Rout 1" LINEAR %3.0 Ohm COEFFS_LINEAR 0.001 0 /end COMPU_METHOD
/begin MEASUREMENT Nernst Rout 2 "Nernst 2 output impedence" VALUE 0x00000000 RL_VALU32 CM_NERNST_ROUT_2 LSU4X 0 1000 /end MEASUREMENT
/begin COMPU_METHOD CM_NERNST_ROUT_2 Conversion for "Nernst Rout 2" LINEAR %3.0 Ohm COEFFS_LINEAR 0.001 0 /end COMPU_METHOD
/begin MEASUREMENT Lambda 1 "Lambda 1 Measurement (dimensionless)" VALUE 0x00000000 RL_VALU16 CM_LAMBDA_1 LSU4X 0 5 /end MEASUREMENT
/begin COMPU_METHOD CM_LAMBDA_1 Conversion for "Lambda 1" LINEAR %4.3 dl COEFFS_LINEAR 0.001 0 /end COMPU_METHOD
/begin MEASUREMENT Lambda 2 "Lambda 2 Measurement (dimensionless)" VALUE 0x00000000 RL_VALU16 CM_LAMBDA_2 LSU4X 0 5 /end MEASUREMENT
/begin COMPU_METHOD CM_LAMBDA_2 Conversion for "Lambda 2" LINEAR %4.3 dl COEFFS_LINEAR 0.001 0 /end COMPU_METHOD
/begin MEASUREMENT Samples1 "sample 1" VALUE 0x00000000 RL_VALU32 CM_SAMPLES1 LSU4X 0 5 /end MEASUREMENT
/begin COMPU_METHOD CM_SAMPLES1 Conversion for "Samples1" IDENTICAL %6.0 n /end COMPU_METHOD
/begin MEASUREMENT Samples2 "sample 2" VALUE 0x00000000 RL_VALU32 CM_SAMPLES2 LSU4X 0 5 /end MEASUREMENT
/begin COMPU_METHOD CM_SAMPLES2 Conversion for "Samples2" IDENTICAL %6.0 n /end COMPU_METHOD
/begin MEASUREMENT Samples3 "sample 3" VALUE 0x00000000 RL_VALU32 CM_SAMPLES3 LSU4X 0 5 /end MEASUREMENT
/begin COMPU_METHOD CM_SAMPLES3 Conversion for "Samples3" IDENTICAL %6.0 n /end COMPU_METHOD
/begin MEASUREMENT Samples4 "sample 4" VALUE 0x00000000 RL_VALU32 CM_SAMPLES4 LSU4X 0 5 /end MEASUREMENT
/begin COMPU_METHOD CM_SAMPLES4 Conversion for "Samples4" IDENTICAL %6.0 n /end COMPU_METHOD
/begin MEASUREMENT Samples5 "sample 5" VALUE 0x00000000 RL_VALU32 CM_SAMPLES5 LSU4X 0 5 /end MEASUREMENT
/begin COMPU_METHOD CM_SAMPLES5 Conversion for "Samples5" IDENTICAL %6.0 n /end COMPU_METHOD
/begin MEASUREMENT Samples6 "sample 6" VALUE 0x00000000 RL_VALU32 CM_SAMPLES6 LSU4X 0 5 /end MEASUREMENT
/begin COMPU_METHOD CM_SAMPLES6 Conversion for "Samples6" IDENTICAL %6.0 n /end COMPU_METHOD
/begin MEASUREMENT Samples7 "sample 7" VALUE 0x00000000 RL_VALU32 CM_SAMPLES7 LSU4X 0 5 /end MEASUREMENT
/begin COMPU_METHOD CM_SAMPLES7 Conversion for "Samples7" IDENTICAL %6.0 n /end COMPU_METHOD
/begin MEASUREMENT Samples8 "sample 8" VALUE 0x00000000 RL_VALU32 CM_SAMPLES8 LSU4X 0 5 /end MEASUREMENT
/begin COMPU_METHOD CM_SAMPLES8 Conversion for "Samples8" IDENTICAL %6.0 n /end COMPU_METHOD
/begin MEASUREMENT Heater Ohms 1 "Heater 1 Ohms" VALUE 0x00000000 RL_VALU32 CM_HEATER_OHMS_1 LSUH 0 10 /end MEASUREMENT
/begin COMPU_METHOD CM_HEATER_OHMS_1 Conversion for "Heater Ohms 1" LINEAR %5.3 Ohms COEFFS_LINEAR 0.001 0 /end COMPU_METHOD
/begin MEASUREMENT Heater Ohms 2 "Heater 2 Ohms" VALUE 0x00000000 RL_VALU32 CM_HEATER_OHMS_2 LSUH 0 10 /end MEASUREMENT
/begin COMPU_METHOD CM_HEATER_OHMS_2 Conversion for "Heater Ohms 2" LINEAR %5.3 Ohms COEFFS_LINEAR 0.001 0 /end COMPU_METHOD
/begin MEASUREMENT MAP Sensor ADC "MAP Sensor ADC Counts" VALUE 0x20073590 RL_VALU32 CM_MAP_SENSOR_ADC MAP 0 4095 /end MEASUREMENT
/begin COMPU_METHOD CM_MAP_SENSOR_ADC Conversion for "MAP Sensor ADC" IDENTICAL %5.3 dl /end COMPU_METHOD
/begin MEASUREMENT MAP Sensor Voltage "MAP Sensor Voltage" VALUE 0x200735B0 RL_VALU32 CM_MAP_SENSOR_VOLTAGE MAP 0 5 /end MEASUREMENT
/begin COMPU_METHOD CM_MAP_SENSOR_VOLTAGE Conversion for "MAP Sensor Voltage" LINEAR %5.3 V COEFFS_LINEAR 0.001 0 /end COMPU_METHOD
/begin MEASUREMENT MAP kPa "Manifold Pressure" VALUE 0x20073570 RL_VALU32 CM_MAP_KPA MAP 0 500 /end MEASUREMENT
/begin COMPU_METHOD CM_MAP_KPA Conversion for "MAP kPa" LINEAR %5.3 kPa COEFFS_LINEAR 0.001 0 /end COMPU_METHOD
/begin MEASUREMENT CAN CTS "CTS CAN" VALUE 0x2007360C RL_VALU8 CM_CAN_CTS SENSORS 0 255 /end MEASUREMENT
/begin COMPU_METHOD CM_CAN_CTS Conversion for "CAN CTS" IDENTICAL %3.0 dl /end COMPU_METHOD
/begin MEASUREMENT CAN ATS "ATS CAN" VALUE 0x2007360E RL_VALU8 CM_CAN_ATS SENSORS 0 255 /end MEASUREMENT
/begin COMPU_METHOD CM_CAN_ATS Conversion for "CAN ATS" IDENTICAL %3.0 dl /end COMPU_METHOD
/begin MEASUREMENT CAN TPS "TPS CAN" VALUE 0x2007360A RL_VALU16 CM_CAN_TPS SENSORS 0 65535 /end MEASUREMENT
/begin COMPU_METHOD CM_CAN_TPS Conversion for "CAN TPS" IDENTICAL %5.0 dl /end COMPU_METHOD
/begin MEASUREMENT CAN PPS "PPS CAN" VALUE 0x2007360D RL_VALU8 CM_CAN_PPS SENSORS 0 255 /end MEASUREMENT
/begin COMPU_METHOD CM_CAN_PPS Conversion for "CAN PPS" IDENTICAL %3.0 dl /end COMPU_METHOD
/begin MEASUREMENT CAN VSS "VSS CAN" VALUE 0x200735FE RL_VALU16 CM_CAN_VSS SENSORS 0 65535 /end MEASUREMENT
/begin COMPU_METHOD CM_CAN_VSS Conversion for "CAN VSS" IDENTICAL %3.0 dl /end COMPU_METHOD
/begin MEASUREMENT CAN AFR "VSS AFR" VALUE 0x200735F8 RL_VALU16 CM_CAN_AFR SENSORS 0 65535 /end MEASUREMENT
/begin COMPU_METHOD CM_CAN_AFR Conversion for "CAN AFR" IDENTICAL %3.0 dl /end COMPU_METHOD
/begin MEASUREMENT TPS Sensor ADC "TPS Sensor ADC Counts" VALUE 0x200735C0 RL_VALU32 CM_TPS_SENSOR_ADC TPS 0 4095 /end MEASUREMENT
/begin COMPU_METHOD CM_TPS_SENSOR_ADC Conversion for "TPS Sensor ADC" IDENTICAL %5.3 dl /end COMPU_METHOD
/begin MEASUREMENT TPS Sensor Voltage "TPS Sensor Voltage" VALUE 0x200735A4 RL_VALU32 CM_TPS_SENSOR_VOLTAGE TPS 0 5 /end MEASUREMENT
/begin COMPU_METHOD CM_TPS_SENSOR_VOLTAGE Conversion for "TPS Sensor Voltage" LINEAR %5.3 V COEFFS_LINEAR 0.001 0 /end COMPU_METHOD
/begin MEASUREMENT Throttle Angle "Throttle Angle" VALUE 0x20073598 RL_VALU32 CM_THROTTLE_ANGLE TPS 0 90 /end MEASUREMENT
/begin COMPU_METHOD CM_THROTTLE_ANGLE Conversion for "Throttle Angle" LINEAR %3.1 degrees COEFFS_LINEAR 0.001 0 /end COMPU_METHOD
/begin MEASUREMENT TPS Movement Rate "Throttle Angle Movement" VALUE 0x20073580 RL_VALS32 CM_TPS_MOVEMENT_RATE TPS -1000 1000 /end MEASUREMENT
/begin COMPU_METHOD CM_TPS_MOVEMENT_RATE Conversion for "TPS Movement Rate" LINEAR %5.3 degrees/s COEFFS_LINEAR 0.001 0 /end COMPU_METHOD
/begin MEASUREMENT TPS Moving Counter "TPS Moving Counter" VALUE 0x20073588 RL_VALU32 CM_TPS_MOVING_COUNTER TPS 0 2000 /end MEASUREMENT
/begin COMPU_METHOD CM_TPS_MOVING_COUNTER Conversion for "TPS Moving Counter" IDENTICAL %4.0 dl /end COMPU_METHOD
/begin MEASUREMENT CAN TPS Move Neg Count "Throttle Angle Movement" VALUE 0x20073568 RL_VALU16 CM_CAN_TPS_MOVE_NEG_COUNT TPS 0 1000 /end MEASUREMENT
/begin COMPU_METHOD CM_CAN_TPS_MOVE_NEG_COUNT Conversion for "CAN TPS Move Neg Count" IDENTICAL %4.0 dl /end COMPU_METHOD
/begin MEASUREMENT CAN TPS Move Pos Count "Throttle Angle Movement" VALUE 0x200735AE RL_VALU16 CM_CAN_TPS_MOVE_POS_COUNT TPS 0 1000 /end MEASUREMENT
/begin COMPU_METHOD CM_CAN_TPS_MOVE_POS_COUNT Conversion for "CAN TPS Move Pos Count" IDENTICAL %4.0 dl /end COMPU_METHOD
/begin MEASUREMENT Moving TPS Enrichment "Throttle Enrichment" VALUE 0x200735A0 RL_VALU32 CM_MOVING_TPS_ENRICHMENT TPS 0 2000 /end MEASUREMENT
/begin COMPU_METHOD CM_MOVING_TPS_ENRICHMENT Conversion for "Moving TPS Enrichment" IDENTICAL %4.0 dl /end COMPU_METHOD
/begin MEASUREMENT Tip In Enrichment "Tip In Enrichment" VALUE 0x20073618 RL_VALU32 CM_TIP_IN_ENRICHMENT TPS 0 2000 /end MEASUREMENT
/begin COMPU_METHOD CM_TIP_IN_ENRICHMENT Conversion for "Tip In Enrichment" IDENTICAL %4.0 dl /end COMPU_METHOD
/begin MEASUREMENT TPS Transition Counter "TPS Transition Counter" VALUE 0x20073574 RL_VALU32 CM_TPS_TRANSITION_COUNTER TPS 0 2000 /end MEASUREMENT
/begin COMPU_METHOD CM_TPS_TRANSITION_COUNTER Conversion for "TPS Transition Counter" IDENTICAL %4.0 dl /end COMPU_METHOD
/begin CHARACTERISTIC AD RefH Voltage "AD Converter Reference High Voltage HTML=001.HTML" VALUE 0x20073630 RL_VALU32 CM_AD_REFH_VOLTAGE USERCAL 0 5 /end CHARACTERISTIC
/begin COMPU_METHOD CM_AD_REFH_VOLTAGE Conversion for "AD RefH Voltage" LINEAR %4.3 V COEFFS_LINEAR 0.001 0 /end COMPU_METHOD
/begin CHARACTERISTIC User Cal VRef 445 "TBC HTML=002.HTML" VALUE 0x20073634 RL_VALU32 CM_USER_CAL_VREF_445 USERCAL 0 5 /end CHARACTERISTIC
/begin COMPU_METHOD CM_USER_CAL_VREF_445 Conversion for "User Cal VRef 445" LINEAR %4.3 TBC COEFFS_LINEAR 0.001 0 /end COMPU_METHOD
/begin CHARACTERISTIC Cal VNernst Target "TBC HTML=003.HTML" VALUE 0x20073638 RL_VALU32 CM_CAL_VNERNST_TARGET USERCAL 0 5 /end CHARACTERISTIC
/begin COMPU_METHOD CM_CAL_VNERNST_TARGET Conversion for "Cal VNernst Target" LINEAR %4.3 TBC COEFFS_LINEAR 0.001 0 /end COMPU_METHOD
/begin CHARACTERISTIC Cal RNernst Ready "TBC HTML=004.HTML" VALUE 0x2007363C RL_VALU32 CM_CAL_RNERNST_READY USERCAL 0 5 /end CHARACTERISTIC
/begin COMPU_METHOD CM_CAL_RNERNST_READY Conversion for "Cal RNernst Ready" LINEAR %4.3 TBC COEFFS_LINEAR 0.001 0 /end COMPU_METHOD
/begin CHARACTERISTIC Uego Heater Rth "Uego Heater Resistance Threshold HTML=005.HTML" VALUE 0x20073640 RL_VALU32 CM_UEGO_HEATER_RTH USERCAL 0 10 /end CHARACTERISTIC
/begin COMPU_METHOD CM_UEGO_HEATER_RTH Conversion for "Uego Heater Rth" LINEAR %4.3 Ohms COEFFS_LINEAR 0.001 0 /end COMPU_METHOD
/begin CHARACTERISTIC Uego1 Current P Cal "Uego1 Current P Calibration (dimensionless) HTML=006.HTML" VALUE 0x20073644 RL_VALU32 CM_UEGO1_CURRENT_P_CAL USERCAL 0 5000000 /end CHARACTERISTIC
/begin COMPU_METHOD CM_UEGO1_CURRENT_P_CAL Conversion for "Uego1 Current P Cal" IDENTICAL %6.0 dl /end COMPU_METHOD
/begin CHARACTERISTIC Uego1 Current M Cal "Uego1 Current M Calibration (dimensionless) HTML=007.HTML" VALUE 0x20073648 RL_VALU32 CM_UEGO1_CURRENT_M_CAL USERCAL 0 5000000 /end CHARACTERISTIC
/begin COMPU_METHOD CM_UEGO1_CURRENT_M_CAL Conversion for "Uego1 Current M Cal" IDENTICAL %6.0 dl /end COMPU_METHOD
/begin CHARACTERISTIC Uego1 Offset Cal "Uego1 Offset Calibration (dimensionless) HTML=008.HTML" VALUE 0x2007364C RL_VALS32 CM_UEGO1_OFFSET_CAL USERCAL -5000000 5000000 /end CHARACTERISTIC
/begin COMPU_METHOD CM_UEGO1_OFFSET_CAL Conversion for "Uego1 Offset Cal" IDENTICAL %6.0 dl /end COMPU_METHOD
/begin AXIS_PTS Uego Pump Current Table_XAXIS "Uego Pump Current X Axis HTML=009.HTML" 0x20073650 RL_VALS32 Pump Current 1 CM_PUMP_CURRENT_1 17 -5000000 5000000 AXIS_PTS_REF Uego Pump Current Table_XAXIS /end AXIS_PTS
/begin CHARACTERISTIC Uego Pump Current Table "Uego Pump Current Curve HTML=010.HTML" CURVE 0x20073694 RL_VALU16 CM_UEGO_PUMP_CURRENT_TABLE USERCAL 0 5
 /begin AXIS_DESCR STD_AXIS Pump Current 1 CM_PUMP_CURRENT_1 17 0 0 AXIS_PTS_REF Uego Pump Current Table_XAXIS /end AXIS_DESCR
/end CHARACTERISTIC
/begin COMPU_METHOD CM_UEGO_PUMP_CURRENT_TABLE Conversion for "Uego Pump Current Table" LINEAR %4.3 dl COEFFS_LINEAR 0.001 0 /end COMPU_METHOD
/begin CHARACTERISTIC Uego1 Sensor Trim "Uego1 Sensor Trim HTML=011.HTML" VALUE 0x200736B6 RL_VALU8 CM_UEGO1_SENSOR_TRIM USERCAL 0 255 /end CHARACTERISTIC
/begin COMPU_METHOD CM_UEGO1_SENSOR_TRIM Conversion for "Uego1 Sensor Trim" IDENTICAL %3.0 dl /end COMPU_METHOD
/begin CHARACTERISTIC Uego1 Stoich Cal "Uego1 Stoich Cal HTML=012.HTML" VALUE 0x200736B8 RL_VALU32 CM_UEGO1_STOICH_CAL USERCAL 0 2000 /end CHARACTERISTIC
/begin COMPU_METHOD CM_UEGO1_STOICH_CAL Conversion for "Uego1 Stoich Cal" IDENTICAL %3.0 dl /end COMPU_METHOD
/begin CHARACTERISTIC User Cal Pump Deadband "TBC HTML=013.HTML" VALUE 0x200736BC RL_VALU8 CM_USER_CAL_PUMP_DEADBAND USERCAL 0 2000 /end CHARACTERISTIC
/begin COMPU_METHOD CM_USER_CAL_PUMP_DEADBAND Conversion for "User Cal Pump Deadband" IDENTICAL %3.0 dl /end COMPU_METHOD
/begin CHARACTERISTIC User Cal Free Air Points "TBC HTML=014.HTML" VALUE 0x200736BE RL_VALU16 CM_USER_CAL_FREE_AIR_POINTS USERCAL 0 2000 /end CHARACTERISTIC
/begin COMPU_METHOD CM_USER_CAL_FREE_AIR_POINTS Conversion for "User Cal Free Air Points" IDENTICAL %3.0 dl /end COMPU_METHOD
/begin CHARACTERISTIC UserHeaterAlarmCurrent "TBC HTML=015.HTML" VALUE 0x200736E4 RL_VALU32 CM_USERHEATERALARMCURRENT USERCAL 0 2000 /end CHARACTERISTIC
/begin COMPU_METHOD CM_USERHEATERALARMCURRENT Conversion for "UserHeaterAlarmCurrent" IDENTICAL %3.0 dl /end COMPU_METHOD
/begin CHARACTERISTIC Warm Up Delay "TBC HTML=016.HTML" VALUE 0x200736E8 RL_VALU8 CM_WARM_UP_DELAY USERCAL 0 2000 /end CHARACTERISTIC
/begin COMPU_METHOD CM_WARM_UP_DELAY Conversion for "Warm Up Delay" IDENTICAL %3.0 dl /end COMPU_METHOD
/begin CHARACTERISTIC Display Mode "TBC HTML=017.HTML" VALUE 0x200736E9 RL_VALU8 CM_DISPLAY_MODE USERCAL 0 2000 /end CHARACTERISTIC
/begin COMPU_METHOD CM_DISPLAY_MODE Conversion for "Display Mode" IDENTICAL %3.0 dl /end COMPU_METHOD
/begin CHARACTERISTIC Back Light Enable "TBC HTML=018.HTML" VALUE 0x200736EA RL_VALU8 CM_BACK_LIGHT_ENABLE USERCAL 0 2000 /end CHARACTERISTIC
/begin COMPU_METHOD CM_BACK_LIGHT_ENABLE Conversion for "Back Light Enable" IDENTICAL %3.0 ENUMERATION OFF=0 ON=1 /end COMPU_METHOD
/begin CHARACTERISTIC TPS Cal Min "TPS voltage at min throttle position or neutral ETC position HTML=019.HTML" VALUE 0x200736EC RL_VALU32 CM_TPS_CAL_MIN USERCAL 0 5000 /end CHARACTERISTIC
/begin COMPU_METHOD CM_TPS_CAL_MIN Conversion for "TPS Cal Min" LINEAR %3.2 V COEFFS_LINEAR 0.001 0 /end COMPU_METHOD
/begin CHARACTERISTIC TPS Cal Max "TPS voltage at maximum throttle position HTML=020.HTML" VALUE 0x200736F0 RL_VALU32 CM_TPS_CAL_MAX USERCAL 0 5000 /end CHARACTERISTIC
/begin COMPU_METHOD CM_TPS_CAL_MAX Conversion for "TPS Cal Max" LINEAR %3.2 V COEFFS_LINEAR 0.001 0 /end COMPU_METHOD
/begin AXIS_PTS AfmTF Table_XAXIS "Air Flow Meter calibration curve x-axis points array HTML=021.HTML" 0x200736F4 RL_VALU32 AFM Sensor Voltage CM_AFM_SENSOR_VOLTAGE 17 0 300000 AXIS_PTS_REF AfmTF Table_XAXIS /end AXIS_PTS
/begin CHARACTERISTIC AfmTF Table "ir Flow Meter calibration curve data points array HTML=022.HTML" CURVE 0x20073738 RL_VALU32 CM_AFMTF_TABLE USERCAL 0 400
 /begin AXIS_DESCR STD_AXIS AFM Sensor Voltage CM_AFM_SENSOR_VOLTAGE 17 0 0 AXIS_PTS_REF AfmTF Table_XAXIS /end AXIS_DESCR
/end CHARACTERISTIC
/begin COMPU_METHOD CM_AFMTF_TABLE Conversion for "AfmTF Table" LINEAR %4.3 g/s COEFFS_LINEAR 1E-06 0 /end COMPU_METHOD
/begin AXIS_PTS Inj Response Table_XAXIS "Injector response curve x-axis points array HTML=023.HTML" 0x2007377C RL_VALU32 Battery Voltage CM_BATTERY_VOLTAGE 17 0 20000 AXIS_PTS_REF Inj Response Table_XAXIS /end AXIS_PTS
/begin CHARACTERISTIC Inj Response Table "Injector response curve data points array HTML=024.HTML" CURVE 0x200737C0 RL_VALU16 CM_INJ_RESPONSE_TABLE USERCAL 0 3
 /begin AXIS_DESCR STD_AXIS Battery Voltage CM_BATTERY_VOLTAGE 17 0 0 AXIS_PTS_REF Inj Response Table_XAXIS /end AXIS_DESCR
/end CHARACTERISTIC
/begin COMPU_METHOD CM_INJ_RESPONSE_TABLE Conversion for "Inj Response Table" LINEAR %4.3 ms COEFFS_LINEAR 0.001 0 /end COMPU_METHOD
/begin AXIS_PTS Coolant Sensor Table_XAXIS "Coolant sensor calibration curve x-axis points array HTML=025.HTML" 0x200737E4 RL_VALU32 CTS Sensor Voltage CM_CTS_SENSOR_VOLTAGE 17 0 5 AXIS_PTS_REF Coolant Sensor Table_XAXIS /end AXIS_PTS
/begin CHARACTERISTIC Coolant Sensor Table "Coolant sensor calibration curve data points array HTML=026.HTML" CURVE 0x20073828 RL_VALS32 CM_COOLANT_SENSOR_TABLE USERCAL -40 200
 /begin AXIS_DESCR STD_AXIS CTS Sensor Voltage CM_CTS_SENSOR_VOLTAGE 17 0 0 AXIS_PTS_REF Coolant Sensor Table_XAXIS /end AXIS_DESCR
/end CHARACTERISTIC
/begin COMPU_METHOD CM_COOLANT_SENSOR_TABLE Conversion for "Coolant Sensor Table" LINEAR %4.3 degrees C COEFFS_LINEAR 0.001 0 /end COMPU_METHOD
/begin AXIS_PTS CTS Enrichment Table_XAXIS "CTS Enrichment X Axis HTML=027.HTML" 0x2007386C RL_VALS32 Coolant Temperature CM_COOLANT_TEMPERATURE 17 0 200 AXIS_PTS_REF CTS Enrichment Table_XAXIS /end AXIS_PTS
/begin CHARACTERISTIC CTS Enrichment Table "CTS Enrichment Curve HTML=028.HTML" CURVE 0x200738B0 RL_VALS32 CM_CTS_ENRICHMENT_TABLE USERCAL -1 3
 /begin AXIS_DESCR STD_AXIS Coolant Temperature CM_COOLANT_TEMPERATURE 17 0 0 AXIS_PTS_REF CTS Enrichment Table_XAXIS /end AXIS_DESCR
/end CHARACTERISTIC
/begin COMPU_METHOD CM_CTS_ENRICHMENT_TABLE Conversion for "CTS Enrichment Table" LINEAR %4.3 % COEFFS_LINEAR 0.001 0 /end COMPU_METHOD
/begin AXIS_PTS TAFR Map_XAXIS "VE MAP Y Axis HTML=029.HTML" 0x200738F4 RL_VALU32 Engine Speed Raw CM_ENGINE_SPEED_RAW 17 0 8000 AXIS_PTS_REF TAFR Map_XAXIS /end AXIS_PTS
/begin AXIS_PTS TAFR Map_YAXIS "VE MAP X Axis HTML=030.HTML" 0x20073938 RL_VALU32 MAP kPa CM_MAP_KPA 17 0 110000 AXIS_PTS_REF TAFR Map_YAXIS /end AXIS_PTS
/begin CHARACTERISTIC TAFR Map "TAFR Map HTML=031.HTML" MAP 0x2007397C RL_VALU16 CM_TAFR_MAP USERCAL 0 20
 /begin AXIS_DESCR STD_AXIS Engine Speed Raw CM_ENGINE_SPEED_RAW 17 0 0 AXIS_PTS_REF TAFR Map_XAXIS /end AXIS_DESCR
 /begin AXIS_DESCR STD_AXIS Throttle Angle CM_THROTTLE_ANGLE 17 0 0 AXIS_PTS_REF TAFR Map_YAXIS /end AXIS_DESCR
/end CHARACTERISTIC
/begin COMPU_METHOD CM_TAFR_MAP Conversion for "TAFR Map" LINEAR %4.3 dl COEFFS_LINEAR 0.01 0 /end COMPU_METHOD
/begin AXIS_PTS Timing Map_XAXIS "VE MAP Y Axis HTML=032.HTML" 0x20073BC0 RL_VALU32 Engine Speed Raw CM_ENGINE_SPEED_RAW 17 0 8000 AXIS_PTS_REF Timing Map_XAXIS /end AXIS_PTS
/begin AXIS_PTS Timing Map_YAXIS "VE MAP X Axis HTML=033.HTML" 0x20073C04 RL_VALU32 MAP kPa CM_MAP_KPA 17 0 110000 AXIS_PTS_REF Timing Map_YAXIS /end AXIS_PTS
/begin CHARACTERISTIC Timing Map "Timing Map HTML=034.HTML" MAP 0x20073C48 RL_VALU16 CM_TIMING_MAP USERCAL 0 50
 /begin AXIS_DESCR STD_AXIS Engine Speed Raw CM_ENGINE_SPEED_RAW 17 0 0 AXIS_PTS_REF Timing Map_XAXIS /end AXIS_DESCR
 /begin AXIS_DESCR STD_AXIS MAP kPa CM_MAP_KPA 17 0 0 AXIS_PTS_REF Timing Map_YAXIS /end AXIS_DESCR
/end CHARACTERISTIC
/begin COMPU_METHOD CM_TIMING_MAP Conversion for "Timing Map" LINEAR %3.1 Degrees COEFFS_LINEAR 0.1 0 /end COMPU_METHOD
/begin AXIS_PTS VE Map_XAXIS "VE MAP Y Axis HTML=035.HTML" 0x20073E8C RL_VALU32 Engine Speed Raw CM_ENGINE_SPEED_RAW 17 0 8000 AXIS_PTS_REF VE Map_XAXIS /end AXIS_PTS
/begin AXIS_PTS VE Map_YAXIS "VE MAP X Axis HTML=036.HTML" 0x20073ED0 RL_VALU32 MAP kPa CM_MAP_KPA 17 0 110000 AXIS_PTS_REF VE Map_YAXIS /end AXIS_PTS
/begin CHARACTERISTIC VE Map "VE Map HTML=037.HTML" MAP 0x20073F14 RL_VALU16 CM_VE_MAP USERCAL 0 1.5
 /begin AXIS_DESCR STD_AXIS Engine Speed Raw CM_ENGINE_SPEED_RAW 17 0 0 AXIS_PTS_REF VE Map_XAXIS /end AXIS_DESCR
 /begin AXIS_DESCR STD_AXIS MAP kPa CM_MAP_KPA 17 0 0 AXIS_PTS_REF VE Map_YAXIS /end AXIS_DESCR
/end CHARACTERISTIC
/begin COMPU_METHOD CM_VE_MAP Conversion for "VE Map" LINEAR %4.3 dl COEFFS_LINEAR 0.001 0 /end COMPU_METHOD
/begin AXIS_PTS CTS Start Enrichment Table_XAXIS "CTS Start Enrichment X Axis HTML=038.HTML" 0x20074158 RL_VALS32 Coolant Temperature CM_COOLANT_TEMPERATURE 17 0 200 AXIS_PTS_REF CTS Start Enrichment Table_XAXIS /end AXIS_PTS
/begin CHARACTERISTIC CTS Start Enrichment Table "CTS Start Enrichment Curve HTML=039.HTML" CURVE 0x2007419C RL_VALS32 CM_CTS_START_ENRICHMENT_TABLE USERCAL 0 4
 /begin AXIS_DESCR STD_AXIS Coolant Temperature CM_COOLANT_TEMPERATURE 17 0 0 AXIS_PTS_REF CTS Start Enrichment Table_XAXIS /end AXIS_DESCR
/end CHARACTERISTIC
/begin COMPU_METHOD CM_CTS_START_ENRICHMENT_TABLE Conversion for "CTS Start Enrichment Table" LINEAR %4.3 % COEFFS_LINEAR 0.001 0 /end COMPU_METHOD
/begin AXIS_PTS CTS Post Start Enrichment Table_XAXIS "CTS Post Start Enrichment X Axis HTML=040.HTML" 0x200741E0 RL_VALS32 Coolant Temperature CM_COOLANT_TEMPERATURE 17 0 200 AXIS_PTS_REF CTS Post Start Enrichment Table_XAXIS /end AXIS_PTS
/begin CHARACTERISTIC CTS Post Start Enrichment Table "CTS Post Start Enrichment Curve HTML=041.HTML" CURVE 0x20074224 RL_VALS32 CM_CTS_POST_START_ENRICHMENT_TABLE USERCAL 0 4
 /begin AXIS_DESCR STD_AXIS Coolant Temperature CM_COOLANT_TEMPERATURE 17 0 0 AXIS_PTS_REF CTS Post Start Enrichment Table_XAXIS /end AXIS_DESCR
/end CHARACTERISTIC
/begin COMPU_METHOD CM_CTS_POST_START_ENRICHMENT_TABLE Conversion for "CTS Post Start Enrichment Table" LINEAR %4.3 % COEFFS_LINEAR 0.001 0 /end COMPU_METHOD
/begin AXIS_PTS Cranking Airflow Table_XAXIS "Cranking Airflow X Axis HTML=042.HTML" 0x20074268 RL_VALU32 Engine Speed Raw CM_ENGINE_SPEED_RAW 17 0 8000 AXIS_PTS_REF Cranking Airflow Table_XAXIS /end AXIS_PTS
/begin CHARACTERISTIC Cranking Airflow Table "Cranking Airflow Curve HTML=043.HTML" CURVE 0x200742AC RL_VALU16 CM_CRANKING_AIRFLOW_TABLE USERCAL 0 65.535
 /begin AXIS_DESCR STD_AXIS Engine Speed Raw CM_ENGINE_SPEED_RAW 17 0 0 AXIS_PTS_REF Cranking Airflow Table_XAXIS /end AXIS_DESCR
/end CHARACTERISTIC
/begin COMPU_METHOD CM_CRANKING_AIRFLOW_TABLE Conversion for "Cranking Airflow Table" LINEAR %4.3 g/s COEFFS_LINEAR 0.001 0 /end COMPU_METHOD
/begin AXIS_PTS Dwell Table_XAXIS "Dwell X Axis HTML=044.HTML" 0x200742D0 RL_VALU32 Battery Voltage CM_BATTERY_VOLTAGE 17 0 20000 AXIS_PTS_REF Dwell Table_XAXIS /end AXIS_PTS
/begin CHARACTERISTIC Dwell Table "Dwell Curve HTML=045.HTML" CURVE 0x20074314 RL_VALU16 CM_DWELL_TABLE USERCAL 0 10
 /begin AXIS_DESCR STD_AXIS Battery Voltage CM_BATTERY_VOLTAGE 17 0 0 AXIS_PTS_REF Dwell Table_XAXIS /end AXIS_DESCR
/end CHARACTERISTIC
/begin COMPU_METHOD CM_DWELL_TABLE Conversion for "Dwell Table" LINEAR %4.3 ms COEFFS_LINEAR 0.001 0 /end COMPU_METHOD
/begin AXIS_PTS ATS Fuel Correction Table_XAXIS "ATS Fuel Correction X Axis HTML=046.HTML" 0x20074338 RL_VALS32 Air Temperature CM_AIR_TEMPERATURE 17 0 20 AXIS_PTS_REF ATS Fuel Correction Table_XAXIS /end AXIS_PTS
/begin CHARACTERISTIC ATS Fuel Correction Table "ATS Fuel Correction Curve HTML=047.HTML" CURVE 0x2007437C RL_VALU16 CM_ATS_FUEL_CORRECTION_TABLE USERCAL 0 2
 /begin AXIS_DESCR STD_AXIS Air Temperature CM_AIR_TEMPERATURE 17 0 0 AXIS_PTS_REF ATS Fuel Correction Table_XAXIS /end AXIS_DESCR
/end CHARACTERISTIC
/begin COMPU_METHOD CM_ATS_FUEL_CORRECTION_TABLE Conversion for "ATS Fuel Correction Table" LINEAR %4.3 % COEFFS_LINEAR 0.001 0 /end COMPU_METHOD
/begin AXIS_PTS TPS Movement Correction Table_XAXIS "TPS Movement Correction X Axis HTML=048.HTML" 0x200743A0 RL_VALU32 TPS Movement Rate CM_TPS_MOVEMENT_RATE 17 -450 450 AXIS_PTS_REF TPS Movement Correction Table_XAXIS /end AXIS_PTS
/begin CHARACTERISTIC TPS Movement Correction Table "TPS Movement Correction Curve HTML=049.HTML" CURVE 0x200743E4 RL_VALU16 CM_TPS_MOVEMENT_CORRECTION_TABLE USERCAL 0 2
 /begin AXIS_DESCR STD_AXIS TPS Movement Rate CM_TPS_MOVEMENT_RATE 17 0 0 AXIS_PTS_REF TPS Movement Correction Table_XAXIS /end AXIS_DESCR
/end CHARACTERISTIC
/begin COMPU_METHOD CM_TPS_MOVEMENT_CORRECTION_TABLE Conversion for "TPS Movement Correction Table" LINEAR %6.3 % COEFFS_LINEAR 0.001 0 /end COMPU_METHOD
/begin AXIS_PTS Injection Phasing Table_XAXIS "Injection Phasing X Axis HTML=050.HTML" 0x20074408 RL_VALU32 Engine Speed Raw CM_ENGINE_SPEED_RAW 17 0 20000 AXIS_PTS_REF Injection Phasing Table_XAXIS /end AXIS_PTS
/begin CHARACTERISTIC Injection Phasing Table "Injection Phasing Curve HTML=281.HTML" CURVE 0x2007444C RL_VALU16 CM_INJECTION_PHASING_TABLE USERCAL 0 20
 /begin AXIS_DESCR STD_AXIS Engine Speed Raw CM_ENGINE_SPEED_RAW 17 0 0 AXIS_PTS_REF Injection Phasing Table_XAXIS /end AXIS_DESCR
/end CHARACTERISTIC
/begin COMPU_METHOD CM_INJECTION_PHASING_TABLE Conversion for "Injection Phasing Table" LINEAR %4.3 ms COEFFS_LINEAR 0.001 0 /end COMPU_METHOD
/begin AXIS_PTS CTS Timing Correction Table_XAXIS "CTS Timing Correction X Axis HTML=051.HTML" 0x20074470 RL_VALS32 Coolant Temperature CM_COOLANT_TEMPERATURE 17 0 200 AXIS_PTS_REF CTS Timing Correction Table_XAXIS /end AXIS_PTS
/begin CHARACTERISTIC CTS Timing Correction Table "CTS Timing Correction Curve HTML=052.HTML" CURVE 0x200744B4 RL_VALS16 CM_CTS_TIMING_CORRECTION_TABLE USERCAL -10 10
 /begin AXIS_DESCR STD_AXIS Coolant Temperature CM_COOLANT_TEMPERATURE 17 0 0 AXIS_PTS_REF CTS Timing Correction Table_XAXIS /end AXIS_DESCR
/end CHARACTERISTIC
/begin COMPU_METHOD CM_CTS_TIMING_CORRECTION_TABLE Conversion for "CTS Timing Correction Table" LINEAR %4.3 Degrees COEFFS_LINEAR 0.1 0 /end COMPU_METHOD
/begin AXIS_PTS ATS Timing Correction Table_XAXIS "ATS Timing Correction X Axis HTML=053.HTML" 0x200744D8 RL_VALS32 Air Temperature CM_AIR_TEMPERATURE 17 0 200 AXIS_PTS_REF ATS Timing Correction Table_XAXIS /end AXIS_PTS
/begin CHARACTERISTIC ATS Timing Correction Table "ATS Timing Correction Curve HTML=054.HTML" CURVE 0x2007451C RL_VALS16 CM_ATS_TIMING_CORRECTION_TABLE USERCAL -10 10
 /begin AXIS_DESCR STD_AXIS Air Temperature CM_AIR_TEMPERATURE 17 0 0 AXIS_PTS_REF ATS Timing Correction Table_XAXIS /end AXIS_DESCR
/end CHARACTERISTIC
/begin COMPU_METHOD CM_ATS_TIMING_CORRECTION_TABLE Conversion for "ATS Timing Correction Table" LINEAR %4.3 Degrees COEFFS_LINEAR 0.1 0 /end COMPU_METHOD
/begin AXIS_PTS ISC Target Table_XAXIS "ISC Target X Axis HTML=055.HTML" 0x20074540 RL_VALS32 Coolant Temperature CM_COOLANT_TEMPERATURE 17 0 200 AXIS_PTS_REF ISC Target Table_XAXIS /end AXIS_PTS
/begin CHARACTERISTIC ISC Target Table "ISC Target Curve HTML=056.HTML" CURVE 0x20074584 RL_VALU16 CM_ISC_TARGET_TABLE USERCAL 0 2000
 /begin AXIS_DESCR STD_AXIS Coolant Temperature CM_COOLANT_TEMPERATURE 17 0 0 AXIS_PTS_REF ISC Target Table_XAXIS /end AXIS_DESCR
/end CHARACTERISTIC
/begin COMPU_METHOD CM_ISC_TARGET_TABLE Conversion for "ISC Target Table" IDENTICAL %4.3 RPM /end COMPU_METHOD
/begin CHARACTERISTIC User Stepper Close Table "TBC HTML=057.HTML" VALUE 0x200745A6 RL_VALU32 CM_USER_STEPPER_CLOSE_TABLE USERCAL 0 2000 /end CHARACTERISTIC
/begin COMPU_METHOD CM_USER_STEPPER_CLOSE_TABLE Conversion for "User Stepper Close Table" IDENTICAL %3.0 dl /end COMPU_METHOD
/begin CHARACTERISTIC User Stepper Open Table "TBC HTML=058.HTML" VALUE 0x200745AA RL_VALU32 CM_USER_STEPPER_OPEN_TABLE USERCAL 0 2000 /end CHARACTERISTIC
/begin COMPU_METHOD CM_USER_STEPPER_OPEN_TABLE Conversion for "User Stepper Open Table" IDENTICAL %3.0 dl /end COMPU_METHOD
/begin CHARACTERISTIC User Stepper Home Steps "TBC HTML=059.HTML" VALUE 0x200745B0 RL_VALU32 CM_USER_STEPPER_HOME_STEPS USERCAL 0 2000 /end CHARACTERISTIC
/begin COMPU_METHOD CM_USER_STEPPER_HOME_STEPS Conversion for "User Stepper Home Steps" IDENTICAL %3.0 dl /end COMPU_METHOD
/begin BLOB Primary Trigger Table "Primary Trigger Tooth Setup HTML=060.HTML" BLOB 0x200745B4 RL_VALU16 USERCAL 1 65535 80 /end BLOB
/begin BLOB Secondary Trigger Table "Secondary Trigger Tooth Setup HTML=061.HTML" BLOB 0x20074654 RL_VALU16 USERCAL 1 65535 40 /end BLOB
/begin BLOB Sync Points Table "Syncronisation Points Setup HTML=062.HTML" BLOB 0x200746A4 RL_VALU16 USERCAL 1 65535 36 /end BLOB
/begin CHARACTERISTIC Primary Edge Setup "Primary Edge Setup" VALUE 0x200746EC RL_VALU8 CM_PRIMARY_EDGE_SETUP USERCAL 0 255 /end CHARACTERISTIC
/begin COMPU_METHOD CM_PRIMARY_EDGE_SETUP Conversion for "Primary Edge Setup" TAB_VERB %5.0 ENUM COMPU_TAB_REF CM_TAB_VERB_PRIMARY_EDGE_SETUP /end COMPU_METHOD
/begin COMPU_TAB_RANGE CM_TAB_VERB_PRIMARY_EDGE_SETUP "  " 3 0 RISING 1 FALLING 2 ANY DEFAULT_VALUE AUTO /end COMPU_TAB_RANGE
/begin CHARACTERISTIC Secondary Edge Setup "Secondary Edge Setup HTML=064.HTML" VALUE 0x200746ED RL_VALU8 CM_SECONDARY_EDGE_SETUP USERCAL 0 255 /end CHARACTERISTIC
/begin COMPU_METHOD CM_SECONDARY_EDGE_SETUP Conversion for "Secondary Edge Setup" TAB_VERB %5.0 ENUM COMPU_TAB_REF CM_TAB_VERB_SECONDARY_EDGE_SETUP /end COMPU_METHOD
/begin COMPU_TAB_RANGE CM_TAB_VERB_SECONDARY_EDGE_SETUP "  " 3 0 RISING 1 FALLING 2 ANY DEFAULT_VALUE AUTO /end COMPU_TAB_RANGE
/begin CHARACTERISTIC Primary VR Enable "Primary VR Circuit Enable HTML=065.HTML" VALUE 0x200746EE RL_VALU8 CM_PRIMARY_VR_ENABLE USERCAL 0 255 /end CHARACTERISTIC
/begin COMPU_METHOD CM_PRIMARY_VR_ENABLE Conversion for "Primary VR Enable" TAB_VERB %5.0 ENUM COMPU_TAB_REF CM_TAB_VERB_PRIMARY_VR_ENABLE /end COMPU_METHOD
/begin COMPU_TAB_RANGE CM_TAB_VERB_PRIMARY_VR_ENABLE "  " 2 0 OFF 1 ON DEFAULT_VALUE AUTO /end COMPU_TAB_RANGE
/begin CHARACTERISTIC Secondary VR Enable "Secondary VR Circuit Enable HTML=066.HTML" VALUE 0x200746EF RL_VALU8 CM_SECONDARY_VR_ENABLE USERCAL 0 255 /end CHARACTERISTIC
/begin COMPU_METHOD CM_SECONDARY_VR_ENABLE Conversion for "Secondary VR Enable" TAB_VERB %5.0 ENUM COMPU_TAB_REF CM_TAB_VERB_SECONDARY_VR_ENABLE /end COMPU_METHOD
/begin COMPU_TAB_RANGE CM_TAB_VERB_SECONDARY_VR_ENABLE "  " 2 0 OFF 1 ON DEFAULT_VALUE AUTO /end COMPU_TAB_RANGE
/begin CHARACTERISTIC First Edge Rising Primary "First Edge Rising Primary HTML=067.HTML" VALUE 0x200746F0 RL_VALU8 CM_FIRST_EDGE_RISING_PRIMARY USERCAL 0 255 /end CHARACTERISTIC
/begin COMPU_METHOD CM_FIRST_EDGE_RISING_PRIMARY Conversion for "First Edge Rising Primary" TAB_VERB %3.0 ENUM COMPU_TAB_REF CM_TAB_VERB_FIRST_EDGE_RISING_PRIMARY /end COMPU_METHOD
/begin COMPU_TAB_RANGE CM_TAB_VERB_FIRST_EDGE_RISING_PRIMARY "  " 2 0 FALSE 1 TRUE DEFAULT_VALUE AUTO /end COMPU_TAB_RANGE
/begin CHARACTERISTIC First Edge Rising Secondary "First Edge Rising Secondary HTML=068.HTML" VALUE 0x200746F1 RL_VALU8 CM_FIRST_EDGE_RISING_SECONDARY USERCAL 0 255 /end CHARACTERISTIC
/begin COMPU_METHOD CM_FIRST_EDGE_RISING_SECONDARY Conversion for "First Edge Rising Secondary" TAB_VERB %3.0 ENUM COMPU_TAB_REF CM_TAB_VERB_FIRST_EDGE_RISING_SECONDARY /end COMPU_METHOD
/begin COMPU_TAB_RANGE CM_TAB_VERB_FIRST_EDGE_RISING_SECONDARY "  " 2 0 FALSE 1 TRUE DEFAULT_VALUE AUTO /end COMPU_TAB_RANGE
/begin CHARACTERISTIC Injection Sequence AE "TBC HTML=069.HTML" VALUE 0x200746F4 RL_VALU32 CM_INJECTION_SEQUENCE_AE USERCAL 0 65535 /end CHARACTERISTIC
/begin COMPU_METHOD CM_INJECTION_SEQUENCE_AE Conversion for "Injection Sequence AE" TAB_VERB %3.0 ENUM COMPU_TAB_REF CM_TAB_VERB_INJECTION_SEQUENCE_AE /end COMPU_METHOD
/begin COMPU_TAB_RANGE CM_TAB_VERB_INJECTION_SEQUENCE_AE "  " 8 4 BATCH_POS1st 261 BATCH_POS2nd 518 BATCH_POS3rd 775 BATCH_POS4th 65280 SEQ_POS3rd 65282 SEQ_POS4th 65284 SEQ_POS1st 65286 SEQ_POS2nd DEFAULT_VALUE AUTO /end COMPU_TAB_RANGE
/begin CHARACTERISTIC Injection Sequence BF "TBC HTML=070.HTML" VALUE 0x200746F8 RL_VALU32 CM_INJECTION_SEQUENCE_BF USERCAL 0 65535 /end CHARACTERISTIC
/begin COMPU_METHOD CM_INJECTION_SEQUENCE_BF Conversion for "Injection Sequence BF" TAB_VERB %3.0 ENUM COMPU_TAB_REF CM_TAB_VERB_INJECTION_SEQUENCE_BF /end COMPU_METHOD
/begin COMPU_TAB_RANGE CM_TAB_VERB_INJECTION_SEQUENCE_BF "  " 8 4 BATCH_POS1st 261 BATCH_POS2nd 518 BATCH_POS3rd 775 BATCH_POS4th 65280 SEQ_POS3rd 65282 SEQ_POS4th 65284 SEQ_POS1st 65286 SEQ_POS2nd DEFAULT_VALUE AUTO /end COMPU_TAB_RANGE
/begin CHARACTERISTIC Injection Sequence CG "TBC HTML=071.HTML" VALUE 0x200746FC RL_VALU32 CM_INJECTION_SEQUENCE_CG USERCAL 0 65535 /end CHARACTERISTIC
/begin COMPU_METHOD CM_INJECTION_SEQUENCE_CG Conversion for "Injection Sequence CG" TAB_VERB %3.0 ENUM COMPU_TAB_REF CM_TAB_VERB_INJECTION_SEQUENCE_CG /end COMPU_METHOD
/begin COMPU_TAB_RANGE CM_TAB_VERB_INJECTION_SEQUENCE_CG "  " 8 4 BATCH_POS1st 261 BATCH_POS2nd 518 BATCH_POS3rd 775 BATCH_POS4th 65280 SEQ_POS3rd 65282 SEQ_POS4th 65284 SEQ_POS1st 65286 SEQ_POS2nd DEFAULT_VALUE AUTO /end COMPU_TAB_RANGE
/begin CHARACTERISTIC Injection Sequence DH "TBC HTML=072.HTML" VALUE 0x20074700 RL_VALU32 CM_INJECTION_SEQUENCE_DH USERCAL 0 65535 /end CHARACTERISTIC
/begin COMPU_METHOD CM_INJECTION_SEQUENCE_DH Conversion for "Injection Sequence DH" TAB_VERB %3.0 ENUM COMPU_TAB_REF CM_TAB_VERB_INJECTION_SEQUENCE_DH /end COMPU_METHOD
/begin COMPU_TAB_RANGE CM_TAB_VERB_INJECTION_SEQUENCE_DH "  " 8 4 BATCH_POS1st 261 BATCH_POS2nd 518 BATCH_POS3rd 775 BATCH_POS4th 65280 SEQ_POS3rd 65282 SEQ_POS4th 65284 SEQ_POS1st 65286 SEQ_POS2nd DEFAULT_VALUE AUTO /end COMPU_TAB_RANGE
/begin CHARACTERISTIC Ignition Sequence AE "TBC HTML=073.HTML" VALUE 0x20074704 RL_VALU32 CM_IGNITION_SEQUENCE_AE USERCAL 0 65535 /end CHARACTERISTIC
/begin COMPU_METHOD CM_IGNITION_SEQUENCE_AE Conversion for "Ignition Sequence AE" TAB_VERB %3.0 ENUM COMPU_TAB_REF CM_TAB_VERB_IGNITION_SEQUENCE_AE /end COMPU_METHOD
/begin COMPU_TAB_RANGE CM_TAB_VERB_IGNITION_SEQUENCE_AE "  " 8 4 WASTED_POS1st 261 WASTED_POS2nd 518 WASTED_POS3rd 775 WASTED_POS4th 65280 SEQ_POS1st 65282 SEQ_POS2nd 65284 SEQ_POS3rd 65286 SEQ_POS4th DEFAULT_VALUE AUTO /end COMPU_TAB_RANGE
/begin CHARACTERISTIC Ignition Sequence BF "TBC HTML=074.HTML" VALUE 0x20074708 RL_VALU32 CM_IGNITION_SEQUENCE_BF USERCAL 0 65535 /end CHARACTERISTIC
/begin COMPU_METHOD CM_IGNITION_SEQUENCE_BF Conversion for "Ignition Sequence BF" TAB_VERB %3.0 ENUM COMPU_TAB_REF CM_TAB_VERB_IGNITION_SEQUENCE_BF /end COMPU_METHOD
/begin COMPU_TAB_RANGE CM_TAB_VERB_IGNITION_SEQUENCE_BF "  " 8 4 WASTED_POS1st 261 WASTED_POS2nd 518 WASTED_POS3rd 775 WASTED_POS4th 65280 SEQ_POS1st 65282 SEQ_POS2nd 65284 SEQ_POS3rd 65286 SEQ_POS4th DEFAULT_VALUE AUTO /end COMPU_TAB_RANGE
/begin CHARACTERISTIC Ignition Sequence CG "TBC HTML=075.HTML" VALUE 0x2007470C RL_VALU32 CM_IGNITION_SEQUENCE_CG USERCAL 0 65535 /end CHARACTERISTIC
/begin COMPU_METHOD CM_IGNITION_SEQUENCE_CG Conversion for "Ignition Sequence CG" TAB_VERB %3.0 ENUM COMPU_TAB_REF CM_TAB_VERB_IGNITION_SEQUENCE_CG /end COMPU_METHOD
/begin COMPU_TAB_RANGE CM_TAB_VERB_IGNITION_SEQUENCE_CG "  " 8 4 WASTED_POS1st 261 WASTED_POS2nd 518 WASTED_POS3rd 775 WASTED_POS4th 65280 SEQ_POS1st 65282 SEQ_POS2nd 65284 SEQ_POS3rd 65286 SEQ_POS4th DEFAULT_VALUE AUTO /end COMPU_TAB_RANGE
/begin CHARACTERISTIC Ignition Sequence DH "TBC HTML=076.HTML" VALUE 0x20074710 RL_VALU32 CM_IGNITION_SEQUENCE_DH USERCAL 0 65535 /end CHARACTERISTIC
/begin COMPU_METHOD CM_IGNITION_SEQUENCE_DH Conversion for "Ignition Sequence DH" TAB_VERB %3.0 ENUM COMPU_TAB_REF CM_TAB_VERB_IGNITION_SEQUENCE_DH /end COMPU_METHOD
/begin COMPU_TAB_RANGE CM_TAB_VERB_IGNITION_SEQUENCE_DH "  " 8 4 WASTED_POS1st 261 WASTED_POS2nd 518 WASTED_POS3rd 775 WASTED_POS4th 65280 SEQ_POS1st 65282 SEQ_POS2nd 65284 SEQ_POS3rd 65286 SEQ_POS4th DEFAULT_VALUE AUTO /end COMPU_TAB_RANGE
/begin CHARACTERISTIC Simple Cam Sync Source "TBC HTML=077.HTML" VALUE 0x20074714 RL_VALU8 CM_SIMPLE_CAM_SYNC_SOURCE USERCAL 0 2000 /end CHARACTERISTIC
/begin COMPU_METHOD CM_SIMPLE_CAM_SYNC_SOURCE Conversion for "Simple Cam Sync Source" TAB_VERB %3.0 ENUM COMPU_TAB_REF CM_TAB_VERB_SIMPLE_CAM_SYNC_SOURCE /end COMPU_METHOD
/begin COMPU_TAB_RANGE CM_TAB_VERB_SIMPLE_CAM_SYNC_SOURCE "  " 15 0 EH_IO_ADD1 1 EH_IO_ADD2 2 EH_IO_ADD3 3 EH_IO_ADD4 4 EH_IO_ADD5 5 EH_IO_ADD6 6 EH_IO_ADD7 7 EH_IO_ADD8 8 EH_IO_ADD9 9 EH_IO_ADD10 10 EH_IO_ADD11 11 EH_IO_ADD12 46 EH_IO_IO52 48 EH_IO_IIC1_SCL 49 EH_IO_IIC1_SDA DEFAULT_VALUE AUTO /end COMPU_TAB_RANGE
/begin CHARACTERISTIC Cam Sync High Late "TBC HTML=078.HTML" VALUE 0x20074715 RL_VALU8 CM_CAM_SYNC_HIGH_LATE USERCAL 0 2000 /end CHARACTERISTIC
/begin COMPU_METHOD CM_CAM_SYNC_HIGH_LATE Conversion for "Cam Sync High Late" TAB_VERB %3.0 ENUM COMPU_TAB_REF CM_TAB_VERB_CAM_SYNC_HIGH_LATE /end COMPU_METHOD
/begin COMPU_TAB_RANGE CM_TAB_VERB_CAM_SYNC_HIGH_LATE "  " 2 0 FALSE 1 TRUE DEFAULT_VALUE AUTO /end COMPU_TAB_RANGE
/begin CHARACTERISTIC Cam Sync Sample Tooth Count "TBC HTML=079.HTML" VALUE 0x20074718 RL_VALU32 CM_CAM_SYNC_SAMPLE_TOOTH_COUNT USERCAL 0 2000 /end CHARACTERISTIC
/begin COMPU_METHOD CM_CAM_SYNC_SAMPLE_TOOTH_COUNT Conversion for "Cam Sync Sample Tooth Count" IDENTICAL %3.0 dl /end COMPU_METHOD
/begin CHARACTERISTIC Manifold Volume "Manifold Volume CC HTML=080.HTML" VALUE 0x2007471C RL_VALU16 CM_MANIFOLD_VOLUME USERCAL 0 65535 /end CHARACTERISTIC
/begin COMPU_METHOD CM_MANIFOLD_VOLUME Conversion for "Manifold Volume" IDENTICAL %5.0 cc /end COMPU_METHOD
/begin CHARACTERISTIC Cyl Count "TBC HTML=081.HTML" VALUE 0x2007471E RL_VALU8 CM_CYL_COUNT USERCAL 0 2000 /end CHARACTERISTIC
/begin COMPU_METHOD CM_CYL_COUNT Conversion for "Cyl Count" IDENTICAL %3.0 dl /end COMPU_METHOD
/begin CHARACTERISTIC Injector Flow Rate "TBC HTML=082.HTML" VALUE 0x20074720 RL_VALU32 CM_INJECTOR_FLOW_RATE USERCAL 0 20000 /end CHARACTERISTIC
/begin COMPU_METHOD CM_INJECTOR_FLOW_RATE Conversion for "Injector Flow Rate" IDENTICAL %3.0 dl /end COMPU_METHOD
/begin AXIS_PTS Airflow Map_XAXIS "Airflow MAP Y Axis HTML=083.HTML" 0x20074724 RL_VALU32 Engine Speed Raw CM_ENGINE_SPEED_RAW 11 0 8000 AXIS_PTS_REF Airflow Map_XAXIS /end AXIS_PTS
/begin AXIS_PTS Airflow Map_YAXIS "Airflow MAP X Axis HTML=084.HTML" 0x20074750 RL_VALU32 Throttle Angle CM_THROTTLE_ANGLE 11 0 90000 AXIS_PTS_REF Airflow Map_YAXIS /end AXIS_PTS
/begin CHARACTERISTIC Airflow Map "Airflow Map HTML=085.HTML" MAP 0x2007477C RL_VALU32 CM_AIRFLOW_MAP USERCAL 0 150
 /begin AXIS_DESCR STD_AXIS Engine Speed Raw CM_ENGINE_SPEED_RAW 11 0 0 AXIS_PTS_REF Airflow Map_XAXIS /end AXIS_DESCR
 /begin AXIS_DESCR STD_AXIS Throttle Angle CM_THROTTLE_ANGLE 11 0 0 AXIS_PTS_REF Airflow Map_YAXIS /end AXIS_DESCR
/end CHARACTERISTIC
/begin COMPU_METHOD CM_AIRFLOW_MAP Conversion for "Airflow Map" LINEAR %9.6 g/s COEFFS_LINEAR 1E-06 0 /end COMPU_METHOD
/begin CHARACTERISTIC Manifold Time Constant Cal "Manifold Time Constant Cal HTML=086.HTML" VALUE 0x20074960 RL_VALU8 CM_MANIFOLD_TIME_CONSTANT_CAL USERCAL 0 255 /end CHARACTERISTIC
/begin COMPU_METHOD CM_MANIFOLD_TIME_CONSTANT_CAL Conversion for "Manifold Time Constant Cal" IDENTICAL %3.0 dl /end COMPU_METHOD
/begin CHARACTERISTIC Airflow Transient Enable "Airflow Transients Enable HTML=087.HTML" VALUE 0x20074961 RL_VALU8 CM_AIRFLOW_TRANSIENT_ENABLE USERCAL 0 1 /end CHARACTERISTIC
/begin COMPU_METHOD CM_AIRFLOW_TRANSIENT_ENABLE Conversion for "Airflow Transient Enable" TAB_VERB %1.0 ENUM COMPU_TAB_REF CM_TAB_VERB_AIRFLOW_TRANSIENT_ENABLE /end COMPU_METHOD
/begin COMPU_TAB_RANGE CM_TAB_VERB_AIRFLOW_TRANSIENT_ENABLE "  " 2 0 OFF 1 ON DEFAULT_VALUE AUTO /end COMPU_TAB_RANGE
/begin AXIS_PTS Injector Start Primer Table_XAXIS "Injector Short Opening X Axis HTML=088.HTML" 0x20074964 RL_VALS32 Fuel Injector Predicted ms CM_FUEL_INJECTOR_PREDICTED_MS 11 0 2 AXIS_PTS_REF Injector Start Primer Table_XAXIS /end AXIS_PTS
/begin CHARACTERISTIC Injector Start Primer Table "Injector Short Opening Curve HTML=089.HTML" CURVE 0x20074990 RL_VALU32 CM_INJECTOR_START_PRIMER_TABLE USERCAL 0 2
 /begin AXIS_DESCR STD_AXIS Fuel Injector Predicted ms CM_FUEL_INJECTOR_PREDICTED_MS 11 0 0 AXIS_PTS_REF Injector Start Primer Table_XAXIS /end AXIS_DESCR
/end CHARACTERISTIC
/begin COMPU_METHOD CM_INJECTOR_START_PRIMER_TABLE Conversion for "Injector Start Primer Table" IDENTICAL %4.3 ms /end COMPU_METHOD
/begin AXIS_PTS Injector Short Opening Table_XAXIS "Injector Short Opening X Axis HTML=090.HTML" 0x200749BC RL_VALU32 Fuel Injector Predicted ms CM_FUEL_INJECTOR_PREDICTED_MS 11 0 2 AXIS_PTS_REF Injector Short Opening Table_XAXIS /end AXIS_PTS
/begin CHARACTERISTIC Injector Short Opening Table "Injector Short Opening Curve HTML=091.HTML" CURVE 0x200749E8 RL_VALU32 CM_INJECTOR_SHORT_OPENING_TABLE USERCAL 0 2
 /begin AXIS_DESCR STD_AXIS Fuel Injector Predicted ms CM_FUEL_INJECTOR_PREDICTED_MS 11 0 0 AXIS_PTS_REF Injector Short Opening Table_XAXIS /end AXIS_DESCR
/end CHARACTERISTIC
/begin COMPU_METHOD CM_INJECTOR_SHORT_OPENING_TABLE Conversion for "Injector Short Opening Table" LINEAR %4.3 ms COEFFS_LINEAR 0.001 0 /end COMPU_METHOD
/begin CHARACTERISTIC STT Neg Limit "TBC HTML=092.HTML" VALUE 0x20074A14 RL_VALU32 CM_STT_NEG_LIMIT USERCAL 0 2000 /end CHARACTERISTIC
/begin COMPU_METHOD CM_STT_NEG_LIMIT Conversion for "STT Neg Limit" IDENTICAL %3.0 dl /end COMPU_METHOD
/begin CHARACTERISTIC STT Pos Limit "TBC HTML=093.HTML" VALUE 0x20074A18 RL_VALU32 CM_STT_POS_LIMIT USERCAL 0 2000 /end CHARACTERISTIC
/begin COMPU_METHOD CM_STT_POS_LIMIT Conversion for "STT Pos Limit" IDENTICAL %3.0 dl /end COMPU_METHOD
/begin CHARACTERISTIC CLO2 Step Closed "TBC HTML=094.HTML" VALUE 0x20074A1C RL_VALU32 CM_CLO2_STEP_CLOSED USERCAL 0 10 /end CHARACTERISTIC
/begin COMPU_METHOD CM_CLO2_STEP_CLOSED Conversion for "CLO2 Step Closed" LINEAR %3.1 % COEFFS_LINEAR 0.1 0 /end COMPU_METHOD
/begin CHARACTERISTIC CLO2 Inc Closed "TBC HTML=095.HTML" VALUE 0x20074A20 RL_VALU32 CM_CLO2_INC_CLOSED USERCAL 0 10 /end CHARACTERISTIC
/begin COMPU_METHOD CM_CLO2_INC_CLOSED Conversion for "CLO2 Inc Closed" LINEAR %3.1 % COEFFS_LINEAR 0.1 0 /end COMPU_METHOD
/begin CHARACTERISTIC CLO2 Step Open "TBC HTML=096.HTML" VALUE 0x20074A24 RL_VALU32 CM_CLO2_STEP_OPEN USERCAL 0 10 /end CHARACTERISTIC
/begin COMPU_METHOD CM_CLO2_STEP_OPEN Conversion for "CLO2 Step Open" LINEAR %3.1 % COEFFS_LINEAR 0.1 0 /end COMPU_METHOD
/begin CHARACTERISTIC CLO2 Inc Open "TBC HTML=097.HTML" VALUE 0x20074A28 RL_VALU32 CM_CLO2_INC_OPEN USERCAL 0 10 /end CHARACTERISTIC
/begin COMPU_METHOD CM_CLO2_INC_OPEN Conversion for "CLO2 Inc Open" LINEAR %3.1 % COEFFS_LINEAR 0.1 0 /end COMPU_METHOD
/begin CHARACTERISTIC Timing Main Offset "TBC HTML=098.HTML" VALUE 0x20074A2C RL_VALU16 CM_TIMING_MAIN_OFFSET USERCAL 0 360 /end CHARACTERISTIC
/begin COMPU_METHOD CM_TIMING_MAIN_OFFSET Conversion for "Timing Main Offset" LINEAR %1.0 Degrees COEFFS_LINEAR 0.001 0 /end COMPU_METHOD
/begin CHARACTERISTIC AFM Transient Control RPM Limit "TBC HTML=099.HTML" VALUE 0x20074A30 RL_VALU32 CM_AFM_TRANSIENT_CONTROL_RPM_LIMIT USERCAL 0 8000 /end CHARACTERISTIC
/begin COMPU_METHOD CM_AFM_TRANSIENT_CONTROL_RPM_LIMIT Conversion for "AFM Transient Control RPM Limit" IDENTICAL %1.0 RPM /end COMPU_METHOD
/begin CHARACTERISTIC Wasted Spark Enable "TBC HTML=100.HTML" VALUE 0x20074A34 RL_VALU8 CM_WASTED_SPARK_ENABLE USERCAL 0 1 /end CHARACTERISTIC
/begin COMPU_METHOD CM_WASTED_SPARK_ENABLE Conversion for "Wasted Spark Enable" TAB_VERB %1.0 ENUM COMPU_TAB_REF CM_TAB_VERB_WASTED_SPARK_ENABLE /end COMPU_METHOD
/begin COMPU_TAB_RANGE CM_TAB_VERB_WASTED_SPARK_ENABLE "  " 2 0 OFF 1 ON DEFAULT_VALUE AUTO /end COMPU_TAB_RANGE
/begin CHARACTERISTIC AFR Reinstate "TBC HTML=101.HTML" VALUE 0x20074A36 RL_VALU16 CM_AFR_REINSTATE USERCAL 0 1 /end CHARACTERISTIC
/begin COMPU_METHOD CM_AFR_REINSTATE Conversion for "AFR Reinstate" LINEAR %1.0 dl COEFFS_LINEAR 0.001 0 /end COMPU_METHOD
/begin CHARACTERISTIC AFR Cutoff "TBC HTML=102.HTML" VALUE 0x20074A38 RL_VALU16 CM_AFR_CUTOFF USERCAL 0 1 /end CHARACTERISTIC
/begin COMPU_METHOD CM_AFR_CUTOFF Conversion for "AFR Cutoff" LINEAR %1.0 Degrees COEFFS_LINEAR 0.001 0 /end COMPU_METHOD
/begin CHARACTERISTIC TPS Closed Lower "TBC HTML=103.HTML" VALUE 0x20074A3C RL_VALU32 CM_TPS_CLOSED_LOWER USERCAL 0 90 /end CHARACTERISTIC
/begin COMPU_METHOD CM_TPS_CLOSED_LOWER Conversion for "TPS Closed Lower" LINEAR %1.0 Degrees COEFFS_LINEAR 0.001 0 /end COMPU_METHOD
/begin CHARACTERISTIC TPS Closed Upper "TBC HTML=104.HTML" VALUE 0x20074A40 RL_VALU32 CM_TPS_CLOSED_UPPER USERCAL 0 90 /end CHARACTERISTIC
/begin COMPU_METHOD CM_TPS_CLOSED_UPPER Conversion for "TPS Closed Upper" LINEAR %1.0 Degrees COEFFS_LINEAR 0.001 0 /end COMPU_METHOD
/begin CHARACTERISTIC ISC EST Trim Pos "ISC EST Trim Positive Max HTML=105.HTML" VALUE 0x20074A44 RL_VALU32 CM_ISC_EST_TRIM_POS USERCAL 0 15 /end CHARACTERISTIC
/begin COMPU_METHOD CM_ISC_EST_TRIM_POS Conversion for "ISC EST Trim Pos" LINEAR %5.3 Degrees COEFFS_LINEAR 0.001 0 /end COMPU_METHOD
/begin CHARACTERISTIC ISC EST Trim Neg "ISC EST Trim Negative Max HTML=106.HTML" VALUE 0x20074A48 RL_VALU32 CM_ISC_EST_TRIM_NEG USERCAL 0 15 /end CHARACTERISTIC
/begin COMPU_METHOD CM_ISC_EST_TRIM_NEG Conversion for "ISC EST Trim Neg" LINEAR %5.3 Degrees COEFFS_LINEAR 0.001 0 /end COMPU_METHOD
/begin CHARACTERISTIC CLO2 EST Trim Pos "Closed Loop Fuel EST Trim Positive Max HTML=107.HTML" VALUE 0x20074A4C RL_VALU32 CM_CLO2_EST_TRIM_POS USERCAL 0 5 /end CHARACTERISTIC
/begin COMPU_METHOD CM_CLO2_EST_TRIM_POS Conversion for "CLO2 EST Trim Pos" LINEAR %5.3 Degrees COEFFS_LINEAR 0.001 0 /end COMPU_METHOD
/begin CHARACTERISTIC CLO2 EST Trim Neg "Closed Loop Fuel EST Trim Negative Max HTML=108.HTML" VALUE 0x20074A50 RL_VALU32 CM_CLO2_EST_TRIM_NEG USERCAL 0 5 /end CHARACTERISTIC
/begin COMPU_METHOD CM_CLO2_EST_TRIM_NEG Conversion for "CLO2 EST Trim Neg" LINEAR %5.3 Degrees COEFFS_LINEAR 0.001 0 /end COMPU_METHOD
/begin CHARACTERISTIC Cylinder CC "Cylinder Capacity HTML=109.HTML" VALUE 0x20074A54 RL_VALU16 CM_CYLINDER_CC USERCAL 0 1000 /end CHARACTERISTIC
/begin COMPU_METHOD CM_CYLINDER_CC Conversion for "Cylinder CC" IDENTICAL %1.0 dl /end COMPU_METHOD
/begin CHARACTERISTIC AFM Primary Input Enable Open "AFM Primary Input Enable Open HTML=110.HTML" VALUE 0x20074A56 RL_VALU8 CM_AFM_PRIMARY_INPUT_ENABLE_OPEN USERCAL 0 1 /end CHARACTERISTIC
/begin COMPU_METHOD CM_AFM_PRIMARY_INPUT_ENABLE_OPEN Conversion for "AFM Primary Input Enable Open" TAB_VERB %1.0 ENUM COMPU_TAB_REF CM_TAB_VERB_AFM_PRIMARY_INPUT_ENABLE_OPEN /end COMPU_METHOD
/begin COMPU_TAB_RANGE CM_TAB_VERB_AFM_PRIMARY_INPUT_ENABLE_OPEN "  " 2 0 OFF 1 ON DEFAULT_VALUE AUTO /end COMPU_TAB_RANGE
/begin CHARACTERISTIC Speed Density AFM TPS Limit "TBC HTML=111.HTML" VALUE 0x20074A58 RL_VALU32 CM_SPEED_DENSITY_AFM_TPS_LIMIT USERCAL 0 90 /end CHARACTERISTIC
/begin COMPU_METHOD CM_SPEED_DENSITY_AFM_TPS_LIMIT Conversion for "Speed Density AFM TPS Limit" LINEAR %5.3 degrees COEFFS_LINEAR 0.001 0 /end COMPU_METHOD
/begin CHARACTERISTIC Seq RPM Limit AE "TBC HTML=112.HTML" VALUE 0x20074A5C RL_VALU16 CM_SEQ_RPM_LIMIT_AE USERCAL 0 10000 /end CHARACTERISTIC
/begin COMPU_METHOD CM_SEQ_RPM_LIMIT_AE Conversion for "Seq RPM Limit AE" IDENTICAL %1.0 dl /end COMPU_METHOD
/begin CHARACTERISTIC Seq RPM Limit BF "TBC HTML=113.HTML" VALUE 0x20074A5E RL_VALU16 CM_SEQ_RPM_LIMIT_BF USERCAL 0 10000 /end CHARACTERISTIC
/begin COMPU_METHOD CM_SEQ_RPM_LIMIT_BF Conversion for "Seq RPM Limit BF" IDENTICAL %1.0 dl /end COMPU_METHOD
/begin CHARACTERISTIC Seq RPM Limit CG "TBC HTML=114.HTML" VALUE 0x20074A60 RL_VALU16 CM_SEQ_RPM_LIMIT_CG USERCAL 0 10000 /end CHARACTERISTIC
/begin COMPU_METHOD CM_SEQ_RPM_LIMIT_CG Conversion for "Seq RPM Limit CG" IDENTICAL %1.0 dl /end COMPU_METHOD
/begin CHARACTERISTIC Seq RPM Limit DH "TBC HTML=115.HTML" VALUE 0x20074A62 RL_VALU16 CM_SEQ_RPM_LIMIT_DH USERCAL 0 10000 /end CHARACTERISTIC
/begin COMPU_METHOD CM_SEQ_RPM_LIMIT_DH Conversion for "Seq RPM Limit DH" IDENTICAL %1.0 dl /end COMPU_METHOD
/begin CHARACTERISTIC SeqRPMLimit5 "TBC HTML=116.HTML" VALUE 0x20074A64 RL_VALU16 CM_SEQRPMLIMIT5 USERCAL 0 1 /end CHARACTERISTIC
/begin COMPU_METHOD CM_SEQRPMLIMIT5 Conversion for "SeqRPMLimit5" LINEAR %1.0 dl COEFFS_LINEAR 10000 0 /end COMPU_METHOD
/begin CHARACTERISTIC SeqRPMLimit6 "TBC HTML=117.HTML" VALUE 0x20074A66 RL_VALU16 CM_SEQRPMLIMIT6 USERCAL 0 1 /end CHARACTERISTIC
/begin COMPU_METHOD CM_SEQRPMLIMIT6 Conversion for "SeqRPMLimit6" LINEAR %1.0 dl COEFFS_LINEAR 10000 0 /end COMPU_METHOD
/begin CHARACTERISTIC SeqRPMLimit7 "TBC HTML=118.HTML" VALUE 0x20074A68 RL_VALU16 CM_SEQRPMLIMIT7 USERCAL 0 1 /end CHARACTERISTIC
/begin COMPU_METHOD CM_SEQRPMLIMIT7 Conversion for "SeqRPMLimit7" LINEAR %1.0 dl COEFFS_LINEAR 10000 0 /end COMPU_METHOD
/begin CHARACTERISTIC SeqRPMLimit8 "TBC HTML=119.HTML" VALUE 0x20074A6A RL_VALU16 CM_SEQRPMLIMIT8 USERCAL 0 1 /end CHARACTERISTIC
/begin COMPU_METHOD CM_SEQRPMLIMIT8 Conversion for "SeqRPMLimit8" LINEAR %1.0 dl COEFFS_LINEAR 10000 0 /end COMPU_METHOD
/begin CHARACTERISTIC Seq RPM Limit Hyst "TBC HTML=120.HTML" VALUE 0x20074A6C RL_VALU16 CM_SEQ_RPM_LIMIT_HYST USERCAL 0 500 /end CHARACTERISTIC
/begin COMPU_METHOD CM_SEQ_RPM_LIMIT_HYST Conversion for "Seq RPM Limit Hyst" IDENTICAL %1.0 dl /end COMPU_METHOD
/begin CHARACTERISTIC HighVacuumEnableKpa "TBC HTML=121.HTML" VALUE 0x20074A6E RL_VALU16 CM_HIGHVACUUMENABLEKPA USERCAL 0 101.3 /end CHARACTERISTIC
/begin COMPU_METHOD CM_HIGHVACUUMENABLEKPA Conversion for "HighVacuumEnableKpa" LINEAR %1.0 dl COEFFS_LINEAR 0.001 0 /end COMPU_METHOD
/begin CHARACTERISTIC HighVacuumDisableKpa "TBC HTML=123.HTML" VALUE 0x20074A70 RL_VALU16 CM_HIGHVACUUMDISABLEKPA USERCAL 0 101.3 /end CHARACTERISTIC
/begin COMPU_METHOD CM_HIGHVACUUMDISABLEKPA Conversion for "HighVacuumDisableKpa" LINEAR %1.0 dl COEFFS_LINEAR 0.001 0 /end COMPU_METHOD
/begin CHARACTERISTIC OverrunCutEnableRPM "TBC HTML=124.HTML" VALUE 0x20074A72 RL_VALU16 CM_OVERRUNCUTENABLERPM USERCAL 0 2000 /end CHARACTERISTIC
/begin COMPU_METHOD CM_OVERRUNCUTENABLERPM Conversion for "OverrunCutEnableRPM" IDENTICAL %1.0 dl /end COMPU_METHOD
/begin CHARACTERISTIC OverrunCutDisableRPM "TBC HTML=125.HTML" VALUE 0x20074A74 RL_VALU16 CM_OVERRUNCUTDISABLERPM USERCAL 0 2000 /end CHARACTERISTIC
/begin COMPU_METHOD CM_OVERRUNCUTDISABLERPM Conversion for "OverrunCutDisableRPM" IDENTICAL %1.0 dl /end COMPU_METHOD
/begin CHARACTERISTIC RPMRunThreshold "TBC HTML=126.HTML" VALUE 0x20074A76 RL_VALU16 CM_RPMRUNTHRESHOLD USERCAL 0 1 /end CHARACTERISTIC
/begin COMPU_METHOD CM_RPMRUNTHRESHOLD Conversion for "RPMRunThreshold" IDENTICAL %1.0 dl /end COMPU_METHOD
/begin CHARACTERISTIC CLO2 Sequence Assignment "CLO2 Sequence Assignment HTML=126.HTML" VALUE 0x20074A78 RL_VALU8 CM_CLO2_SEQUENCE_ASSIGNMENT USERCAL 0 255 /end CHARACTERISTIC
/begin COMPU_METHOD CM_CLO2_SEQUENCE_ASSIGNMENT Conversion for "CLO2 Sequence Assignment" TAB_VERB %1.0 ENUM COMPU_TAB_REF CM_TAB_VERB_CLO2_SEQUENCE_ASSIGNMENT /end COMPU_METHOD
/begin COMPU_TAB_RANGE CM_TAB_VERB_CLO2_SEQUENCE_ASSIGNMENT "  " 16 0 CYL1stL-CYL2ndL-CYL3rdL-CYL4thL 1 CYL1stR-CYL2ndL-CYL3rdL-CYL4thL 2 CYL1stL-CYL2ndR-CYL3rdL-CYL4thL 3 CYL1stR-CYL2ndR-CYL3rdL-CYL4thL 4 CYL1stL-CYL2ndL-CYL3rdR-CYL4thL 5 CYL1stR-CYL2ndL-CYL3rdR-CYL4thL 6 CYL1stL-CYL2ndR-CYL3rdR-CYL4thL 7 CYL1stR-CYL2ndR-CYL3rdR-CYL4thL 8 CYL1stL-CYL2ndL-CYL3rdL-CYL4thR 9 CYL1stR-CYL2ndL-CYL3rdL-CYL4thR 10 CYL1stL-CYL2ndR-CYL3rdL-CYL4thR 11 CYL1stR-CYL2ndR-CYL3rdL-CYL4thR 12 CYL1stL-CYL2ndL-CYL3rdR-CYL4thR 13 CYL1stR-CYL2ndL-CYL3rdR-CYL4thR 14 CYL1stL-CYL2ndR-CYL3rdR-CYL4thR 15 CYL1stR-CYL2ndR-CYL3rdR-CYL4thR DEFAULT_VALUE AUTO /end COMPU_TAB_RANGE
/begin CHARACTERISTIC EST Filter Closed "EST Filter Closed HTML=127.HTML" VALUE 0x20074A7A RL_VALU16 CM_EST_FILTER_CLOSED USERCAL 0 255 /end CHARACTERISTIC
/begin COMPU_METHOD CM_EST_FILTER_CLOSED Conversion for "EST Filter Closed" IDENTICAL %1.0 dl /end COMPU_METHOD
/begin CHARACTERISTIC EST Filter Open "EST Filter Open HTML=128.HTML" VALUE 0x20074A7C RL_VALU16 CM_EST_FILTER_OPEN USERCAL 0 255 /end CHARACTERISTIC
/begin COMPU_METHOD CM_EST_FILTER_OPEN Conversion for "EST Filter Open" IDENTICAL %1.0 dl /end COMPU_METHOD
/begin CHARACTERISTIC EST CL Gain "EST CL Gain HTML=129.HTML" VALUE 0x20074A7E RL_VALU16 CM_EST_CL_GAIN USERCAL 0 255 /end CHARACTERISTIC
/begin COMPU_METHOD CM_EST_CL_GAIN Conversion for "EST CL Gain" IDENTICAL %1.0 dl /end COMPU_METHOD
/begin CHARACTERISTIC AFM Primary Input Enable Closed "AFM Primary Input Enable Closed HTML=130.HTML" VALUE 0x20074A80 RL_VALU8 CM_AFM_PRIMARY_INPUT_ENABLE_CLOSED USERCAL 0 1 /end CHARACTERISTIC
/begin COMPU_METHOD CM_AFM_PRIMARY_INPUT_ENABLE_CLOSED Conversion for "AFM Primary Input Enable Closed" TAB_VERB %1.0 ENUM COMPU_TAB_REF CM_TAB_VERB_AFM_PRIMARY_INPUT_ENABLE_CLOSED /end COMPU_METHOD
/begin COMPU_TAB_RANGE CM_TAB_VERB_AFM_PRIMARY_INPUT_ENABLE_CLOSED "  " 2 0 OFF 1 ON DEFAULT_VALUE AUTO /end COMPU_TAB_RANGE
/begin CHARACTERISTIC Sequence 1 Fuel Offset "Sequence 1 Fuel Offset HTML=131.HTML" VALUE 0x20074A82 RL_VALS16 CM_SEQUENCE_1_FUEL_OFFSET USERCAL -1 1 /end CHARACTERISTIC
/begin COMPU_METHOD CM_SEQUENCE_1_FUEL_OFFSET Conversion for "Sequence 1 Fuel Offset" LINEAR %4.3 ms COEFFS_LINEAR 0.001 0 /end COMPU_METHOD
/begin CHARACTERISTIC Sequence 2 Fuel Offset "Sequence 2 Fuel Offset HTML=132.HTML" VALUE 0x20074A84 RL_VALS16 CM_SEQUENCE_2_FUEL_OFFSET USERCAL -1 1 /end CHARACTERISTIC
/begin COMPU_METHOD CM_SEQUENCE_2_FUEL_OFFSET Conversion for "Sequence 2 Fuel Offset" LINEAR %4.3 ms COEFFS_LINEAR 0.001 0 /end COMPU_METHOD
/begin CHARACTERISTIC Sequence 3 Fuel Offset "Sequence 3 Fuel Offset HTML=133.HTML" VALUE 0x20074A86 RL_VALS16 CM_SEQUENCE_3_FUEL_OFFSET USERCAL -1 1 /end CHARACTERISTIC
/begin COMPU_METHOD CM_SEQUENCE_3_FUEL_OFFSET Conversion for "Sequence 3 Fuel Offset" LINEAR %4.3 ms COEFFS_LINEAR 0.001 0 /end COMPU_METHOD
/begin CHARACTERISTIC Sequence 4 Fuel Offset "Sequence 4 Fuel Offset HTML=134.HTML" VALUE 0x20074A88 RL_VALS16 CM_SEQUENCE_4_FUEL_OFFSET USERCAL -1 1 /end CHARACTERISTIC
/begin COMPU_METHOD CM_SEQUENCE_4_FUEL_OFFSET Conversion for "Sequence 4 Fuel Offset" LINEAR %4.3 ms COEFFS_LINEAR 0.001 0 /end COMPU_METHOD
/begin CHARACTERISTIC Sequence 1 Fuel Gain "Sequence 1 Fuel Gain HTML=135.HTML" VALUE 0x20074A8A RL_VALU16 CM_SEQUENCE_1_FUEL_GAIN USERCAL 0 2 /end CHARACTERISTIC
/begin COMPU_METHOD CM_SEQUENCE_1_FUEL_GAIN Conversion for "Sequence 1 Fuel Gain" LINEAR %4.3 dl COEFFS_LINEAR 0.001 0 /end COMPU_METHOD
/begin CHARACTERISTIC Sequence 2 Fuel Gain "Sequence 2 Fuel Gain HTML=136.HTML" VALUE 0x20074A8C RL_VALU16 CM_SEQUENCE_2_FUEL_GAIN USERCAL 0 2 /end CHARACTERISTIC
/begin COMPU_METHOD CM_SEQUENCE_2_FUEL_GAIN Conversion for "Sequence 2 Fuel Gain" LINEAR %4.3 dl COEFFS_LINEAR 0.001 0 /end COMPU_METHOD
/begin CHARACTERISTIC Sequence 3 Fuel Gain "Sequence 3 Fuel Gain HTML=137.HTML" VALUE 0x20074A8E RL_VALU16 CM_SEQUENCE_3_FUEL_GAIN USERCAL 0 2 /end CHARACTERISTIC
/begin COMPU_METHOD CM_SEQUENCE_3_FUEL_GAIN Conversion for "Sequence 3 Fuel Gain" LINEAR %4.3 dl COEFFS_LINEAR 0.001 0 /end COMPU_METHOD
/begin CHARACTERISTIC Sequence 4 Fuel Gain "Sequence 4 Fuel Gain HTML=138.HTML" VALUE 0x20074A90 RL_VALU16 CM_SEQUENCE_4_FUEL_GAIN USERCAL 0 2 /end CHARACTERISTIC
/begin COMPU_METHOD CM_SEQUENCE_4_FUEL_GAIN Conversion for "Sequence 4 Fuel Gain" LINEAR %4.3 dl COEFFS_LINEAR 0.001 0 /end COMPU_METHOD
/begin CHARACTERISTIC TPS CAN Primary "TPS CAN Enable HTML=139.HTML" VALUE 0x20074A92 RL_VALU8 CM_TPS_CAN_PRIMARY USERCAL 0 2 /end CHARACTERISTIC
/begin COMPU_METHOD CM_TPS_CAN_PRIMARY Conversion for "TPS CAN Primary" IDENTICAL %1.0 dl /end COMPU_METHOD
/begin CHARACTERISTIC PPS CAN Primary "PPS CAN Enable HTML=140.HTML" VALUE 0x20074A93 RL_VALU8 CM_PPS_CAN_PRIMARY USERCAL 0 2 /end CHARACTERISTIC
/begin COMPU_METHOD CM_PPS_CAN_PRIMARY Conversion for "PPS CAN Primary" IDENTICAL %1.0 dl /end COMPU_METHOD
/begin CHARACTERISTIC CTS CAN Primary "CTS CAN Enable HTML=141.HTML" VALUE 0x20074A94 RL_VALU8 CM_CTS_CAN_PRIMARY USERCAL 0 2 /end CHARACTERISTIC
/begin COMPU_METHOD CM_CTS_CAN_PRIMARY Conversion for "CTS CAN Primary" IDENTICAL %1.0 dl /end COMPU_METHOD
/begin CHARACTERISTIC ATS CAN Primary "ATS CAN Enable HTML=142.HTML" VALUE 0x20074A95 RL_VALU8 CM_ATS_CAN_PRIMARY USERCAL 0 2 /end CHARACTERISTIC
/begin COMPU_METHOD CM_ATS_CAN_PRIMARY Conversion for "ATS CAN Primary" IDENTICAL %1.0 dl /end COMPU_METHOD
/begin CHARACTERISTIC MAP CAN Primary "MAP CAN Enable HTML=143.HTML" VALUE 0x20074A96 RL_VALU8 CM_MAP_CAN_PRIMARY USERCAL 0 2 /end CHARACTERISTIC
/begin COMPU_METHOD CM_MAP_CAN_PRIMARY Conversion for "MAP CAN Primary" IDENTICAL %1.0 dl /end COMPU_METHOD
/begin CHARACTERISTIC Priority CAN ID 1 "Priority CAN ID 1 HTML=144.HTML" VALUE 0x20074A98 RL_VALU32 CM_PRIORITY_CAN_ID_1 USERCAL 1 4095 /end CHARACTERISTIC
/begin COMPU_METHOD CM_PRIORITY_CAN_ID_1 Conversion for "Priority CAN ID 1" IDENTICAL %4.0 dl /end COMPU_METHOD
/begin CHARACTERISTIC Sensor CAN Data Offset "Priority CAN ID 1 HTML=145.HTML" VALUE 0x20074AA8 RL_VALU8 CM_SENSOR_CAN_DATA_OFFSET USERCAL 1 255 /end CHARACTERISTIC
/begin COMPU_METHOD CM_SENSOR_CAN_DATA_OFFSET Conversion for "Sensor CAN Data Offset" IDENTICAL %4.0 dl /end COMPU_METHOD
/begin CHARACTERISTIC Sensor CAN Data ByteCount "Priority CAN ID 1 HTML=146.HTML" VALUE 0x20074AB0 RL_VALU8 CM_SENSOR_CAN_DATA_BYTECOUNT USERCAL 1 255 /end CHARACTERISTIC
/begin COMPU_METHOD CM_SENSOR_CAN_DATA_BYTECOUNT Conversion for "Sensor CAN Data ByteCount" IDENTICAL %4.0 dl /end COMPU_METHOD
/begin CHARACTERISTIC Sync Phase Repeats "Sync Phase Repeats HTML=147.HTML" VALUE 0x20074AB8 RL_VALU32 CM_SYNC_PHASE_REPEATS USERCAL 1 4095 /end CHARACTERISTIC
/begin COMPU_METHOD CM_SYNC_PHASE_REPEATS Conversion for "Sync Phase Repeats" TAB_VERB %4.0 ENUM COMPU_TAB_REF CM_TAB_VERB_SYNC_PHASE_REPEATS /end COMPU_METHOD
/begin COMPU_TAB_RANGE CM_TAB_VERB_SYNC_PHASE_REPEATS "  " 2 1 BATCH 2 SEQUENTIAL DEFAULT_VALUE AUTO /end COMPU_TAB_RANGE
/begin CHARACTERISTIC Map Sensor Gain "Sync Phase Repeats HTML=148.HTML" VALUE 0x20074ABC RL_VALS32 CM_MAP_SENSOR_GAIN USERCAL 1 4095 /end CHARACTERISTIC
/begin COMPU_METHOD CM_MAP_SENSOR_GAIN Conversion for "Map Sensor Gain" IDENTICAL %4.0 dl /end COMPU_METHOD
/begin CHARACTERISTIC Map Sensor Offset "Sync Phase Repeats HTML=149.HTML" VALUE 0x20074AC0 RL_VALS32 CM_MAP_SENSOR_OFFSET USERCAL 1 4095 /end CHARACTERISTIC
/begin COMPU_METHOD CM_MAP_SENSOR_OFFSET Conversion for "Map Sensor Offset" IDENTICAL %4.0 dl /end COMPU_METHOD
/begin CHARACTERISTIC Inj Divide "Sync Phase Repeats HTML=150.HTML" VALUE 0x20074AC4 RL_VALU8 CM_INJ_DIVIDE USERCAL 1 4 /end CHARACTERISTIC
/begin COMPU_METHOD CM_INJ_DIVIDE Conversion for "Inj Divide" TAB_VERB %4.0 ENUM COMPU_TAB_REF CM_TAB_VERB_INJ_DIVIDE /end COMPU_METHOD
/begin COMPU_TAB_RANGE CM_TAB_VERB_INJ_DIVIDE "  " 3 4 TBI 2 BATCH 1 SEQUENTIAL DEFAULT_VALUE AUTO /end COMPU_TAB_RANGE
/begin CHARACTERISTIC CLO2 LeftEnable "Sync Phase Repeats HTML=151.HTML" VALUE 0x20074AC5 RL_VALU8 CM_CLO2_LEFTENABLE USERCAL 0 1 /end CHARACTERISTIC
/begin COMPU_METHOD CM_CLO2_LEFTENABLE Conversion for "CLO2 LeftEnable" TAB_VERB %4.0 ENUM COMPU_TAB_REF CM_TAB_VERB_CLO2_LEFTENABLE /end COMPU_METHOD
/begin COMPU_TAB_RANGE CM_TAB_VERB_CLO2_LEFTENABLE "  " 2 0 OFF 1 ON DEFAULT_VALUE AUTO /end COMPU_TAB_RANGE
/begin CHARACTERISTIC CLO2 RightEnable "Sync Phase Repeats HTML=152.HTML" VALUE 0x20074AC6 RL_VALU8 CM_CLO2_RIGHTENABLE USERCAL 0 1 /end CHARACTERISTIC
/begin COMPU_METHOD CM_CLO2_RIGHTENABLE Conversion for "CLO2 RightEnable" TAB_VERB %4.0 ENUM COMPU_TAB_REF CM_TAB_VERB_CLO2_RIGHTENABLE /end COMPU_METHOD
/begin COMPU_TAB_RANGE CM_TAB_VERB_CLO2_RIGHTENABLE "  " 2 0 OFF 1 ON DEFAULT_VALUE AUTO /end COMPU_TAB_RANGE
/begin CHARACTERISTIC Returnless Enable "Sync Phase Repeats HTML=153.HTML" VALUE 0x20074AC7 RL_VALU8 CM_RETURNLESS_ENABLE USERCAL 1 1 /end CHARACTERISTIC
/begin COMPU_METHOD CM_RETURNLESS_ENABLE Conversion for "Returnless Enable" TAB_VERB %4.0 ENUM COMPU_TAB_REF CM_TAB_VERB_RETURNLESS_ENABLE /end COMPU_METHOD
/begin COMPU_TAB_RANGE CM_TAB_VERB_RETURNLESS_ENABLE "  " 2 0 OFF 1 ON DEFAULT_VALUE AUTO /end COMPU_TAB_RANGE
/begin CHARACTERISTIC Returnless Pressure kPa "Sync Phase Repeats HTML=154.HTML" VALUE 0x20074AC8 RL_VALU16 CM_RETURNLESS_PRESSURE_KPA USERCAL 1 500 /end CHARACTERISTIC
/begin COMPU_METHOD CM_RETURNLESS_PRESSURE_KPA Conversion for "Returnless Pressure kPa" LINEAR %4.0 kPa COEFFS_LINEAR 0.001 0 /end COMPU_METHOD
/begin CHARACTERISTIC Cranking Airflow Enable "Sync Phase Repeats HTML=155.HTML" VALUE 0x20074ACA RL_VALU8 CM_CRANKING_AIRFLOW_ENABLE USERCAL 1 1 /end CHARACTERISTIC
/begin COMPU_METHOD CM_CRANKING_AIRFLOW_ENABLE Conversion for "Cranking Airflow Enable" TAB_VERB %4.0 ENUM COMPU_TAB_REF CM_TAB_VERB_CRANKING_AIRFLOW_ENABLE /end COMPU_METHOD
/begin COMPU_TAB_RANGE CM_TAB_VERB_CRANKING_AIRFLOW_ENABLE "  " 2 0 OFF 1 ON DEFAULT_VALUE AUTO /end COMPU_TAB_RANGE
/begin CHARACTERISTIC Stepper IAC Enable "Sync Phase Repeats HTML=156.HTML" VALUE 0x20074ACB RL_VALU8 CM_STEPPER_IAC_ENABLE USERCAL 1 1 /end CHARACTERISTIC
/begin COMPU_METHOD CM_STEPPER_IAC_ENABLE Conversion for "Stepper IAC Enable" TAB_VERB %4.0 ENUM COMPU_TAB_REF CM_TAB_VERB_STEPPER_IAC_ENABLE /end COMPU_METHOD
/begin COMPU_TAB_RANGE CM_TAB_VERB_STEPPER_IAC_ENABLE "  " 2 0 OFF 1 ON DEFAULT_VALUE AUTO /end COMPU_TAB_RANGE
/begin CHARACTERISTIC IAC Steps Open Hot "Sync Phase Repeats HTML=157.HTML" VALUE 0x20074ACC RL_VALU16 CM_IAC_STEPS_OPEN_HOT USERCAL 1 255 /end CHARACTERISTIC
/begin COMPU_METHOD CM_IAC_STEPS_OPEN_HOT Conversion for "IAC Steps Open Hot" IDENTICAL %4.0 dl /end COMPU_METHOD
/begin CHARACTERISTIC IAC Steps Open Cold "Sync Phase Repeats HTML=158.HTML" VALUE 0x20074ACE RL_VALU16 CM_IAC_STEPS_OPEN_COLD USERCAL 1 255 /end CHARACTERISTIC
/begin COMPU_METHOD CM_IAC_STEPS_OPEN_COLD Conversion for "IAC Steps Open Cold" IDENTICAL %4.0 dl /end COMPU_METHOD
/begin CHARACTERISTIC Idle Entry RPM Offset "Idle Entry RPM Offset HTML=159.HTML" VALUE 0x20074AD0 RL_VALU16 CM_IDLE_ENTRY_RPM_OFFSET USERCAL 1 1000 /end CHARACTERISTIC
/begin COMPU_METHOD CM_IDLE_ENTRY_RPM_OFFSET Conversion for "Idle Entry RPM Offset" IDENTICAL %4.0 RPM /end COMPU_METHOD
/begin CHARACTERISTIC Rad Fan On Temp "Rad Fan On Temp HTML=160.HTML" VALUE 0x20074AD4 RL_VALS32 CM_RAD_FAN_ON_TEMP USERCAL -40 200 /end CHARACTERISTIC
/begin COMPU_METHOD CM_RAD_FAN_ON_TEMP Conversion for "Rad Fan On Temp" LINEAR %4.0 degC COEFFS_LINEAR 0.001 0 /end COMPU_METHOD
/begin CHARACTERISTIC Rad Fan Off Temp "Rad Fan Off Temp HTML=161.HTML" VALUE 0x20074AD8 RL_VALS32 CM_RAD_FAN_OFF_TEMP USERCAL -40 200 /end CHARACTERISTIC
/begin COMPU_METHOD CM_RAD_FAN_OFF_TEMP Conversion for "Rad Fan Off Temp" LINEAR %4.0 degC COEFFS_LINEAR 0.001 0 /end COMPU_METHOD
/begin CHARACTERISTIC Fuel Pump Relay "EST Sequence 1 IO Mux Resource" VALUE 0x20074ADC RL_VALU8 CM_FUEL_PUMP_RELAY USERCAL 1 100 /end CHARACTERISTIC
/begin COMPU_METHOD CM_FUEL_PUMP_RELAY Conversion for "Fuel Pump Relay" TAB_VERB %3.0 ENUM COMPU_TAB_REF CM_TAB_VERB_FUEL_PUMP_RELAY /end COMPU_METHOD
/begin COMPU_TAB_RANGE CM_TAB_VERB_FUEL_PUMP_RELAY "  " 26 0 EH_IO_ADD1 1 EH_IO_ADD2 2 EH_IO_ADD3 3 EH_IO_ADD4 4 EH_IO_ADD5 5 EH_IO_ADD6 6 EH_IO_ADD7 7 EH_IO_ADD8 8 EH_IO_ADD9 9 EH_IO_ADD10 10 EH_IO_ADD11 11 EH_IO_ADD12 58 EH_IO_TMR1 59 EH_IO_TMR2 60 EH_IO_TMR3 61 EH_IO_TMR4 62 EH_IO_TMR5 63 EH_IO_TMR6 64 EH_IO_TMR7 65 EH_IO_TMR8 66 EH_IO_TMR9 67 EH_IO_TMR10 68 EH_IO_TMR11 69 EH_IO_TMR12 70 EH_IO_EXTINT 121 EH_IO_Invalid DEFAULT_VALUE AUTO /end COMPU_TAB_RANGE
/begin CHARACTERISTIC EST Bypass "EST Sequence 1 IO Mux Resource" VALUE 0x20074ADD RL_VALU8 CM_EST_BYPASS USERCAL 1 1000 /end CHARACTERISTIC
/begin COMPU_METHOD CM_EST_BYPASS Conversion for "EST Bypass" TAB_VERB %3.0 ENUM COMPU_TAB_REF CM_TAB_VERB_EST_BYPASS /end COMPU_METHOD
/begin COMPU_TAB_RANGE CM_TAB_VERB_EST_BYPASS "  " 26 0 EH_IO_ADD1 1 EH_IO_ADD2 2 EH_IO_ADD3 3 EH_IO_ADD4 4 EH_IO_ADD5 5 EH_IO_ADD6 6 EH_IO_ADD7 7 EH_IO_ADD8 8 EH_IO_ADD9 9 EH_IO_ADD10 10 EH_IO_ADD11 11 EH_IO_ADD12 58 EH_IO_TMR1 59 EH_IO_TMR2 60 EH_IO_TMR3 61 EH_IO_TMR4 62 EH_IO_TMR5 63 EH_IO_TMR6 64 EH_IO_TMR7 65 EH_IO_TMR8 66 EH_IO_TMR9 67 EH_IO_TMR10 68 EH_IO_TMR11 69 EH_IO_TMR12 70 EH_IO_EXTINT 121 EH_IO_Invalid DEFAULT_VALUE AUTO /end COMPU_TAB_RANGE
/begin AXIS_PTS Air Sensor Table_XAXIS "Air Sensor X Axis HTML=164.HTML" 0x20074AE0 RL_VALU32 ATS Sensor Voltage CM_ATS_SENSOR_VOLTAGE 17 0 5 AXIS_PTS_REF Air Sensor Table_XAXIS /end AXIS_PTS
/begin CHARACTERISTIC Air Sensor Table "Air Sensor Curve HTML=165.HTML" CURVE 0x20074B24 RL_VALS32 CM_AIR_SENSOR_TABLE USERCAL -40 200
 /begin AXIS_DESCR STD_AXIS ATS Sensor Voltage CM_ATS_SENSOR_VOLTAGE 17 0 0 AXIS_PTS_REF Air Sensor Table_XAXIS /end AXIS_DESCR
/end CHARACTERISTIC
/begin COMPU_METHOD CM_AIR_SENSOR_TABLE Conversion for "Air Sensor Table" LINEAR %4.3 degrees C COEFFS_LINEAR 0.001 0 /end COMPU_METHOD
/begin CHARACTERISTIC Fuel 1 IO Resource "Fuel Sequence 1 IO Resource HTML=166.HTML" VALUE 0x20074B68 RL_VALU16 CM_FUEL_1_IO_RESOURCE USERCAL 0 255 /end CHARACTERISTIC
/begin COMPU_METHOD CM_FUEL_1_IO_RESOURCE Conversion for "Fuel 1 IO Resource" TAB_VERB %3.0 ENUM COMPU_TAB_REF CM_TAB_VERB_FUEL_1_IO_RESOURCE /end COMPU_METHOD
/begin COMPU_TAB_RANGE CM_TAB_VERB_FUEL_1_IO_RESOURCE "  " 17 4 EH_IO_ADD5 6 EH_IO_ADD7 7 EH_IO_ADD8 58 EH_IO_TMR1 59 EH_IO_TMR2 60 EH_IO_TMR3 61 EH_IO_TMR4 62 EH_IO_TMR5 63 EH_IO_TMR6 64 EH_IO_TMR7 65 EH_IO_TMR8 66 EH_IO_TMR9 67 EH_IO_TMR10 68 EH_IO_TMR11 69 EH_IO_TMR12 70 EH_IO_EXTINT 121 EH_IO_Invalid DEFAULT_VALUE AUTO /end COMPU_TAB_RANGE
/begin CHARACTERISTIC Fuel 2 IO Resource "Fuel Sequence 2 IO Resource HTML=167.HTML" VALUE 0x20074B6A RL_VALU16 CM_FUEL_2_IO_RESOURCE USERCAL 0 255 /end CHARACTERISTIC
/begin COMPU_METHOD CM_FUEL_2_IO_RESOURCE Conversion for "Fuel 2 IO Resource" TAB_VERB %3.0 ENUM COMPU_TAB_REF CM_TAB_VERB_FUEL_2_IO_RESOURCE /end COMPU_METHOD
/begin COMPU_TAB_RANGE CM_TAB_VERB_FUEL_2_IO_RESOURCE "  " 17 4 EH_IO_ADD5 6 EH_IO_ADD7 7 EH_IO_ADD8 58 EH_IO_TMR1 59 EH_IO_TMR2 60 EH_IO_TMR3 61 EH_IO_TMR4 62 EH_IO_TMR5 63 EH_IO_TMR6 64 EH_IO_TMR7 65 EH_IO_TMR8 66 EH_IO_TMR9 67 EH_IO_TMR10 68 EH_IO_TMR11 69 EH_IO_TMR12 70 EH_IO_EXTINT 121 EH_IO_Invalid DEFAULT_VALUE AUTO /end COMPU_TAB_RANGE
/begin CHARACTERISTIC Fuel 3 IO Resource "Fuel Sequence 3 IO Resource HTML=168.HTML" VALUE 0x20074B6C RL_VALU16 CM_FUEL_3_IO_RESOURCE USERCAL 0 255 /end CHARACTERISTIC
/begin COMPU_METHOD CM_FUEL_3_IO_RESOURCE Conversion for "Fuel 3 IO Resource" TAB_VERB %3.0 ENUM COMPU_TAB_REF CM_TAB_VERB_FUEL_3_IO_RESOURCE /end COMPU_METHOD
/begin COMPU_TAB_RANGE CM_TAB_VERB_FUEL_3_IO_RESOURCE "  " 17 4 EH_IO_ADD5 6 EH_IO_ADD7 7 EH_IO_ADD8 58 EH_IO_TMR1 59 EH_IO_TMR2 60 EH_IO_TMR3 61 EH_IO_TMR4 62 EH_IO_TMR5 63 EH_IO_TMR6 64 EH_IO_TMR7 65 EH_IO_TMR8 66 EH_IO_TMR9 67 EH_IO_TMR10 68 EH_IO_TMR11 69 EH_IO_TMR12 70 EH_IO_EXTINT 121 EH_IO_Invalid DEFAULT_VALUE AUTO /end COMPU_TAB_RANGE
/begin CHARACTERISTIC Fuel 4 IO Resource "Fuel Sequence 4 IO Resource HTML=169.HTML" VALUE 0x20074B6E RL_VALU16 CM_FUEL_4_IO_RESOURCE USERCAL 0 255 /end CHARACTERISTIC
/begin COMPU_METHOD CM_FUEL_4_IO_RESOURCE Conversion for "Fuel 4 IO Resource" TAB_VERB %3.0 ENUM COMPU_TAB_REF CM_TAB_VERB_FUEL_4_IO_RESOURCE /end COMPU_METHOD
/begin COMPU_TAB_RANGE CM_TAB_VERB_FUEL_4_IO_RESOURCE "  " 17 4 EH_IO_ADD5 6 EH_IO_ADD7 7 EH_IO_ADD8 58 EH_IO_TMR1 59 EH_IO_TMR2 60 EH_IO_TMR3 61 EH_IO_TMR4 62 EH_IO_TMR5 63 EH_IO_TMR6 64 EH_IO_TMR7 65 EH_IO_TMR8 66 EH_IO_TMR9 67 EH_IO_TMR10 68 EH_IO_TMR11 69 EH_IO_TMR12 70 EH_IO_EXTINT 121 EH_IO_Invalid DEFAULT_VALUE AUTO /end COMPU_TAB_RANGE
/begin CHARACTERISTIC EST 1 IO Resource "EST Sequence 1 IO Resource HTML=170.HTML" VALUE 0x20074B70 RL_VALU16 CM_EST_1_IO_RESOURCE USERCAL 0 255 /end CHARACTERISTIC
/begin COMPU_METHOD CM_EST_1_IO_RESOURCE Conversion for "EST 1 IO Resource" TAB_VERB %3.0 ENUM COMPU_TAB_REF CM_TAB_VERB_EST_1_IO_RESOURCE /end COMPU_METHOD
/begin COMPU_TAB_RANGE CM_TAB_VERB_EST_1_IO_RESOURCE "  " 17 4 EH_IO_ADD5 6 EH_IO_ADD7 7 EH_IO_ADD8 58 EH_IO_TMR1 59 EH_IO_TMR2 60 EH_IO_TMR3 61 EH_IO_TMR4 62 EH_IO_TMR5 63 EH_IO_TMR6 64 EH_IO_TMR7 65 EH_IO_TMR8 66 EH_IO_TMR9 67 EH_IO_TMR10 68 EH_IO_TMR11 69 EH_IO_TMR12 70 EH_IO_EXTINT 121 EH_IO_Invalid DEFAULT_VALUE AUTO /end COMPU_TAB_RANGE
/begin CHARACTERISTIC EST 2 IO Resource "EST Sequence 2 IO Resource HTML=171.HTML" VALUE 0x20074B72 RL_VALU16 CM_EST_2_IO_RESOURCE USERCAL 0 255 /end CHARACTERISTIC
/begin COMPU_METHOD CM_EST_2_IO_RESOURCE Conversion for "EST 2 IO Resource" TAB_VERB %3.0 ENUM COMPU_TAB_REF CM_TAB_VERB_EST_2_IO_RESOURCE /end COMPU_METHOD
/begin COMPU_TAB_RANGE CM_TAB_VERB_EST_2_IO_RESOURCE "  " 17 4 EH_IO_ADD5 6 EH_IO_ADD7 7 EH_IO_ADD8 58 EH_IO_TMR1 59 EH_IO_TMR2 60 EH_IO_TMR3 61 EH_IO_TMR4 62 EH_IO_TMR5 63 EH_IO_TMR6 64 EH_IO_TMR7 65 EH_IO_TMR8 66 EH_IO_TMR9 67 EH_IO_TMR10 68 EH_IO_TMR11 69 EH_IO_TMR12 70 EH_IO_EXTINT 121 EH_IO_Invalid DEFAULT_VALUE AUTO /end COMPU_TAB_RANGE
/begin CHARACTERISTIC EST 3 IO Resource "EST Sequence 3 IO Resource HTML=172.HTML" VALUE 0x20074B74 RL_VALU16 CM_EST_3_IO_RESOURCE USERCAL 0 255 /end CHARACTERISTIC
/begin COMPU_METHOD CM_EST_3_IO_RESOURCE Conversion for "EST 3 IO Resource" TAB_VERB %3.0 ENUM COMPU_TAB_REF CM_TAB_VERB_EST_3_IO_RESOURCE /end COMPU_METHOD
/begin COMPU_TAB_RANGE CM_TAB_VERB_EST_3_IO_RESOURCE "  " 17 4 EH_IO_ADD5 6 EH_IO_ADD7 7 EH_IO_ADD8 58 EH_IO_TMR1 59 EH_IO_TMR2 60 EH_IO_TMR3 61 EH_IO_TMR4 62 EH_IO_TMR5 63 EH_IO_TMR6 64 EH_IO_TMR7 65 EH_IO_TMR8 66 EH_IO_TMR9 67 EH_IO_TMR10 68 EH_IO_TMR11 69 EH_IO_TMR12 70 EH_IO_EXTINT 121 EH_IO_Invalid DEFAULT_VALUE AUTO /end COMPU_TAB_RANGE
/begin CHARACTERISTIC EST 4 IO Resource "EST Sequence 4 IO Resource HTML=173.HTML" VALUE 0x20074B76 RL_VALU16 CM_EST_4_IO_RESOURCE USERCAL 0 255 /end CHARACTERISTIC
/begin COMPU_METHOD CM_EST_4_IO_RESOURCE Conversion for "EST 4 IO Resource" TAB_VERB %3.0 ENUM COMPU_TAB_REF CM_TAB_VERB_EST_4_IO_RESOURCE /end COMPU_METHOD
/begin COMPU_TAB_RANGE CM_TAB_VERB_EST_4_IO_RESOURCE "  " 17 4 EH_IO_ADD5 6 EH_IO_ADD7 7 EH_IO_ADD8 58 EH_IO_TMR1 59 EH_IO_TMR2 60 EH_IO_TMR3 61 EH_IO_TMR4 62 EH_IO_TMR5 63 EH_IO_TMR6 64 EH_IO_TMR7 65 EH_IO_TMR8 66 EH_IO_TMR9 67 EH_IO_TMR10 68 EH_IO_TMR11 69 EH_IO_TMR12 70 EH_IO_EXTINT 121 EH_IO_Invalid DEFAULT_VALUE AUTO /end COMPU_TAB_RANGE
/begin CHARACTERISTIC IAC 1 IO Resource "IAC 1 IO Resource HTML=174.HTML" VALUE 0x20074B78 RL_VALU16 CM_IAC_1_IO_RESOURCE USERCAL 0 255 /end CHARACTERISTIC
/begin COMPU_METHOD CM_IAC_1_IO_RESOURCE Conversion for "IAC 1 IO Resource" TAB_VERB %3.0 ENUM COMPU_TAB_REF CM_TAB_VERB_IAC_1_IO_RESOURCE /end COMPU_METHOD
/begin COMPU_TAB_RANGE CM_TAB_VERB_IAC_1_IO_RESOURCE "  " 17 4 EH_IO_ADD5 6 EH_IO_ADD7 7 EH_IO_ADD8 58 EH_IO_TMR1 59 EH_IO_TMR2 60 EH_IO_TMR3 61 EH_IO_TMR4 62 EH_IO_TMR5 63 EH_IO_TMR6 64 EH_IO_TMR7 65 EH_IO_TMR8 66 EH_IO_TMR9 67 EH_IO_TMR10 68 EH_IO_TMR11 69 EH_IO_TMR12 70 EH_IO_EXTINT 121 EH_IO_Invalid DEFAULT_VALUE AUTO /end COMPU_TAB_RANGE
/begin CHARACTERISTIC IAC 2 IO Resource "IAC 2 IO Resource HTML=175.HTML" VALUE 0x20074B7A RL_VALU16 CM_IAC_2_IO_RESOURCE USERCAL 0 255 /end CHARACTERISTIC
/begin COMPU_METHOD CM_IAC_2_IO_RESOURCE Conversion for "IAC 2 IO Resource" TAB_VERB %3.0 ENUM COMPU_TAB_REF CM_TAB_VERB_IAC_2_IO_RESOURCE /end COMPU_METHOD
/begin COMPU_TAB_RANGE CM_TAB_VERB_IAC_2_IO_RESOURCE "  " 17 4 EH_IO_ADD5 6 EH_IO_ADD7 7 EH_IO_ADD8 58 EH_IO_TMR1 59 EH_IO_TMR2 60 EH_IO_TMR3 61 EH_IO_TMR4 62 EH_IO_TMR5 63 EH_IO_TMR6 64 EH_IO_TMR7 65 EH_IO_TMR8 66 EH_IO_TMR9 67 EH_IO_TMR10 68 EH_IO_TMR11 69 EH_IO_TMR12 70 EH_IO_EXTINT 121 EH_IO_Invalid DEFAULT_VALUE AUTO /end COMPU_TAB_RANGE
/begin CHARACTERISTIC IAC 3 IO Resource "IAC 3 IO Resource HTML=176.HTML" VALUE 0x20074B7C RL_VALU16 CM_IAC_3_IO_RESOURCE USERCAL 0 255 /end CHARACTERISTIC
/begin COMPU_METHOD CM_IAC_3_IO_RESOURCE Conversion for "IAC 3 IO Resource" TAB_VERB %3.0 ENUM COMPU_TAB_REF CM_TAB_VERB_IAC_3_IO_RESOURCE /end COMPU_METHOD
/begin COMPU_TAB_RANGE CM_TAB_VERB_IAC_3_IO_RESOURCE "  " 17 4 EH_IO_ADD5 6 EH_IO_ADD7 7 EH_IO_ADD8 58 EH_IO_TMR1 59 EH_IO_TMR2 60 EH_IO_TMR3 61 EH_IO_TMR4 62 EH_IO_TMR5 63 EH_IO_TMR6 64 EH_IO_TMR7 65 EH_IO_TMR8 66 EH_IO_TMR9 67 EH_IO_TMR10 68 EH_IO_TMR11 69 EH_IO_TMR12 70 EH_IO_EXTINT 121 EH_IO_Invalid DEFAULT_VALUE AUTO /end COMPU_TAB_RANGE
/begin CHARACTERISTIC IAC 4 IO Resource "IAC 4 IO Resource HTML=177.HTML" VALUE 0x20074B7E RL_VALU16 CM_IAC_4_IO_RESOURCE USERCAL 0 255 /end CHARACTERISTIC
/begin COMPU_METHOD CM_IAC_4_IO_RESOURCE Conversion for "IAC 4 IO Resource" TAB_VERB %3.0 ENUM COMPU_TAB_REF CM_TAB_VERB_IAC_4_IO_RESOURCE /end COMPU_METHOD
/begin COMPU_TAB_RANGE CM_TAB_VERB_IAC_4_IO_RESOURCE "  " 17 4 EH_IO_ADD5 6 EH_IO_ADD7 7 EH_IO_ADD8 58 EH_IO_TMR1 59 EH_IO_TMR2 60 EH_IO_TMR3 61 EH_IO_TMR4 62 EH_IO_TMR5 63 EH_IO_TMR6 64 EH_IO_TMR7 65 EH_IO_TMR8 66 EH_IO_TMR9 67 EH_IO_TMR10 68 EH_IO_TMR11 69 EH_IO_TMR12 70 EH_IO_EXTINT 121 EH_IO_Invalid DEFAULT_VALUE AUTO /end COMPU_TAB_RANGE
/begin CHARACTERISTIC OBD ISC Advance Enable "IAC Enable OBD Idle Advance HTML=178.HTML" VALUE 0x20074B80 RL_VALU8 CM_OBD_ISC_ADVANCE_ENABLE USERCAL 0 1 /end CHARACTERISTIC
/begin COMPU_METHOD CM_OBD_ISC_ADVANCE_ENABLE Conversion for "OBD ISC Advance Enable" TAB_VERB %1.0 ENUM COMPU_TAB_REF CM_TAB_VERB_OBD_ISC_ADVANCE_ENABLE /end COMPU_METHOD
/begin COMPU_TAB_RANGE CM_TAB_VERB_OBD_ISC_ADVANCE_ENABLE "  " 2 0 OFF 1 ON DEFAULT_VALUE AUTO /end COMPU_TAB_RANGE
/begin CHARACTERISTIC Trigger Type "Trigger Type HTML=178.HTML" VALUE 0x20074B81 RL_VALU8 CM_TRIGGER_TYPE USERCAL 0 0 /end CHARACTERISTIC
/begin COMPU_METHOD CM_TRIGGER_TYPE Conversion for "Trigger Type" TAB_VERB %12.0 ENUM COMPU_TAB_REF CM_TAB_VERB_TRIGGER_TYPE /end COMPU_METHOD
/begin COMPU_TAB_RANGE CM_TAB_VERB_TRIGGER_TYPE "  " 4 0 AUTO 1 M15A 2 EA888 3 2NEFE DEFAULT_VALUE AUTO /end COMPU_TAB_RANGE
/begin CHARACTERISTIC Sync Type "Sync Type HTML=179.HTML" VALUE 0x20074B82 RL_VALU8 CM_SYNC_TYPE USERCAL 0 255 /end CHARACTERISTIC
/begin COMPU_METHOD CM_SYNC_TYPE Conversion for "Sync Type" TAB_VERB %12.0 ENUM COMPU_TAB_REF CM_TAB_VERB_SYNC_TYPE /end COMPU_METHOD
/begin COMPU_TAB_RANGE CM_TAB_VERB_SYNC_TYPE "  " 3 0 AUTO 1 M15A 2 EA888 DEFAULT_VALUE AUTO /end COMPU_TAB_RANGE
/begin CHARACTERISTIC Trigger Pull Strength "Trigger Pull Strength HTML=180.HTML" VALUE 0x20074B83 RL_VALU8 CM_TRIGGER_PULL_STRENGTH USERCAL 0 0 /end CHARACTERISTIC
/begin COMPU_METHOD CM_TRIGGER_PULL_STRENGTH Conversion for "Trigger Pull Strength" TAB_VERB %12.0 ENUM COMPU_TAB_REF CM_TAB_VERB_TRIGGER_PULL_STRENGTH /end COMPU_METHOD
/begin COMPU_TAB_RANGE CM_TAB_VERB_TRIGGER_PULL_STRENGTH "  " 3 0 WEAK 1 MEDIUM 2 STRONG DEFAULT_VALUE AUTO /end COMPU_TAB_RANGE
/begin CHARACTERISTIC Sync Pull Strength "Sync Pull Strength HTML=181.HTML" VALUE 0x20074B84 RL_VALU8 CM_SYNC_PULL_STRENGTH USERCAL 0 0 /end CHARACTERISTIC
/begin COMPU_METHOD CM_SYNC_PULL_STRENGTH Conversion for "Sync Pull Strength" TAB_VERB %1.0 ENUM COMPU_TAB_REF CM_TAB_VERB_SYNC_PULL_STRENGTH /end COMPU_METHOD
/begin COMPU_TAB_RANGE CM_TAB_VERB_SYNC_PULL_STRENGTH "  " 3 0 WEAK 1 MEDIUM 2 STRONG DEFAULT_VALUE AUTO /end COMPU_TAB_RANGE
/begin CHARACTERISTIC Min Linear Fuel Pulse "Min Linear Fuel Pulse HTML=182.HTML" VALUE 0x20074B86 RL_VALU16 CM_MIN_LINEAR_FUEL_PULSE USERCAL 0 2 /end CHARACTERISTIC
/begin COMPU_METHOD CM_MIN_LINEAR_FUEL_PULSE Conversion for "Min Linear Fuel Pulse" LINEAR %1.0 ms COEFFS_LINEAR 0.001 0 /end COMPU_METHOD
/begin CHARACTERISTIC CTS AD Resource "CTS AD Resource HTML=183.HTML" VALUE 0x20074B88 RL_VALU16 CM_CTS_AD_RESOURCE USERCAL 0 255 /end CHARACTERISTIC
/begin COMPU_METHOD CM_CTS_AD_RESOURCE Conversion for "CTS AD Resource" TAB_VERB %3.0 ENUM COMPU_TAB_REF CM_TAB_VERB_CTS_AD_RESOURCE /end COMPU_METHOD
/begin COMPU_TAB_RANGE CM_TAB_VERB_CTS_AD_RESOURCE "  " 15 0 EH_IO_ADD1 1 EH_IO_ADD2 2 EH_IO_ADD3 3 EH_IO_ADD4 4 EH_IO_ADD5 5 EH_IO_ADD6 6 EH_IO_ADD7 7 EH_IO_ADD8 8 EH_IO_ADD9 9 EH_IO_ADD10 10 EH_IO_ADD11 11 EH_IO_ADD12 46 EH_IO_IO52 48 EH_IO_IIC1_SCL 49 EH_IO_IIC1_SDA DEFAULT_VALUE AUTO /end COMPU_TAB_RANGE
/begin CHARACTERISTIC MAP AD Resource "MAP AD Resource HTML=184.HTML" VALUE 0x20074B8A RL_VALU16 CM_MAP_AD_RESOURCE USERCAL 0 255 /end CHARACTERISTIC
/begin COMPU_METHOD CM_MAP_AD_RESOURCE Conversion for "MAP AD Resource" TAB_VERB %3.0 ENUM COMPU_TAB_REF CM_TAB_VERB_MAP_AD_RESOURCE /end COMPU_METHOD
/begin COMPU_TAB_RANGE CM_TAB_VERB_MAP_AD_RESOURCE "  " 15 0 EH_IO_ADD1 1 EH_IO_ADD2 2 EH_IO_ADD3 3 EH_IO_ADD4 4 EH_IO_ADD5 5 EH_IO_ADD6 6 EH_IO_ADD7 7 EH_IO_ADD8 8 EH_IO_ADD9 9 EH_IO_ADD10 10 EH_IO_ADD11 11 EH_IO_ADD12 46 EH_IO_IO52 48 EH_IO_IIC1_SCL 49 EH_IO_IIC1_SDA DEFAULT_VALUE AUTO /end COMPU_TAB_RANGE
/begin CHARACTERISTIC ATS AD Resource "ATS AD Resource HTML=185.HTML" VALUE 0x20074B8C RL_VALU16 CM_ATS_AD_RESOURCE USERCAL 0 255 /end CHARACTERISTIC
/begin COMPU_METHOD CM_ATS_AD_RESOURCE Conversion for "ATS AD Resource" TAB_VERB %3.0 ENUM COMPU_TAB_REF CM_TAB_VERB_ATS_AD_RESOURCE /end COMPU_METHOD
/begin COMPU_TAB_RANGE CM_TAB_VERB_ATS_AD_RESOURCE "  " 15 0 EH_IO_ADD1 1 EH_IO_ADD2 2 EH_IO_ADD3 3 EH_IO_ADD4 4 EH_IO_ADD5 5 EH_IO_ADD6 6 EH_IO_ADD7 7 EH_IO_ADD8 8 EH_IO_ADD9 9 EH_IO_ADD10 10 EH_IO_ADD11 11 EH_IO_ADD12 46 EH_IO_IO52 48 EH_IO_IIC1_SCL 49 EH_IO_IIC1_SDA DEFAULT_VALUE AUTO /end COMPU_TAB_RANGE
/begin CHARACTERISTIC AFM AD Resource "AFM AD Resource HTML=186.HTML" VALUE 0x20074B8E RL_VALU16 CM_AFM_AD_RESOURCE USERCAL 0 255 /end CHARACTERISTIC
/begin COMPU_METHOD CM_AFM_AD_RESOURCE Conversion for "AFM AD Resource" TAB_VERB %3.0 ENUM COMPU_TAB_REF CM_TAB_VERB_AFM_AD_RESOURCE /end COMPU_METHOD
/begin COMPU_TAB_RANGE CM_TAB_VERB_AFM_AD_RESOURCE "  " 15 0 EH_IO_ADD1 1 EH_IO_ADD2 2 EH_IO_ADD3 3 EH_IO_ADD4 4 EH_IO_ADD5 5 EH_IO_ADD6 6 EH_IO_ADD7 7 EH_IO_ADD8 8 EH_IO_ADD9 9 EH_IO_ADD10 10 EH_IO_ADD11 11 EH_IO_ADD12 46 EH_IO_IO52 48 EH_IO_IIC1_SCL 49 EH_IO_IIC1_SDA DEFAULT_VALUE AUTO /end COMPU_TAB_RANGE
/begin CHARACTERISTIC TPS AD Resource "TPS AD Resource HTML=187.HTML" VALUE 0x20074B90 RL_VALU16 CM_TPS_AD_RESOURCE USERCAL 0 255 /end CHARACTERISTIC
/begin COMPU_METHOD CM_TPS_AD_RESOURCE Conversion for "TPS AD Resource" TAB_VERB %3.0 ENUM COMPU_TAB_REF CM_TAB_VERB_TPS_AD_RESOURCE /end COMPU_METHOD
/begin COMPU_TAB_RANGE CM_TAB_VERB_TPS_AD_RESOURCE "  " 15 0 EH_IO_ADD1 1 EH_IO_ADD2 2 EH_IO_ADD3 3 EH_IO_ADD4 4 EH_IO_ADD5 5 EH_IO_ADD6 6 EH_IO_ADD7 7 EH_IO_ADD8 8 EH_IO_ADD9 9 EH_IO_ADD10 10 EH_IO_ADD11 11 EH_IO_ADD12 46 EH_IO_IO52 48 EH_IO_IIC1_SCL 49 EH_IO_IIC1_SDA DEFAULT_VALUE AUTO /end COMPU_TAB_RANGE
/begin AXIS_PTS Tip In Correction Table_XAXIS "Tip In Correction X Axis HTML=188.HTML" 0x20074B94 RL_VALU32 Engine Speed Raw CM_ENGINE_SPEED_RAW 17 0 8000 AXIS_PTS_REF Tip In Correction Table_XAXIS /end AXIS_PTS
/begin CHARACTERISTIC Tip In Correction Table "Tip In Correction Curve HTML=189.HTML" CURVE 0x20074BD8 RL_VALU16 CM_TIP_IN_CORRECTION_TABLE USERCAL 0 2
 /begin AXIS_DESCR STD_AXIS Engine Speed Raw CM_ENGINE_SPEED_RAW 17 0 0 AXIS_PTS_REF Tip In Correction Table_XAXIS /end AXIS_DESCR
/end CHARACTERISTIC
/begin COMPU_METHOD CM_TIP_IN_CORRECTION_TABLE Conversion for "Tip In Correction Table" LINEAR %6.3 % COEFFS_LINEAR 0.001 0 /end COMPU_METHOD
/begin CHARACTERISTIC Logic Block Var A "Logic Block Variable 1 HTML=190.HTML" VALUE 0x20074BFC RL_VALU32 CM_LOGIC_BLOCK_VAR_A USERCAL 0 4.294967E+09 /end CHARACTERISTIC
/begin COMPU_METHOD CM_LOGIC_BLOCK_VAR_A Conversion for "Logic Block Var A" IDENTICAL %3.0 dl /end COMPU_METHOD
/begin CHARACTERISTIC Logic Block Var B "Logic Block Variable 2 HTML=191.HTML" VALUE 0x20074C00 RL_VALU32 CM_LOGIC_BLOCK_VAR_B USERCAL 0 4.294967E+09 /end CHARACTERISTIC
/begin COMPU_METHOD CM_LOGIC_BLOCK_VAR_B Conversion for "Logic Block Var B" IDENTICAL %3.0 dl /end COMPU_METHOD
/begin CHARACTERISTIC Logic Block Var C "Logic Block Variable 3 HTML=192.HTML" VALUE 0x20074C04 RL_VALU32 CM_LOGIC_BLOCK_VAR_C USERCAL 0 4.294967E+09 /end CHARACTERISTIC
/begin COMPU_METHOD CM_LOGIC_BLOCK_VAR_C Conversion for "Logic Block Var C" IDENTICAL %3.0 dl /end COMPU_METHOD
/begin CHARACTERISTIC Logic Block Var D "Logic Block Variable 4 HTML=193.HTML" VALUE 0x20074C08 RL_VALU32 CM_LOGIC_BLOCK_VAR_D USERCAL 0 4.294967E+09 /end CHARACTERISTIC
/begin COMPU_METHOD CM_LOGIC_BLOCK_VAR_D Conversion for "Logic Block Var D" IDENTICAL %3.0 dl /end COMPU_METHOD
/begin CHARACTERISTIC Logic Block Var E "Logic Block Variable 5 HTML=194.HTML" VALUE 0x20074C0C RL_VALU32 CM_LOGIC_BLOCK_VAR_E USERCAL 0 4.294967E+09 /end CHARACTERISTIC
/begin COMPU_METHOD CM_LOGIC_BLOCK_VAR_E Conversion for "Logic Block Var E" IDENTICAL %3.0 dl /end COMPU_METHOD
/begin CHARACTERISTIC Logic Block Var F "Logic Block Variable 6 HTML=195.HTML" VALUE 0x20074C10 RL_VALU32 CM_LOGIC_BLOCK_VAR_F USERCAL 0 4.294967E+09 /end CHARACTERISTIC
/begin COMPU_METHOD CM_LOGIC_BLOCK_VAR_F Conversion for "Logic Block Var F" IDENTICAL %3.0 dl /end COMPU_METHOD
/begin CHARACTERISTIC Logic Block Var G "Logic Block Variable 7 HTML=196.HTML" VALUE 0x20074C14 RL_VALU32 CM_LOGIC_BLOCK_VAR_G USERCAL 0 4.294967E+09 /end CHARACTERISTIC
/begin COMPU_METHOD CM_LOGIC_BLOCK_VAR_G Conversion for "Logic Block Var G" IDENTICAL %3.0 dl /end COMPU_METHOD
/begin CHARACTERISTIC Logic Block Var H "Logic Block Variable 8 HTML=197.HTML" VALUE 0x20074C18 RL_VALU32 CM_LOGIC_BLOCK_VAR_H USERCAL 0 4.294967E+09 /end CHARACTERISTIC
/begin COMPU_METHOD CM_LOGIC_BLOCK_VAR_H Conversion for "Logic Block Var H" IDENTICAL %3.0 dl /end COMPU_METHOD
/begin CHARACTERISTIC Logic Block Operand A "Logic Block Operand 1 HTML=198.HTML" VALUE 0x20074C1C RL_VALU32 CM_LOGIC_BLOCK_OPERAND_A USERCAL 0 4.294967E+09 /end CHARACTERISTIC
/begin COMPU_METHOD CM_LOGIC_BLOCK_OPERAND_A Conversion for "Logic Block Operand A" IDENTICAL %3.0 dl /end COMPU_METHOD
/begin CHARACTERISTIC Logic Block Operand B "Logic Block Operand 2 HTML=199.HTML" VALUE 0x20074C20 RL_VALU32 CM_LOGIC_BLOCK_OPERAND_B USERCAL 0 4.294967E+09 /end CHARACTERISTIC
/begin COMPU_METHOD CM_LOGIC_BLOCK_OPERAND_B Conversion for "Logic Block Operand B" IDENTICAL %3.0 dl /end COMPU_METHOD
/begin CHARACTERISTIC Logic Block Operand C "Logic Block Operand 3 HTML=200.HTML" VALUE 0x20074C24 RL_VALU32 CM_LOGIC_BLOCK_OPERAND_C USERCAL 0 4.294967E+09 /end CHARACTERISTIC
/begin COMPU_METHOD CM_LOGIC_BLOCK_OPERAND_C Conversion for "Logic Block Operand C" IDENTICAL %3.0 dl /end COMPU_METHOD
/begin CHARACTERISTIC Logic Block Operand D "Logic Block Operand 4 HTML=201.HTML" VALUE 0x20074C28 RL_VALU32 CM_LOGIC_BLOCK_OPERAND_D USERCAL 0 4.294967E+09 /end CHARACTERISTIC
/begin COMPU_METHOD CM_LOGIC_BLOCK_OPERAND_D Conversion for "Logic Block Operand D" IDENTICAL %3.0 dl /end COMPU_METHOD
/begin CHARACTERISTIC Logic Block Operand E "Logic Block Operand 5 HTML=202.HTML" VALUE 0x20074C2C RL_VALU32 CM_LOGIC_BLOCK_OPERAND_E USERCAL 0 4.294967E+09 /end CHARACTERISTIC
/begin COMPU_METHOD CM_LOGIC_BLOCK_OPERAND_E Conversion for "Logic Block Operand E" IDENTICAL %3.0 dl /end COMPU_METHOD
/begin CHARACTERISTIC Logic Block Operand F "Logic Block Operand 6 HTML=203.HTML" VALUE 0x20074C30 RL_VALU32 CM_LOGIC_BLOCK_OPERAND_F USERCAL 0 4.294967E+09 /end CHARACTERISTIC
/begin COMPU_METHOD CM_LOGIC_BLOCK_OPERAND_F Conversion for "Logic Block Operand F" IDENTICAL %3.0 dl /end COMPU_METHOD
/begin CHARACTERISTIC Logic Block Operand G "Logic Block Operand 7 HTML=204.HTML" VALUE 0x20074C34 RL_VALU32 CM_LOGIC_BLOCK_OPERAND_G USERCAL 0 4.294967E+09 /end CHARACTERISTIC
/begin COMPU_METHOD CM_LOGIC_BLOCK_OPERAND_G Conversion for "Logic Block Operand G" IDENTICAL %3.0 dl /end COMPU_METHOD
/begin CHARACTERISTIC Logic Block Operand H "Logic Block Operand 8 HTML=205.HTML" VALUE 0x20074C38 RL_VALU32 CM_LOGIC_BLOCK_OPERAND_H USERCAL 0 4.294967E+09 /end CHARACTERISTIC
/begin COMPU_METHOD CM_LOGIC_BLOCK_OPERAND_H Conversion for "Logic Block Operand H" IDENTICAL %3.0 dl /end COMPU_METHOD
/begin CHARACTERISTIC Logic Block Chain Output A "Logic Block Chain Output 1 HTML=206.HTML" VALUE 0x20074C3C RL_VALU16 CM_LOGIC_BLOCK_CHAIN_OUTPUT_A USERCAL 0 4.294967E+09 /end CHARACTERISTIC
/begin COMPU_METHOD CM_LOGIC_BLOCK_CHAIN_OUTPUT_A Conversion for "Logic Block Chain Output A" IDENTICAL %3.0 dl /end COMPU_METHOD
/begin CHARACTERISTIC Logic Block Chain Output B "Logic Block Chain Output 2 HTML=207.HTML" VALUE 0x20074C3E RL_VALU16 CM_LOGIC_BLOCK_CHAIN_OUTPUT_B USERCAL 0 4.294967E+09 /end CHARACTERISTIC
/begin COMPU_METHOD CM_LOGIC_BLOCK_CHAIN_OUTPUT_B Conversion for "Logic Block Chain Output B" IDENTICAL %3.0 dl /end COMPU_METHOD
/begin CHARACTERISTIC Logic Block Chain Output C "Logic Block Chain Output 3 HTML=208.HTML" VALUE 0x20074C40 RL_VALU16 CM_LOGIC_BLOCK_CHAIN_OUTPUT_C USERCAL 0 4.294967E+09 /end CHARACTERISTIC
/begin COMPU_METHOD CM_LOGIC_BLOCK_CHAIN_OUTPUT_C Conversion for "Logic Block Chain Output C" IDENTICAL %3.0 dl /end COMPU_METHOD
/begin CHARACTERISTIC Logic Block Chain Output D "Logic Block Chain Output 4 HTML=209.HTML" VALUE 0x20074C42 RL_VALU16 CM_LOGIC_BLOCK_CHAIN_OUTPUT_D USERCAL 0 4.294967E+09 /end CHARACTERISTIC
/begin COMPU_METHOD CM_LOGIC_BLOCK_CHAIN_OUTPUT_D Conversion for "Logic Block Chain Output D" IDENTICAL %3.0 dl /end COMPU_METHOD
/begin CHARACTERISTIC Logic Block Chain Output E "Logic Block Chain Output 5 HTML=210.HTML" VALUE 0x20074C44 RL_VALU16 CM_LOGIC_BLOCK_CHAIN_OUTPUT_E USERCAL 0 4.294967E+09 /end CHARACTERISTIC
/begin COMPU_METHOD CM_LOGIC_BLOCK_CHAIN_OUTPUT_E Conversion for "Logic Block Chain Output E" IDENTICAL %3.0 dl /end COMPU_METHOD
/begin CHARACTERISTIC Logic Block Chain Output F "Logic Block Chain Output 6 HTML=211.HTML" VALUE 0x20074C46 RL_VALU16 CM_LOGIC_BLOCK_CHAIN_OUTPUT_F USERCAL 0 4.294967E+09 /end CHARACTERISTIC
/begin COMPU_METHOD CM_LOGIC_BLOCK_CHAIN_OUTPUT_F Conversion for "Logic Block Chain Output F" IDENTICAL %3.0 dl /end COMPU_METHOD
/begin CHARACTERISTIC Logic Block Chain Output G "Logic Block Chain Output 7 HTML=212.HTML" VALUE 0x20074C48 RL_VALU16 CM_LOGIC_BLOCK_CHAIN_OUTPUT_G USERCAL 0 4.294967E+09 /end CHARACTERISTIC
/begin COMPU_METHOD CM_LOGIC_BLOCK_CHAIN_OUTPUT_G Conversion for "Logic Block Chain Output G" IDENTICAL %3.0 dl /end COMPU_METHOD
/begin CHARACTERISTIC Logic Block Chain Output H "Logic Block Chain Output 8 HTML=213.HTML" VALUE 0x20074C4A RL_VALU16 CM_LOGIC_BLOCK_CHAIN_OUTPUT_H USERCAL 0 4.294967E+09 /end CHARACTERISTIC
/begin COMPU_METHOD CM_LOGIC_BLOCK_CHAIN_OUTPUT_H Conversion for "Logic Block Chain Output H" IDENTICAL %3.0 dl /end COMPU_METHOD
/begin CHARACTERISTIC Thermofan Relay "EST Sequence 1 IO Mux Resource" VALUE 0x20074C4C RL_VALU8 CM_THERMOFAN_RELAY USERCAL 1 100 /end CHARACTERISTIC
/begin COMPU_METHOD CM_THERMOFAN_RELAY Conversion for "Thermofan Relay" TAB_VERB %3.0 ENUM COMPU_TAB_REF CM_TAB_VERB_THERMOFAN_RELAY /end COMPU_METHOD
/begin COMPU_TAB_RANGE CM_TAB_VERB_THERMOFAN_RELAY "  " 26 0 EH_IO_ADD1 1 EH_IO_ADD2 2 EH_IO_ADD3 3 EH_IO_ADD4 4 EH_IO_ADD5 5 EH_IO_ADD6 6 EH_IO_ADD7 7 EH_IO_ADD8 8 EH_IO_ADD9 9 EH_IO_ADD10 10 EH_IO_ADD11 11 EH_IO_ADD12 58 EH_IO_TMR1 59 EH_IO_TMR2 60 EH_IO_TMR3 61 EH_IO_TMR4 62 EH_IO_TMR5 63 EH_IO_TMR6 64 EH_IO_TMR7 65 EH_IO_TMR8 66 EH_IO_TMR9 67 EH_IO_TMR10 68 EH_IO_TMR11 69 EH_IO_TMR12 70 EH_IO_EXTINT 121 EH_IO_Invalid DEFAULT_VALUE AUTO /end COMPU_TAB_RANGE
/begin CHARACTERISTIC EST 1 IO Mux Resource "EST Sequence 1 IO Mux Resource HTML=215.HTML" VALUE 0x20074C4E RL_VALU16 CM_EST_1_IO_MUX_RESOURCE USERCAL 0 255 /end CHARACTERISTIC
/begin COMPU_METHOD CM_EST_1_IO_MUX_RESOURCE Conversion for "EST 1 IO Mux Resource" TAB_VERB %3.0 ENUM COMPU_TAB_REF CM_TAB_VERB_EST_1_IO_MUX_RESOURCE /end COMPU_METHOD
/begin COMPU_TAB_RANGE CM_TAB_VERB_EST_1_IO_MUX_RESOURCE "  " 26 0 EH_IO_ADD1 1 EH_IO_ADD2 2 EH_IO_ADD3 3 EH_IO_ADD4 4 EH_IO_ADD5 5 EH_IO_ADD6 6 EH_IO_ADD7 7 EH_IO_ADD8 8 EH_IO_ADD9 9 EH_IO_ADD10 10 EH_IO_ADD11 11 EH_IO_ADD12 58 EH_IO_TMR1 59 EH_IO_TMR2 60 EH_IO_TMR3 61 EH_IO_TMR4 62 EH_IO_TMR5 63 EH_IO_TMR6 64 EH_IO_TMR7 65 EH_IO_TMR8 66 EH_IO_TMR9 67 EH_IO_TMR10 68 EH_IO_TMR11 69 EH_IO_TMR12 70 EH_IO_EXTINT 121 EH_IO_Invalid DEFAULT_VALUE AUTO /end COMPU_TAB_RANGE
/begin CHARACTERISTIC EST 2 IO Mux Resource "EST Sequence 2 IO Mux Resource HTML=216.HTML" VALUE 0x20074C50 RL_VALU16 CM_EST_2_IO_MUX_RESOURCE USERCAL 0 255 /end CHARACTERISTIC
/begin COMPU_METHOD CM_EST_2_IO_MUX_RESOURCE Conversion for "EST 2 IO Mux Resource" TAB_VERB %3.0 ENUM COMPU_TAB_REF CM_TAB_VERB_EST_2_IO_MUX_RESOURCE /end COMPU_METHOD
/begin COMPU_TAB_RANGE CM_TAB_VERB_EST_2_IO_MUX_RESOURCE "  " 26 0 EH_IO_ADD1 1 EH_IO_ADD2 2 EH_IO_ADD3 3 EH_IO_ADD4 4 EH_IO_ADD5 5 EH_IO_ADD6 6 EH_IO_ADD7 7 EH_IO_ADD8 8 EH_IO_ADD9 9 EH_IO_ADD10 10 EH_IO_ADD11 11 EH_IO_ADD12 58 EH_IO_TMR1 59 EH_IO_TMR2 60 EH_IO_TMR3 61 EH_IO_TMR4 62 EH_IO_TMR5 63 EH_IO_TMR6 64 EH_IO_TMR7 65 EH_IO_TMR8 66 EH_IO_TMR9 67 EH_IO_TMR10 68 EH_IO_TMR11 69 EH_IO_TMR12 70 EH_IO_EXTINT 121 EH_IO_Invalid DEFAULT_VALUE AUTO /end COMPU_TAB_RANGE
/begin CHARACTERISTIC EST 3 IO Mux Resource "EST Sequence 3 IO Mux Resource HTML=217.HTML" VALUE 0x20074C52 RL_VALU16 CM_EST_3_IO_MUX_RESOURCE USERCAL 0 255 /end CHARACTERISTIC
/begin COMPU_METHOD CM_EST_3_IO_MUX_RESOURCE Conversion for "EST 3 IO Mux Resource" TAB_VERB %3.0 ENUM COMPU_TAB_REF CM_TAB_VERB_EST_3_IO_MUX_RESOURCE /end COMPU_METHOD
/begin COMPU_TAB_RANGE CM_TAB_VERB_EST_3_IO_MUX_RESOURCE "  " 26 0 EH_IO_ADD1 1 EH_IO_ADD2 2 EH_IO_ADD3 3 EH_IO_ADD4 4 EH_IO_ADD5 5 EH_IO_ADD6 6 EH_IO_ADD7 7 EH_IO_ADD8 8 EH_IO_ADD9 9 EH_IO_ADD10 10 EH_IO_ADD11 11 EH_IO_ADD12 58 EH_IO_TMR1 59 EH_IO_TMR2 60 EH_IO_TMR3 61 EH_IO_TMR4 62 EH_IO_TMR5 63 EH_IO_TMR6 64 EH_IO_TMR7 65 EH_IO_TMR8 66 EH_IO_TMR9 67 EH_IO_TMR10 68 EH_IO_TMR11 69 EH_IO_TMR12 70 EH_IO_EXTINT 121 EH_IO_Invalid DEFAULT_VALUE AUTO /end COMPU_TAB_RANGE
/begin CHARACTERISTIC EST 4 IO Mux Resource "EST Sequence 4 IO Mux Resource HTML=218.HTML" VALUE 0x20074C54 RL_VALU16 CM_EST_4_IO_MUX_RESOURCE USERCAL 0 255 /end CHARACTERISTIC
/begin COMPU_METHOD CM_EST_4_IO_MUX_RESOURCE Conversion for "EST 4 IO Mux Resource" TAB_VERB %3.0 ENUM COMPU_TAB_REF CM_TAB_VERB_EST_4_IO_MUX_RESOURCE /end COMPU_METHOD
/begin COMPU_TAB_RANGE CM_TAB_VERB_EST_4_IO_MUX_RESOURCE "  " 26 0 EH_IO_ADD1 1 EH_IO_ADD2 2 EH_IO_ADD3 3 EH_IO_ADD4 4 EH_IO_ADD5 5 EH_IO_ADD6 6 EH_IO_ADD7 7 EH_IO_ADD8 8 EH_IO_ADD9 9 EH_IO_ADD10 10 EH_IO_ADD11 11 EH_IO_ADD12 58 EH_IO_TMR1 59 EH_IO_TMR2 60 EH_IO_TMR3 61 EH_IO_TMR4 62 EH_IO_TMR5 63 EH_IO_TMR6 64 EH_IO_TMR7 65 EH_IO_TMR8 66 EH_IO_TMR9 67 EH_IO_TMR10 68 EH_IO_TMR11 69 EH_IO_TMR12 70 EH_IO_EXTINT 121 EH_IO_Invalid DEFAULT_VALUE AUTO /end COMPU_TAB_RANGE
/begin CHARACTERISTIC UEGO CAN Primary "UEGO CAN Enable HTML=219.HTML" VALUE 0x20074C56 RL_VALU8 CM_UEGO_CAN_PRIMARY USERCAL 0 2 /end CHARACTERISTIC
/begin COMPU_METHOD CM_UEGO_CAN_PRIMARY Conversion for "UEGO CAN Primary" IDENTICAL %1.0 dl /end COMPU_METHOD
/begin CHARACTERISTIC PWM 2D 1 Axis Source X "PWM 2D 1 Axis Source X HTML=220.HTML" VALUE 0x20074C58 RL_VALU16 CM_PWM_2D_1_AXIS_SOURCE_X USERCAL 0 255 /end CHARACTERISTIC
/begin COMPU_METHOD CM_PWM_2D_1_AXIS_SOURCE_X Conversion for "PWM 2D 1 Axis Source X" IDENTICAL %3.0 dl /end COMPU_METHOD
/begin CHARACTERISTIC PWM 2D 2 Axis Source X "PWM 2D 2 Axis Source X HTML=221.HTML" VALUE 0x20074C5A RL_VALU16 CM_PWM_2D_2_AXIS_SOURCE_X USERCAL 0 255 /end CHARACTERISTIC
/begin COMPU_METHOD CM_PWM_2D_2_AXIS_SOURCE_X Conversion for "PWM 2D 2 Axis Source X" IDENTICAL %3.0 dl /end COMPU_METHOD
/begin CHARACTERISTIC PWM 2D 3 Axis Source X "PWM 2D 3 Axis Source X HTML=222.HTML" VALUE 0x20074C5C RL_VALU16 CM_PWM_2D_3_AXIS_SOURCE_X USERCAL 0 255 /end CHARACTERISTIC
/begin COMPU_METHOD CM_PWM_2D_3_AXIS_SOURCE_X Conversion for "PWM 2D 3 Axis Source X" IDENTICAL %3.0 dl /end COMPU_METHOD
/begin CHARACTERISTIC PWM 2D 4 Axis Source X "PWM 2D 4 Axis Source X HTML=223.HTML" VALUE 0x20074C5E RL_VALU16 CM_PWM_2D_4_AXIS_SOURCE_X USERCAL 0 255 /end CHARACTERISTIC
/begin COMPU_METHOD CM_PWM_2D_4_AXIS_SOURCE_X Conversion for "PWM 2D 4 Axis Source X" IDENTICAL %3.0 dl /end COMPU_METHOD
/begin CHARACTERISTIC PWM 2D 5 Axis Source X "PWM 2D 5 Axis Source X HTML=224.HTML" VALUE 0x20074C60 RL_VALU16 CM_PWM_2D_5_AXIS_SOURCE_X USERCAL 0 255 /end CHARACTERISTIC
/begin COMPU_METHOD CM_PWM_2D_5_AXIS_SOURCE_X Conversion for "PWM 2D 5 Axis Source X" IDENTICAL %3.0 dl /end COMPU_METHOD
/begin CHARACTERISTIC PWM 2D 6 Axis Source X "PWM 2D 6 Axis Source X HTML=225.HTML" VALUE 0x20074C62 RL_VALU16 CM_PWM_2D_6_AXIS_SOURCE_X USERCAL 0 255 /end CHARACTERISTIC
/begin COMPU_METHOD CM_PWM_2D_6_AXIS_SOURCE_X Conversion for "PWM 2D 6 Axis Source X" IDENTICAL %3.0 dl /end COMPU_METHOD
/begin CHARACTERISTIC PWM 2D 7 Axis Source X "PWM 2D 7 Axis Source X HTML=226.HTML" VALUE 0x20074C64 RL_VALU16 CM_PWM_2D_7_AXIS_SOURCE_X USERCAL 0 255 /end CHARACTERISTIC
/begin COMPU_METHOD CM_PWM_2D_7_AXIS_SOURCE_X Conversion for "PWM 2D 7 Axis Source X" IDENTICAL %3.0 dl /end COMPU_METHOD
/begin CHARACTERISTIC PWM 2D 8 Axis Source X "PWM 2D 8 Axis Source X HTML=227.HTML" VALUE 0x20074C66 RL_VALU16 CM_PWM_2D_8_AXIS_SOURCE_X USERCAL 0 255 /end CHARACTERISTIC
/begin COMPU_METHOD CM_PWM_2D_8_AXIS_SOURCE_X Conversion for "PWM 2D 8 Axis Source X" IDENTICAL %3.0 dl /end COMPU_METHOD
/begin CHARACTERISTIC PWM 3D 1 Axis Source X "PWM 3D 1 Axis Source X HTML=228.HTML" VALUE 0x20074C68 RL_VALU16 CM_PWM_3D_1_AXIS_SOURCE_X USERCAL 0 255 /end CHARACTERISTIC
/begin COMPU_METHOD CM_PWM_3D_1_AXIS_SOURCE_X Conversion for "PWM 3D 1 Axis Source X" IDENTICAL %3.0 dl /end COMPU_METHOD
/begin CHARACTERISTIC PWM 3D 2 Axis Source X "PWM 3D 2 Axis Source X HTML=229.HTML" VALUE 0x20074C6A RL_VALU16 CM_PWM_3D_2_AXIS_SOURCE_X USERCAL 0 255 /end CHARACTERISTIC
/begin COMPU_METHOD CM_PWM_3D_2_AXIS_SOURCE_X Conversion for "PWM 3D 2 Axis Source X" IDENTICAL %3.0 dl /end COMPU_METHOD
/begin CHARACTERISTIC PWM 3D 3 Axis Source X "PWM 3D 3 Axis Source X HTML=230.HTML" VALUE 0x20074C6C RL_VALU16 CM_PWM_3D_3_AXIS_SOURCE_X USERCAL 0 255 /end CHARACTERISTIC
/begin COMPU_METHOD CM_PWM_3D_3_AXIS_SOURCE_X Conversion for "PWM 3D 3 Axis Source X" IDENTICAL %3.0 dl /end COMPU_METHOD
/begin CHARACTERISTIC PWM 3D 4 Axis Source X "PWM 3D 4 Axis Source X HTML=231.HTML" VALUE 0x20074C6E RL_VALU16 CM_PWM_3D_4_AXIS_SOURCE_X USERCAL 0 255 /end CHARACTERISTIC
/begin COMPU_METHOD CM_PWM_3D_4_AXIS_SOURCE_X Conversion for "PWM 3D 4 Axis Source X" IDENTICAL %3.0 dl /end COMPU_METHOD
/begin CHARACTERISTIC PWM 3D 1 Axis Source Y "PWM 3D 1 Axis Source Y HTML=232.HTML" VALUE 0x20074C70 RL_VALU16 CM_PWM_3D_1_AXIS_SOURCE_Y USERCAL 0 255 /end CHARACTERISTIC
/begin COMPU_METHOD CM_PWM_3D_1_AXIS_SOURCE_Y Conversion for "PWM 3D 1 Axis Source Y" IDENTICAL %3.0 dl /end COMPU_METHOD
/begin CHARACTERISTIC PWM 3D 2 Axis Source Y "PWM 3D 2 Axis Source Y HTML=233.HTML" VALUE 0x20074C72 RL_VALU16 CM_PWM_3D_2_AXIS_SOURCE_Y USERCAL 0 255 /end CHARACTERISTIC
/begin COMPU_METHOD CM_PWM_3D_2_AXIS_SOURCE_Y Conversion for "PWM 3D 2 Axis Source Y" IDENTICAL %3.0 dl /end COMPU_METHOD
/begin CHARACTERISTIC PWM 3D 3 Axis Source Y "PWM 3D 3 Axis Source Y HTML=234.HTML" VALUE 0x20074C74 RL_VALU16 CM_PWM_3D_3_AXIS_SOURCE_Y USERCAL 0 255 /end CHARACTERISTIC
/begin COMPU_METHOD CM_PWM_3D_3_AXIS_SOURCE_Y Conversion for "PWM 3D 3 Axis Source Y" IDENTICAL %3.0 dl /end COMPU_METHOD
/begin CHARACTERISTIC PWM 3D 4 Axis Source Y "PWM 3D 4 Axis Source Y HTML=235.HTML" VALUE 0x20074C76 RL_VALU16 CM_PWM_3D_4_AXIS_SOURCE_Y USERCAL 0 255 /end CHARACTERISTIC
/begin COMPU_METHOD CM_PWM_3D_4_AXIS_SOURCE_Y Conversion for "PWM 3D 4 Axis Source Y" IDENTICAL %3.0 dl /end COMPU_METHOD
/begin CHARACTERISTIC PWM 2D 1 IO Resource "PWM 2D 1 IO Resource HTML=236.HTML" VALUE 0x20074C78 RL_VALU16 CM_PWM_2D_1_IO_RESOURCE USERCAL 0 255 /end CHARACTERISTIC
/begin COMPU_METHOD CM_PWM_2D_1_IO_RESOURCE Conversion for "PWM 2D 1 IO Resource" TAB_VERB %3.0 ENUM COMPU_TAB_REF CM_TAB_VERB_PWM_2D_1_IO_RESOURCE /end COMPU_METHOD
/begin COMPU_TAB_RANGE CM_TAB_VERB_PWM_2D_1_IO_RESOURCE "  " 26 0 EH_IO_ADD1 1 EH_IO_ADD2 2 EH_IO_ADD3 3 EH_IO_ADD4 4 EH_IO_ADD5 5 EH_IO_ADD6 6 EH_IO_ADD7 7 EH_IO_ADD8 8 EH_IO_ADD9 9 EH_IO_ADD10 10 EH_IO_ADD11 11 EH_IO_ADD12 58 EH_IO_TMR1 59 EH_IO_TMR2 60 EH_IO_TMR3 61 EH_IO_TMR4 62 EH_IO_TMR5 63 EH_IO_TMR6 64 EH_IO_TMR7 65 EH_IO_TMR8 66 EH_IO_TMR9 67 EH_IO_TMR10 68 EH_IO_TMR11 69 EH_IO_TMR12 70 EH_IO_EXTINT 121 EH_IO_Invalid DEFAULT_VALUE AUTO /end COMPU_TAB_RANGE
/begin CHARACTERISTIC PWM 2D 2 IO Resource "PWM 2D 2 IO Resource HTML=237.HTML" VALUE 0x20074C7A RL_VALU16 CM_PWM_2D_2_IO_RESOURCE USERCAL 0 255 /end CHARACTERISTIC
/begin COMPU_METHOD CM_PWM_2D_2_IO_RESOURCE Conversion for "PWM 2D 2 IO Resource" TAB_VERB %3.0 ENUM COMPU_TAB_REF CM_TAB_VERB_PWM_2D_2_IO_RESOURCE /end COMPU_METHOD
/begin COMPU_TAB_RANGE CM_TAB_VERB_PWM_2D_2_IO_RESOURCE "  " 26 0 EH_IO_ADD1 1 EH_IO_ADD2 2 EH_IO_ADD3 3 EH_IO_ADD4 4 EH_IO_ADD5 5 EH_IO_ADD6 6 EH_IO_ADD7 7 EH_IO_ADD8 8 EH_IO_ADD9 9 EH_IO_ADD10 10 EH_IO_ADD11 11 EH_IO_ADD12 58 EH_IO_TMR1 59 EH_IO_TMR2 60 EH_IO_TMR3 61 EH_IO_TMR4 62 EH_IO_TMR5 63 EH_IO_TMR6 64 EH_IO_TMR7 65 EH_IO_TMR8 66 EH_IO_TMR9 67 EH_IO_TMR10 68 EH_IO_TMR11 69 EH_IO_TMR12 70 EH_IO_EXTINT 121 EH_IO_Invalid DEFAULT_VALUE AUTO /end COMPU_TAB_RANGE
/begin CHARACTERISTIC PWM 2D 3 IO Resource "PWM 2D 3 IO Resource HTML=238.HTML" VALUE 0x20074C7C RL_VALU16 CM_PWM_2D_3_IO_RESOURCE USERCAL 0 255 /end CHARACTERISTIC
/begin COMPU_METHOD CM_PWM_2D_3_IO_RESOURCE Conversion for "PWM 2D 3 IO Resource" TAB_VERB %3.0 ENUM COMPU_TAB_REF CM_TAB_VERB_PWM_2D_3_IO_RESOURCE /end COMPU_METHOD
/begin COMPU_TAB_RANGE CM_TAB_VERB_PWM_2D_3_IO_RESOURCE "  " 26 0 EH_IO_ADD1 1 EH_IO_ADD2 2 EH_IO_ADD3 3 EH_IO_ADD4 4 EH_IO_ADD5 5 EH_IO_ADD6 6 EH_IO_ADD7 7 EH_IO_ADD8 8 EH_IO_ADD9 9 EH_IO_ADD10 10 EH_IO_ADD11 11 EH_IO_ADD12 58 EH_IO_TMR1 59 EH_IO_TMR2 60 EH_IO_TMR3 61 EH_IO_TMR4 62 EH_IO_TMR5 63 EH_IO_TMR6 64 EH_IO_TMR7 65 EH_IO_TMR8 66 EH_IO_TMR9 67 EH_IO_TMR10 68 EH_IO_TMR11 69 EH_IO_TMR12 70 EH_IO_EXTINT 121 EH_IO_Invalid DEFAULT_VALUE AUTO /end COMPU_TAB_RANGE
/begin CHARACTERISTIC PWM 2D 4 IO Resource "PWM 2D 4 IO Resource HTML=239.HTML" VALUE 0x20074C7E RL_VALU16 CM_PWM_2D_4_IO_RESOURCE USERCAL 0 255 /end CHARACTERISTIC
/begin COMPU_METHOD CM_PWM_2D_4_IO_RESOURCE Conversion for "PWM 2D 4 IO Resource" TAB_VERB %3.0 ENUM COMPU_TAB_REF CM_TAB_VERB_PWM_2D_4_IO_RESOURCE /end COMPU_METHOD
/begin COMPU_TAB_RANGE CM_TAB_VERB_PWM_2D_4_IO_RESOURCE "  " 26 0 EH_IO_ADD1 1 EH_IO_ADD2 2 EH_IO_ADD3 3 EH_IO_ADD4 4 EH_IO_ADD5 5 EH_IO_ADD6 6 EH_IO_ADD7 7 EH_IO_ADD8 8 EH_IO_ADD9 9 EH_IO_ADD10 10 EH_IO_ADD11 11 EH_IO_ADD12 58 EH_IO_TMR1 59 EH_IO_TMR2 60 EH_IO_TMR3 61 EH_IO_TMR4 62 EH_IO_TMR5 63 EH_IO_TMR6 64 EH_IO_TMR7 65 EH_IO_TMR8 66 EH_IO_TMR9 67 EH_IO_TMR10 68 EH_IO_TMR11 69 EH_IO_TMR12 70 EH_IO_EXTINT 121 EH_IO_Invalid DEFAULT_VALUE AUTO /end COMPU_TAB_RANGE
/begin CHARACTERISTIC PWM 2D 5 IO Resource "PWM 2D 5 IO Resource HTML=240.HTML" VALUE 0x20074C80 RL_VALU16 CM_PWM_2D_5_IO_RESOURCE USERCAL 0 255 /end CHARACTERISTIC
/begin COMPU_METHOD CM_PWM_2D_5_IO_RESOURCE Conversion for "PWM 2D 5 IO Resource" TAB_VERB %3.0 ENUM COMPU_TAB_REF CM_TAB_VERB_PWM_2D_5_IO_RESOURCE /end COMPU_METHOD
/begin COMPU_TAB_RANGE CM_TAB_VERB_PWM_2D_5_IO_RESOURCE "  " 26 0 EH_IO_ADD1 1 EH_IO_ADD2 2 EH_IO_ADD3 3 EH_IO_ADD4 4 EH_IO_ADD5 5 EH_IO_ADD6 6 EH_IO_ADD7 7 EH_IO_ADD8 8 EH_IO_ADD9 9 EH_IO_ADD10 10 EH_IO_ADD11 11 EH_IO_ADD12 58 EH_IO_TMR1 59 EH_IO_TMR2 60 EH_IO_TMR3 61 EH_IO_TMR4 62 EH_IO_TMR5 63 EH_IO_TMR6 64 EH_IO_TMR7 65 EH_IO_TMR8 66 EH_IO_TMR9 67 EH_IO_TMR10 68 EH_IO_TMR11 69 EH_IO_TMR12 70 EH_IO_EXTINT 121 EH_IO_Invalid DEFAULT_VALUE AUTO /end COMPU_TAB_RANGE
/begin CHARACTERISTIC PWM 2D 6 IO Resource "PWM 2D 6 IO Resource HTML=241.HTML" VALUE 0x20074C82 RL_VALU16 CM_PWM_2D_6_IO_RESOURCE USERCAL 0 255 /end CHARACTERISTIC
/begin COMPU_METHOD CM_PWM_2D_6_IO_RESOURCE Conversion for "PWM 2D 6 IO Resource" TAB_VERB %3.0 ENUM COMPU_TAB_REF CM_TAB_VERB_PWM_2D_6_IO_RESOURCE /end COMPU_METHOD
/begin COMPU_TAB_RANGE CM_TAB_VERB_PWM_2D_6_IO_RESOURCE "  " 26 0 EH_IO_ADD1 1 EH_IO_ADD2 2 EH_IO_ADD3 3 EH_IO_ADD4 4 EH_IO_ADD5 5 EH_IO_ADD6 6 EH_IO_ADD7 7 EH_IO_ADD8 8 EH_IO_ADD9 9 EH_IO_ADD10 10 EH_IO_ADD11 11 EH_IO_ADD12 58 EH_IO_TMR1 59 EH_IO_TMR2 60 EH_IO_TMR3 61 EH_IO_TMR4 62 EH_IO_TMR5 63 EH_IO_TMR6 64 EH_IO_TMR7 65 EH_IO_TMR8 66 EH_IO_TMR9 67 EH_IO_TMR10 68 EH_IO_TMR11 69 EH_IO_TMR12 70 EH_IO_EXTINT 121 EH_IO_Invalid DEFAULT_VALUE AUTO /end COMPU_TAB_RANGE
/begin CHARACTERISTIC PWM 2D 7 IO Resource "PWM 2D 7 IO Resource HTML=242.HTML" VALUE 0x20074C84 RL_VALU16 CM_PWM_2D_7_IO_RESOURCE USERCAL 0 255 /end CHARACTERISTIC
/begin COMPU_METHOD CM_PWM_2D_7_IO_RESOURCE Conversion for "PWM 2D 7 IO Resource" TAB_VERB %3.0 ENUM COMPU_TAB_REF CM_TAB_VERB_PWM_2D_7_IO_RESOURCE /end COMPU_METHOD
/begin COMPU_TAB_RANGE CM_TAB_VERB_PWM_2D_7_IO_RESOURCE "  " 26 0 EH_IO_ADD1 1 EH_IO_ADD2 2 EH_IO_ADD3 3 EH_IO_ADD4 4 EH_IO_ADD5 5 EH_IO_ADD6 6 EH_IO_ADD7 7 EH_IO_ADD8 8 EH_IO_ADD9 9 EH_IO_ADD10 10 EH_IO_ADD11 11 EH_IO_ADD12 58 EH_IO_TMR1 59 EH_IO_TMR2 60 EH_IO_TMR3 61 EH_IO_TMR4 62 EH_IO_TMR5 63 EH_IO_TMR6 64 EH_IO_TMR7 65 EH_IO_TMR8 66 EH_IO_TMR9 67 EH_IO_TMR10 68 EH_IO_TMR11 69 EH_IO_TMR12 70 EH_IO_EXTINT 121 EH_IO_Invalid DEFAULT_VALUE AUTO /end COMPU_TAB_RANGE
/begin CHARACTERISTIC PWM 2D 8 IO Resource "PWM 2D 8 IO Resource HTML=243.HTML" VALUE 0x20074C86 RL_VALU16 CM_PWM_2D_8_IO_RESOURCE USERCAL 0 255 /end CHARACTERISTIC
/begin COMPU_METHOD CM_PWM_2D_8_IO_RESOURCE Conversion for "PWM 2D 8 IO Resource" TAB_VERB %3.0 ENUM COMPU_TAB_REF CM_TAB_VERB_PWM_2D_8_IO_RESOURCE /end COMPU_METHOD
/begin COMPU_TAB_RANGE CM_TAB_VERB_PWM_2D_8_IO_RESOURCE "  " 26 0 EH_IO_ADD1 1 EH_IO_ADD2 2 EH_IO_ADD3 3 EH_IO_ADD4 4 EH_IO_ADD5 5 EH_IO_ADD6 6 EH_IO_ADD7 7 EH_IO_ADD8 8 EH_IO_ADD9 9 EH_IO_ADD10 10 EH_IO_ADD11 11 EH_IO_ADD12 58 EH_IO_TMR1 59 EH_IO_TMR2 60 EH_IO_TMR3 61 EH_IO_TMR4 62 EH_IO_TMR5 63 EH_IO_TMR6 64 EH_IO_TMR7 65 EH_IO_TMR8 66 EH_IO_TMR9 67 EH_IO_TMR10 68 EH_IO_TMR11 69 EH_IO_TMR12 70 EH_IO_EXTINT 121 EH_IO_Invalid DEFAULT_VALUE AUTO /end COMPU_TAB_RANGE
/begin CHARACTERISTIC PWM 3D 1 IO Resource "PWM 3D 1 IO Resource HTML=244.HTML" VALUE 0x20074C88 RL_VALU16 CM_PWM_3D_1_IO_RESOURCE USERCAL 0 255 /end CHARACTERISTIC
/begin COMPU_METHOD CM_PWM_3D_1_IO_RESOURCE Conversion for "PWM 3D 1 IO Resource" TAB_VERB %3.0 ENUM COMPU_TAB_REF CM_TAB_VERB_PWM_3D_1_IO_RESOURCE /end COMPU_METHOD
/begin COMPU_TAB_RANGE CM_TAB_VERB_PWM_3D_1_IO_RESOURCE "  " 26 0 EH_IO_ADD1 1 EH_IO_ADD2 2 EH_IO_ADD3 3 EH_IO_ADD4 4 EH_IO_ADD5 5 EH_IO_ADD6 6 EH_IO_ADD7 7 EH_IO_ADD8 8 EH_IO_ADD9 9 EH_IO_ADD10 10 EH_IO_ADD11 11 EH_IO_ADD12 58 EH_IO_TMR1 59 EH_IO_TMR2 60 EH_IO_TMR3 61 EH_IO_TMR4 62 EH_IO_TMR5 63 EH_IO_TMR6 64 EH_IO_TMR7 65 EH_IO_TMR8 66 EH_IO_TMR9 67 EH_IO_TMR10 68 EH_IO_TMR11 69 EH_IO_TMR12 70 EH_IO_EXTINT 121 EH_IO_Invalid DEFAULT_VALUE AUTO /end COMPU_TAB_RANGE
/begin CHARACTERISTIC PWM 3D 2 IO Resource "PWM 3D 2 IO Resource HTML=245.HTML" VALUE 0x20074C8A RL_VALU16 CM_PWM_3D_2_IO_RESOURCE USERCAL 0 255 /end CHARACTERISTIC
/begin COMPU_METHOD CM_PWM_3D_2_IO_RESOURCE Conversion for "PWM 3D 2 IO Resource" TAB_VERB %3.0 ENUM COMPU_TAB_REF CM_TAB_VERB_PWM_3D_2_IO_RESOURCE /end COMPU_METHOD
/begin COMPU_TAB_RANGE CM_TAB_VERB_PWM_3D_2_IO_RESOURCE "  " 26 0 EH_IO_ADD1 1 EH_IO_ADD2 2 EH_IO_ADD3 3 EH_IO_ADD4 4 EH_IO_ADD5 5 EH_IO_ADD6 6 EH_IO_ADD7 7 EH_IO_ADD8 8 EH_IO_ADD9 9 EH_IO_ADD10 10 EH_IO_ADD11 11 EH_IO_ADD12 58 EH_IO_TMR1 59 EH_IO_TMR2 60 EH_IO_TMR3 61 EH_IO_TMR4 62 EH_IO_TMR5 63 EH_IO_TMR6 64 EH_IO_TMR7 65 EH_IO_TMR8 66 EH_IO_TMR9 67 EH_IO_TMR10 68 EH_IO_TMR11 69 EH_IO_TMR12 70 EH_IO_EXTINT 121 EH_IO_Invalid DEFAULT_VALUE AUTO /end COMPU_TAB_RANGE
/begin CHARACTERISTIC PWM 3D 3 IO Resource "PWM 3D 3 IO Resource HTML=246.HTML" VALUE 0x20074C8C RL_VALU16 CM_PWM_3D_3_IO_RESOURCE USERCAL 0 255 /end CHARACTERISTIC
/begin COMPU_METHOD CM_PWM_3D_3_IO_RESOURCE Conversion for "PWM 3D 3 IO Resource" TAB_VERB %3.0 ENUM COMPU_TAB_REF CM_TAB_VERB_PWM_3D_3_IO_RESOURCE /end COMPU_METHOD
/begin COMPU_TAB_RANGE CM_TAB_VERB_PWM_3D_3_IO_RESOURCE "  " 26 0 EH_IO_ADD1 1 EH_IO_ADD2 2 EH_IO_ADD3 3 EH_IO_ADD4 4 EH_IO_ADD5 5 EH_IO_ADD6 6 EH_IO_ADD7 7 EH_IO_ADD8 8 EH_IO_ADD9 9 EH_IO_ADD10 10 EH_IO_ADD11 11 EH_IO_ADD12 58 EH_IO_TMR1 59 EH_IO_TMR2 60 EH_IO_TMR3 61 EH_IO_TMR4 62 EH_IO_TMR5 63 EH_IO_TMR6 64 EH_IO_TMR7 65 EH_IO_TMR8 66 EH_IO_TMR9 67 EH_IO_TMR10 68 EH_IO_TMR11 69 EH_IO_TMR12 70 EH_IO_EXTINT 121 EH_IO_Invalid DEFAULT_VALUE AUTO /end COMPU_TAB_RANGE
/begin CHARACTERISTIC PWM 3D 4 IO Resource "PWM 3D 4 IO Resource HTML=247.HTML" VALUE 0x20074C8E RL_VALU16 CM_PWM_3D_4_IO_RESOURCE USERCAL 0 255 /end CHARACTERISTIC
/begin COMPU_METHOD CM_PWM_3D_4_IO_RESOURCE Conversion for "PWM 3D 4 IO Resource" TAB_VERB %3.0 ENUM COMPU_TAB_REF CM_TAB_VERB_PWM_3D_4_IO_RESOURCE /end COMPU_METHOD
/begin COMPU_TAB_RANGE CM_TAB_VERB_PWM_3D_4_IO_RESOURCE "  " 26 0 EH_IO_ADD1 1 EH_IO_ADD2 2 EH_IO_ADD3 3 EH_IO_ADD4 4 EH_IO_ADD5 5 EH_IO_ADD6 6 EH_IO_ADD7 7 EH_IO_ADD8 8 EH_IO_ADD9 9 EH_IO_ADD10 10 EH_IO_ADD11 11 EH_IO_ADD12 58 EH_IO_TMR1 59 EH_IO_TMR2 60 EH_IO_TMR3 61 EH_IO_TMR4 62 EH_IO_TMR5 63 EH_IO_TMR6 64 EH_IO_TMR7 65 EH_IO_TMR8 66 EH_IO_TMR9 67 EH_IO_TMR10 68 EH_IO_TMR11 69 EH_IO_TMR12 70 EH_IO_EXTINT 121 EH_IO_Invalid DEFAULT_VALUE AUTO /end COMPU_TAB_RANGE
/begin AXIS_PTS PWM 2D Table 1_XAXIS "PWM 2D 1 X Axis HTML=248.HTML" 0x20074C90 RL_VALS32 Generic Source IDX1 CM_GENERIC_SOURCE_IDX1 17 0 65535 AXIS_PTS_REF PWM 2D Table 1_XAXIS /end AXIS_PTS
/begin AXIS_PTS PWM 2D Table 2_XAXIS "PWM 2D 2 X Axis HTML=249.HTML" 0x20074CD4 RL_VALS32 Generic Source IDX2 CM_GENERIC_SOURCE_IDX2 17 0 65535 AXIS_PTS_REF PWM 2D Table 2_XAXIS /end AXIS_PTS
/begin AXIS_PTS PWM 2D Table 3_XAXIS "PWM 2D 3 X Axis HTML=250.HTML" 0x20074D18 RL_VALS32 Generic Source IDX3 CM_GENERIC_SOURCE_IDX3 17 0 65535 AXIS_PTS_REF PWM 2D Table 3_XAXIS /end AXIS_PTS
/begin AXIS_PTS PWM 2D Table 4_XAXIS "PWM 2D 4 X Axis HTML=251.HTML" 0x20074D5C RL_VALS32 Generic Source IDX4 CM_GENERIC_SOURCE_IDX4 17 0 65535 AXIS_PTS_REF PWM 2D Table 4_XAXIS /end AXIS_PTS
/begin AXIS_PTS PWM 2D Table 5_XAXIS "PWM 2D 5 X Axis HTML=252.HTML" 0x20074DA0 RL_VALS32 Generic Source IDX5 CM_GENERIC_SOURCE_IDX5 17 0 65535 AXIS_PTS_REF PWM 2D Table 5_XAXIS /end AXIS_PTS
/begin AXIS_PTS PWM 2D Table 6_XAXIS "PWM 2D 6 X Axis HTML=253.HTML" 0x20074DE4 RL_VALS32 Generic Source IDX6 CM_GENERIC_SOURCE_IDX6 17 0 65535 AXIS_PTS_REF PWM 2D Table 6_XAXIS /end AXIS_PTS
/begin AXIS_PTS PWM 2D Table 7_XAXIS "PWM 2D 7 X Axis HTML=254.HTML" 0x20074E28 RL_VALS32 Generic Source IDX7 CM_GENERIC_SOURCE_IDX7 17 0 65535 AXIS_PTS_REF PWM 2D Table 7_XAXIS /end AXIS_PTS
/begin AXIS_PTS PWM 2D Table 8_XAXIS "PWM 2D 8 X Axis HTML=255.HTML" 0x20074E6C RL_VALS32 Generic Source IDX8 CM_GENERIC_SOURCE_IDX8 17 0 65535 AXIS_PTS_REF PWM 2D Table 8_XAXIS /end AXIS_PTS
/begin CHARACTERISTIC PWM 2D Table 1 "PWM 2D Curve 1 HTML=256.HTML" CURVE 0x20074EB0 RL_VALU16 CM_PWM_2D_TABLE_1 USERCAL 0 100
 /begin AXIS_DESCR STD_AXIS Generic Source IDX1 CM_GENERIC_SOURCE_IDX1 17 0 0 AXIS_PTS_REF PWM 2D Table 1_XAXIS /end AXIS_DESCR
/end CHARACTERISTIC
/begin COMPU_METHOD CM_PWM_2D_TABLE_1 Conversion for "PWM 2D Table 1" LINEAR %4.3 % COEFFS_LINEAR 0.1 0 /end COMPU_METHOD
/begin CHARACTERISTIC PWM 2D Table 2 "PWM 2D Curve 2 HTML=257.HTML" CURVE 0x20074ED2 RL_VALU16 CM_PWM_2D_TABLE_2 USERCAL 0 100
 /begin AXIS_DESCR STD_AXIS Generic Source IDX2 CM_GENERIC_SOURCE_IDX2 17 0 0 AXIS_PTS_REF PWM 2D Table 2_XAXIS /end AXIS_DESCR
/end CHARACTERISTIC
/begin COMPU_METHOD CM_PWM_2D_TABLE_2 Conversion for "PWM 2D Table 2" LINEAR %4.3 % COEFFS_LINEAR 0.1 0 /end COMPU_METHOD
/begin CHARACTERISTIC PWM 2D Table 3 "PWM 2D Curve 3 HTML=258.HTML" CURVE 0x20074EF4 RL_VALU16 CM_PWM_2D_TABLE_3 USERCAL 0 100
 /begin AXIS_DESCR STD_AXIS Generic Source IDX3 CM_GENERIC_SOURCE_IDX3 17 0 0 AXIS_PTS_REF PWM 2D Table 3_XAXIS /end AXIS_DESCR
/end CHARACTERISTIC
/begin COMPU_METHOD CM_PWM_2D_TABLE_3 Conversion for "PWM 2D Table 3" LINEAR %4.3 % COEFFS_LINEAR 0.1 0 /end COMPU_METHOD
/begin CHARACTERISTIC PWM 2D Table 4 "PWM 2D Curve 4 HTML=259.HTML" CURVE 0x20074F16 RL_VALU16 CM_PWM_2D_TABLE_4 USERCAL 0 100
 /begin AXIS_DESCR STD_AXIS Generic Source IDX4 CM_GENERIC_SOURCE_IDX4 17 0 0 AXIS_PTS_REF PWM 2D Table 4_XAXIS /end AXIS_DESCR
/end CHARACTERISTIC
/begin COMPU_METHOD CM_PWM_2D_TABLE_4 Conversion for "PWM 2D Table 4" LINEAR %4.3 % COEFFS_LINEAR 0.1 0 /end COMPU_METHOD
/begin CHARACTERISTIC PWM 2D Table 5 "PWM 2D Curve 5 HTML=260.HTML" CURVE 0x20074F38 RL_VALU16 CM_PWM_2D_TABLE_5 USERCAL 0 100
 /begin AXIS_DESCR STD_AXIS Generic Source IDX5 CM_GENERIC_SOURCE_IDX5 17 0 0 AXIS_PTS_REF PWM 2D Table 5_XAXIS /end AXIS_DESCR
/end CHARACTERISTIC
/begin COMPU_METHOD CM_PWM_2D_TABLE_5 Conversion for "PWM 2D Table 5" LINEAR %4.3 % COEFFS_LINEAR 0.1 0 /end COMPU_METHOD
/begin CHARACTERISTIC PWM 2D Table 6 "PWM 2D Curve 6 HTML=261.HTML" CURVE 0x20074F5A RL_VALU16 CM_PWM_2D_TABLE_6 USERCAL 0 100
 /begin AXIS_DESCR STD_AXIS Generic Source IDX6 CM_GENERIC_SOURCE_IDX6 17 0 0 AXIS_PTS_REF PWM 2D Table 6_XAXIS /end AXIS_DESCR
/end CHARACTERISTIC
/begin COMPU_METHOD CM_PWM_2D_TABLE_6 Conversion for "PWM 2D Table 6" LINEAR %4.3 % COEFFS_LINEAR 0.1 0 /end COMPU_METHOD
/begin CHARACTERISTIC PWM 2D Table 7 "PWM 2D Curve 7 HTML=262.HTML" CURVE 0x20074F7C RL_VALU16 CM_PWM_2D_TABLE_7 USERCAL 0 100
 /begin AXIS_DESCR STD_AXIS Generic Source IDX7 CM_GENERIC_SOURCE_IDX7 17 0 0 AXIS_PTS_REF PWM 2D Table 7_XAXIS /end AXIS_DESCR
/end CHARACTERISTIC
/begin COMPU_METHOD CM_PWM_2D_TABLE_7 Conversion for "PWM 2D Table 7" LINEAR %4.3 % COEFFS_LINEAR 0.1 0 /end COMPU_METHOD
/begin CHARACTERISTIC PWM 2D Table 8 "PWM 2D Curve 8 HTML=263.HTML" CURVE 0x20074F9E RL_VALU16 CM_PWM_2D_TABLE_8 USERCAL 0 100
 /begin AXIS_DESCR STD_AXIS Generic Source IDX8 CM_GENERIC_SOURCE_IDX8 17 0 0 AXIS_PTS_REF PWM 2D Table 8_XAXIS /end AXIS_DESCR
/end CHARACTERISTIC
/begin COMPU_METHOD CM_PWM_2D_TABLE_8 Conversion for "PWM 2D Table 8" LINEAR %4.3 % COEFFS_LINEAR 0.1 0 /end COMPU_METHOD
/begin AXIS_PTS PWM 3D Map 1_XAXIS "PWM 3D 1 X Axis HTML=264.HTML" 0x20074FC0 RL_VALS32 Generic Source IDX9 CM_GENERIC_SOURCE_IDX9 17 0 65535 AXIS_PTS_REF PWM 3D Map 1_XAXIS /end AXIS_PTS
/begin AXIS_PTS PWM 3D Map 2_XAXIS "PWM 3D 2 X Axis HTML=265.HTML" 0x20075004 RL_VALS32 Generic Source IDX10 CM_GENERIC_SOURCE_IDX10 17 0 65535 AXIS_PTS_REF PWM 3D Map 2_XAXIS /end AXIS_PTS
/begin AXIS_PTS PWM 3D Map 3_XAXIS "PWM 3D 3 X Axis HTML=266.HTML" 0x20075048 RL_VALS32 Generic Source IDX11 CM_GENERIC_SOURCE_IDX11 17 0 65535 AXIS_PTS_REF PWM 3D Map 3_XAXIS /end AXIS_PTS
/begin AXIS_PTS PWM 3D Map 4_XAXIS "PWM 3D 4 X Axis HTML=267.HTML" 0x2007508C RL_VALS32 Generic Source IDX12 CM_GENERIC_SOURCE_IDX12 17 0 65535 AXIS_PTS_REF PWM 3D Map 4_XAXIS /end AXIS_PTS
/begin AXIS_PTS PWM 3D Map 1_YAXIS "PWM 3D 1 Y Axis HTML=270.HTML" 0x200750D0 RL_VALS32 Generic Source IDX13 CM_GENERIC_SOURCE_IDX13 17 0 65535 AXIS_PTS_REF PWM 3D Map 1_YAXIS /end AXIS_PTS
/begin AXIS_PTS PWM 3D Map 2_YAXIS "PWM 3D 2 Y Axis HTML=271.HTML" 0x20075114 RL_VALS32 Generic Source IDX14 CM_GENERIC_SOURCE_IDX14 17 0 65535 AXIS_PTS_REF PWM 3D Map 2_YAXIS /end AXIS_PTS
/begin AXIS_PTS PWM 3D Map 3_YAXIS "PWM 3D 3 Y Axis HTML=272.HTML" 0x20075158 RL_VALS32 Generic Source IDX15 CM_GENERIC_SOURCE_IDX15 17 0 65535 AXIS_PTS_REF PWM 3D Map 3_YAXIS /end AXIS_PTS
/begin AXIS_PTS PWM 3D Map 4_YAXIS "PWM 3D 4 Y Axis HTML=273.HTML" 0x2007519C RL_VALS32 Generic Source IDX16 CM_GENERIC_SOURCE_IDX16 17 0 65535 AXIS_PTS_REF PWM 3D Map 4_YAXIS /end AXIS_PTS
/begin CHARACTERISTIC PWM 3D Map 1 "PWM 3D Map 1 HTML=274.HTML" MAP 0x200751E0 RL_VALU16 CM_PWM_3D_MAP_1 USERCAL 0 100
 /begin AXIS_DESCR STD_AXIS Generic Source IDX9 CM_GENERIC_SOURCE_IDX9 17 0 0 AXIS_PTS_REF PWM 3D Map 1_XAXIS /end AXIS_DESCR
 /begin AXIS_DESCR STD_AXIS Generic Source IDX13 CM_GENERIC_SOURCE_IDX13 17 0 0 AXIS_PTS_REF PWM 3D Map 1_YAXIS /end AXIS_DESCR
/end CHARACTERISTIC
/begin COMPU_METHOD CM_PWM_3D_MAP_1 Conversion for "PWM 3D Map 1" LINEAR %4.3 dl COEFFS_LINEAR 0.1 0 /end COMPU_METHOD
/begin CHARACTERISTIC PWM 3D Map 2 "PWM 3D Map 2 HTML=275.HTML" MAP 0x20075422 RL_VALU16 CM_PWM_3D_MAP_2 USERCAL 0 100
 /begin AXIS_DESCR STD_AXIS Generic Source IDX10 CM_GENERIC_SOURCE_IDX10 17 0 0 AXIS_PTS_REF PWM 3D Map 2_XAXIS /end AXIS_DESCR
 /begin AXIS_DESCR STD_AXIS Generic Source IDX14 CM_GENERIC_SOURCE_IDX14 17 0 0 AXIS_PTS_REF PWM 3D Map 2_YAXIS /end AXIS_DESCR
/end CHARACTERISTIC
/begin COMPU_METHOD CM_PWM_3D_MAP_2 Conversion for "PWM 3D Map 2" LINEAR %4.3 dl COEFFS_LINEAR 0.1 0 /end COMPU_METHOD
/begin CHARACTERISTIC PWM 3D Map 3 "PWM 3D Map 3 HTML=276.HTML" MAP 0x20075664 RL_VALU16 CM_PWM_3D_MAP_3 USERCAL 0 100
 /begin AXIS_DESCR STD_AXIS Generic Source IDX11 CM_GENERIC_SOURCE_IDX11 17 0 0 AXIS_PTS_REF PWM 3D Map 3_XAXIS /end AXIS_DESCR
 /begin AXIS_DESCR STD_AXIS Generic Source IDX15 CM_GENERIC_SOURCE_IDX15 17 0 0 AXIS_PTS_REF PWM 3D Map 3_YAXIS /end AXIS_DESCR
/end CHARACTERISTIC
/begin COMPU_METHOD CM_PWM_3D_MAP_3 Conversion for "PWM 3D Map 3" LINEAR %4.3 dl COEFFS_LINEAR 0.1 0 /end COMPU_METHOD
/begin CHARACTERISTIC PWM 3D Map 4 "PWM 3D Map 4 HTML=277.HTML" MAP 0x200758A6 RL_VALU16 CM_PWM_3D_MAP_4 USERCAL 0 100
 /begin AXIS_DESCR STD_AXIS Generic Source IDX12 CM_GENERIC_SOURCE_IDX12 17 0 0 AXIS_PTS_REF PWM 3D Map 4_XAXIS /end AXIS_DESCR
 /begin AXIS_DESCR STD_AXIS Generic Source IDX16 CM_GENERIC_SOURCE_IDX16 17 0 0 AXIS_PTS_REF PWM 3D Map 4_YAXIS /end AXIS_DESCR
/end CHARACTERISTIC
/begin COMPU_METHOD CM_PWM_3D_MAP_4 Conversion for "PWM 3D Map 4" LINEAR %4.3 dl COEFFS_LINEAR 0.1 0 /end COMPU_METHOD
/begin CHARACTERISTIC VVT Input Resource "VVT Input Resource HTML=278.HTML" VALUE 0x20075AE8 RL_VALU16 CM_VVT_INPUT_RESOURCE USERCAL 1 100 /end CHARACTERISTIC
/begin COMPU_METHOD CM_VVT_INPUT_RESOURCE Conversion for "VVT Input Resource" TAB_VERB %4.0 ENUM COMPU_TAB_REF CM_TAB_VERB_VVT_INPUT_RESOURCE /end COMPU_METHOD
/begin COMPU_TAB_RANGE CM_TAB_VERB_VVT_INPUT_RESOURCE "  " 26 0 EH_IO_ADD1 1 EH_IO_ADD2 2 EH_IO_ADD3 3 EH_IO_ADD4 4 EH_IO_ADD5 5 EH_IO_ADD6 6 EH_IO_ADD7 7 EH_IO_ADD8 8 EH_IO_ADD9 9 EH_IO_ADD10 10 EH_IO_ADD11 11 EH_IO_ADD12 58 EH_IO_TMR1 59 EH_IO_TMR2 60 EH_IO_TMR3 61 EH_IO_TMR4 62 EH_IO_TMR5 63 EH_IO_TMR6 64 EH_IO_TMR7 65 EH_IO_TMR8 66 EH_IO_TMR9 67 EH_IO_TMR10 68 EH_IO_TMR11 69 EH_IO_TMR12 70 EH_IO_EXTINT 121 EH_IO_Invalid DEFAULT_VALUE AUTO /end COMPU_TAB_RANGE
/begin CHARACTERISTIC VVT Input Type "VVT Input Type HTML=279.HTML" VALUE 0x20075AEA RL_VALU8 CM_VVT_INPUT_TYPE USERCAL 1 100 /end CHARACTERISTIC
/begin COMPU_METHOD CM_VVT_INPUT_TYPE Conversion for "VVT Input Type" IDENTICAL %4.0 dl /end COMPU_METHOD
/begin CHARACTERISTIC EDIS Enable "EDIS Enable HTML=280.HTML" VALUE 0x20075AEB RL_VALU8 CM_EDIS_ENABLE USERCAL 1 100 /end CHARACTERISTIC
/begin COMPU_METHOD CM_EDIS_ENABLE Conversion for "EDIS Enable" TAB_VERB %4.0 ENUM COMPU_TAB_REF CM_TAB_VERB_EDIS_ENABLE /end COMPU_METHOD
/begin COMPU_TAB_RANGE CM_TAB_VERB_EDIS_ENABLE "  " 2 0 OFF 1 ON DEFAULT_VALUE AUTO /end COMPU_TAB_RANGE
/begin CHARACTERISTIC Ignition Tooth Timing Enable "Ignition Tooth Timing Enable HTML=450.HTML" VALUE 0x20075AEC RL_VALU8 CM_IGNITION_TOOTH_TIMING_ENABLE USERCAL 1 255 /end CHARACTERISTIC
/begin COMPU_METHOD CM_IGNITION_TOOTH_TIMING_ENABLE Conversion for "Ignition Tooth Timing Enable" TAB_VERB %4.0 ENUM COMPU_TAB_REF CM_TAB_VERB_IGNITION_TOOTH_TIMING_ENABLE /end COMPU_METHOD
/begin COMPU_TAB_RANGE CM_TAB_VERB_IGNITION_TOOTH_TIMING_ENABLE "  " 2 0 OFF 1 ON DEFAULT_VALUE AUTO /end COMPU_TAB_RANGE
/begin CHARACTERISTIC Ignition Register Mux Enable "EST Register Mux Enable HTML=452.HTML" VALUE 0x20075AED RL_VALU8 CM_IGNITION_REGISTER_MUX_ENABLE USERCAL 0 1 /end CHARACTERISTIC
/begin COMPU_METHOD CM_IGNITION_REGISTER_MUX_ENABLE Conversion for "Ignition Register Mux Enable" TAB_VERB %4.0 ENUM COMPU_TAB_REF CM_TAB_VERB_IGNITION_REGISTER_MUX_ENABLE /end COMPU_METHOD
/begin COMPU_TAB_RANGE CM_TAB_VERB_IGNITION_REGISTER_MUX_ENABLE "  " 2 0 OFF 1 ON DEFAULT_VALUE AUTO /end COMPU_TAB_RANGE
/begin CHARACTERISTIC DUMMY RELAY "IAC 1 IO Resource HTML=451.HTML" VALUE 0x20075AF1 RL_VALU8 CM_DUMMY_RELAY USERCAL 0 255 /end CHARACTERISTIC
/begin COMPU_METHOD CM_DUMMY_RELAY Conversion for "DUMMY RELAY" TAB_VERB %3.0 ENUM COMPU_TAB_REF CM_TAB_VERB_DUMMY_RELAY /end COMPU_METHOD
/begin COMPU_TAB_RANGE CM_TAB_VERB_DUMMY_RELAY "  " 25 4 EH_IO_ADD5 6 EH_IO_ADD7 7 EH_IO_ADD8 58 EH_IO_TMR1 59 EH_IO_TMR2 60 EH_IO_TMR3 61 EH_IO_TMR4 62 EH_IO_TMR5 63 EH_IO_TMR6 64 EH_IO_TMR7 65 EH_IO_TMR8 66 EH_IO_TMR9 67 EH_IO_TMR10 68 EH_IO_TMR11 69 EH_IO_TMR12 70 EH_IO_EXTINT 71 EH_VIO_REL1 72 EH_VIO_REL2 73 EH_VIO_REL3 74 EH_VIO_REL4 75 EH_VIO_REL5 76 EH_VIO_REL6 77 EH_VIO_REL7 78 EH_VIO_REL8 121 EH_IO_Invalid DEFAULT_VALUE AUTO /end COMPU_TAB_RANGE
/begin CHARACTERISTIC CAL CRC "CAL CRC16" VALUE 0x20075AF2 RL_VALU8 CM_CAL_CRC USERCAL 0 255 /end CHARACTERISTIC
/begin COMPU_METHOD CM_CAL_CRC Conversion for "CAL CRC" IDENTICAL %3.0 counts /end COMPU_METHOD
/begin MEASUREMENT au32Offsets "Internal" VALUE 0x00096E38 RL_VALU32 CM_AU32OFFSETS USERCAL 0 65535 /end MEASUREMENT
/begin COMPU_METHOD CM_AU32OFFSETS Conversion for "au32Offsets" IDENTICAL %8.0 dl /end COMPU_METHOD
/begin MEASUREMENT Crank Error Counts "Crank Error Counts" VALUE 0x200806D0 RL_VALU32 CM_CRANK_ERROR_COUNTS CEM 0 65535 /end MEASUREMENT
/begin COMPU_METHOD CM_CRANK_ERROR_COUNTS Conversion for "Crank Error Counts" IDENTICAL %5.3 counts /end COMPU_METHOD
/begin MEASUREMENT Cam Error Counts "Cam Error Counts" VALUE 0x20080398 RL_VALU32 CM_CAM_ERROR_COUNTS CEM 0 65535 /end MEASUREMENT
/begin COMPU_METHOD CM_CAM_ERROR_COUNTS Conversion for "Cam Error Counts" IDENTICAL %5.3 counts /end COMPU_METHOD
/begin MEASUREMENT Crank Running Error Counts "Crank Running Error Counts" VALUE 0x20080514 RL_VALU32 CM_CRANK_RUNNING_ERROR_COUNTS CEM 0 65535 /end MEASUREMENT
/begin COMPU_METHOD CM_CRANK_RUNNING_ERROR_COUNTS Conversion for "Crank Running Error Counts" IDENTICAL %5.3 counts /end COMPU_METHOD
/begin MEASUREMENT Cam Running Error Counts "Cam Running Error Counts" VALUE 0x2008078C RL_VALU32 CM_CAM_RUNNING_ERROR_COUNTS CEM 0 65535 /end MEASUREMENT
/begin COMPU_METHOD CM_CAM_RUNNING_ERROR_COUNTS Conversion for "Cam Running Error Counts" IDENTICAL %5.3 counts /end COMPU_METHOD
